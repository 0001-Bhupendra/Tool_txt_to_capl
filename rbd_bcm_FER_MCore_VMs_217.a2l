ASAP2_VERSION 1 61
/begin PROJECT prjDemo ""
/begin HEADER "" PROJECT_NO prjDemo_1_0 VERSION "AR_A2L_1.0" /end HEADER
/begin MODULE modFinalDemo ""
/begin MOD_COMMON "" BYTE_ORDER MSB_FIRST ALIGNMENT_BYTE 1 ALIGNMENT_WORD 1 ALIGNMENT_LONG 1 ALIGNMENT_INT64 1 ALIGNMENT_FLOAT32_IEEE 1 ALIGNMENT_FLOAT64_IEEE 4 /end MOD_COMMON
/begin RECORD_LAYOUT SSV__SBYTE_S AXIS_PTS_X 1 SBYTE INDEX_INCR DIRECT /end RECORD_LAYOUT
/begin RECORD_LAYOUT SSV__SWORD_S AXIS_PTS_X 1 SWORD INDEX_INCR DIRECT /end RECORD_LAYOUT
/begin RECORD_LAYOUT SSV__SLONG_S AXIS_PTS_X 1 SLONG INDEX_INCR DIRECT /end RECORD_LAYOUT
/begin RECORD_LAYOUT SSV__FLOAT32_IEEE_S AXIS_PTS_X 1 FLOAT32_IEEE INDEX_INCR DIRECT /end RECORD_LAYOUT
/begin RECORD_LAYOUT SSV__FLOAT64_IEEE_S AXIS_PTS_X 1 FLOAT64_IEEE INDEX_INCR DIRECT /end RECORD_LAYOUT
/begin RECORD_LAYOUT __A_UINT64_Z FNC_VALUES 1 A_UINT64 ROW_DIR DIRECT /end RECORD_LAYOUT
/begin RECORD_LAYOUT __A_INT64_Z FNC_VALUES 1 A_INT64 ROW_DIR DIRECT /end RECORD_LAYOUT
/begin RECORD_LAYOUT __A_UINT64_S FNC_VALUES 1 A_UINT64 COLUMN_DIR DIRECT /end RECORD_LAYOUT
/begin RECORD_LAYOUT __A_INT64_S FNC_VALUES 1 A_INT64 COLUMN_DIR DIRECT /end RECORD_LAYOUT
/begin RECORD_LAYOUT SSV__A_UINT64_S AXIS_PTS_X 1 A_UINT64 INDEX_INCR DIRECT /end RECORD_LAYOUT
/begin RECORD_LAYOUT SSV__A_INT64_S AXIS_PTS_X 1 A_INT64 INDEX_INCR DIRECT /end RECORD_LAYOUT
/begin MEASUREMENT MCore_rb_SipF_ProcessImage.Cat50[43].highRes.IrmsSqFiltered "" UBYTE NO_COMPU_METHOD 0 0 0 255 ECU_ADDRESS 0x400DF914 /end MEASUREMENT
/begin MEASUREMENT MCore_rb_SipF_ProcessImage.Cat50[43].highRes.IrmsSqFiltered.B "" UBYTE NO_COMPU_METHOD 0 0 0 255 ECU_ADDRESS 0x400DF914 /end MEASUREMENT
/begin MEASUREMENT MCore_rb_SipF_ProcessImage.Cat50[43].highRes.IrmsSqFiltered.B.high_16 "" UWORD NO_COMPU_METHOD 0 0 0 65535 ECU_ADDRESS 0x400DF914 /end MEASUREMENT
/begin MEASUREMENT MCore_rb_SipF_ProcessImage.Cat50[43].highRes.IrmsSqFiltered.B.low_16 "" UWORD NO_COMPU_METHOD 0 0 0 65535 ECU_ADDRESS 0x400DF916 /end MEASUREMENT
/begin MEASUREMENT MCore_rb_SipF_ProcessImage.Cat50[43].highRes.IrmsSqFiltered.data_32 "" ULONG NO_COMPU_METHOD 0 0 0 4294967295 ECU_ADDRESS 0x400DF914 /end MEASUREMENT
/begin MEASUREMENT MCore_rb_SipF_ProcessImage.Cat50[43].processed "" UWORD NO_COMPU_METHOD 0 0 0 65535 ECU_ADDRESS 0x400DF91C /end MEASUREMENT
/begin MEASUREMENT MCore_rb_SipF_ProcessImage.Cat50[43].snapshot "" UWORD NO_COMPU_METHOD 0 0 0 65535 ECU_ADDRESS 0x400DF90C /end MEASUREMENT
/begin MEASUREMENT MCore_rb_SipF_ProcessImage.Cat50[43].snapshotDuty "" UWORD NO_COMPU_METHOD 0 0 0 65535 ECU_ADDRESS 0x400DF90E /end MEASUREMENT
/begin MEASUREMENT MCore_rb_SipF_ProcessImage.Cat50[43].snapshotErrorValue "" UBYTE NO_COMPU_METHOD 0 0 0 1 BIT_MASK 0x1 ECU_ADDRESS 0x400DF910 /end MEASUREMENT
/begin MEASUREMENT MCore_rb_SipF_ProcessImage.Cat50[43].snapshotPeriod "" UWORD NO_COMPU_METHOD 0 0 0 65535 ECU_ADDRESS 0x400DF910 /end MEASUREMENT
/begin MEASUREMENT MCore_rb_SipF_ProcessImage.Cat50[43].snapshotReserved "" UBYTE NO_COMPU_METHOD 0 0 0 63 BIT_MASK 0xfc ECU_ADDRESS 0x400DF910 /end MEASUREMENT
/begin MEASUREMENT MCore_rb_SipF_ProcessImage.Cat50[43].snapshotSbmValue "" UBYTE NO_COMPU_METHOD 0 0 0 1 BIT_MASK 0x2 ECU_ADDRESS 0x400DF910 /end MEASUREMENT
/begin MEASUREMENT MCore_rb_SipF_ProcessImage.Cat50[43].switches "" UBYTE NO_COMPU_METHOD 0 0 0 255 ECU_ADDRESS 0x400DF920 /end MEASUREMENT
/begin MEASUREMENT MCore_rb_SipF_ProcessImage.Cat50[43].switches.mcalInputDisconnect "" SBYTE rb_SipF_ProcessImage.Cat50[43].switches.mcalInputDisconnect.CONVERSION 0 0 -128 127 ECU_ADDRESS 0x400DF920 /end MEASUREMENT
/begin MEASUREMENT MCore_rb_SipF_ProcessImage.Cat50[43].switches.sipfInputDisconnect "" SBYTE rb_SipF_ProcessImage.Cat50[43].switches.sipfInputDisconnect.CONVERSION 0 0 -128 127 ECU_ADDRESS 0x400DF921 /end MEASUREMENT
/begin MEASUREMENT MCore_rb_SipF_ProcessImage.Cat50[44].highRes "" UBYTE NO_COMPU_METHOD 0 0 0 255 ECU_ADDRESS 0x400DF92C /end MEASUREMENT
/begin MEASUREMENT MCore_rb_SipF_ProcessImage.Cat50[44].highRes.IrmsSq "" UWORD NO_COMPU_METHOD 0 0 0 65535 ECU_ADDRESS 0x400DF930 /end MEASUREMENT
/begin MEASUREMENT MCore_rb_SipF_ProcessImage.Cat50[44].highRes.IrmsSqFiltered "" UBYTE NO_COMPU_METHOD 0 0 0 255 ECU_ADDRESS 0x400DF92C /end MEASUREMENT
/begin MEASUREMENT MCore_rb_SipF_ProcessImage.Cat50[44].highRes.IrmsSqFiltered.B "" UBYTE NO_COMPU_METHOD 0 0 0 255 ECU_ADDRESS 0x400DF92C /end MEASUREMENT
/begin MEASUREMENT MCore_rb_SipF_ProcessImage.Cat50[44].highRes.IrmsSqFiltered.B.high_16 "" UWORD NO_COMPU_METHOD 0 0 0 65535 ECU_ADDRESS 0x400DF92C /end MEASUREMENT
/begin MEASUREMENT MCore_rb_SipF_ProcessImage.Cat50[44].highRes.IrmsSqFiltered.B.low_16 "" UWORD NO_COMPU_METHOD 0 0 0 65535 ECU_ADDRESS 0x400DF92E /end MEASUREMENT
/begin MEASUREMENT MCore_rb_SipF_ProcessImage.Cat50[44].highRes.IrmsSqFiltered.data_32 "" ULONG NO_COMPU_METHOD 0 0 0 4294967295 ECU_ADDRESS 0x400DF92C /end MEASUREMENT
/begin MEASUREMENT MCore_rb_SipF_ProcessImage.Cat50[44].processed "" UWORD NO_COMPU_METHOD 0 0 0 65535 ECU_ADDRESS 0x400DF934 /end MEASUREMENT
/begin MEASUREMENT MCore_rb_SipF_ProcessImage.Cat50[44].snapshot "" UWORD NO_COMPU_METHOD 0 0 0 65535 ECU_ADDRESS 0x400DF924 /end MEASUREMENT
/begin MEASUREMENT MCore_rb_SipF_ProcessImage.Cat50[44].snapshotDuty "" UWORD NO_COMPU_METHOD 0 0 0 65535 ECU_ADDRESS 0x400DF926 /end MEASUREMENT
/begin MEASUREMENT MCore_rb_SipF_ProcessImage.Cat50[44].snapshotErrorValue "" UBYTE NO_COMPU_METHOD 0 0 0 1 BIT_MASK 0x1 ECU_ADDRESS 0x400DF928 /end MEASUREMENT
/begin MEASUREMENT MCore_rb_SipF_ProcessImage.Cat50[44].snapshotPeriod "" UWORD NO_COMPU_METHOD 0 0 0 65535 ECU_ADDRESS 0x400DF928 /end MEASUREMENT
/begin MEASUREMENT MCore_rb_SipF_ProcessImage.Cat50[44].snapshotReserved "" UBYTE NO_COMPU_METHOD 0 0 0 63 BIT_MASK 0xfc ECU_ADDRESS 0x400DF928 /end MEASUREMENT
/begin MEASUREMENT MCore_rb_SipF_ProcessImage.Cat50[44].snapshotSbmValue "" UBYTE NO_COMPU_METHOD 0 0 0 1 BIT_MASK 0x2 ECU_ADDRESS 0x400DF928 /end MEASUREMENT
/begin MEASUREMENT MCore_rb_SipF_ProcessImage.Cat50[44].switches "" UBYTE NO_COMPU_METHOD 0 0 0 255 ECU_ADDRESS 0x400DF938 /end MEASUREMENT
/begin MEASUREMENT MCore_rb_SipF_ProcessImage.Cat50[44].switches.mcalInputDisconnect "" SBYTE rb_SipF_ProcessImage.Cat50[44].switches.mcalInputDisconnect.CONVERSION 0 0 -128 127 ECU_ADDRESS 0x400DF938 /end MEASUREMENT
/begin MEASUREMENT MCore_rb_SipF_ProcessImage.Cat50[44].switches.sipfInputDisconnect "" SBYTE rb_SipF_ProcessImage.Cat50[44].switches.sipfInputDisconnect.CONVERSION 0 0 -128 127 ECU_ADDRESS 0x400DF939 /end MEASUREMENT
/begin MEASUREMENT MCore_rb_SipF_ProcessImage.Cat50[45].highRes "" UBYTE NO_COMPU_METHOD 0 0 0 255 ECU_ADDRESS 0x400DF944 /end MEASUREMENT
/begin MEASUREMENT MCore_rb_SipF_ProcessImage.Cat50[45].highRes.IrmsSq "" UWORD NO_COMPU_METHOD 0 0 0 65535 ECU_ADDRESS 0x400DF948 /end MEASUREMENT
/begin MEASUREMENT MCore_rb_SipF_ProcessImage.Cat50[45].highRes.IrmsSqFiltered "" UBYTE NO_COMPU_METHOD 0 0 0 255 ECU_ADDRESS 0x400DF944 /end MEASUREMENT
/begin MEASUREMENT MCore_rb_SipF_ProcessImage.Cat50[45].highRes.IrmsSqFiltered.B "" UBYTE NO_COMPU_METHOD 0 0 0 255 ECU_ADDRESS 0x400DF944 /end MEASUREMENT
/begin MEASUREMENT MCore_rb_SipF_ProcessImage.Cat50[45].highRes.IrmsSqFiltered.B.high_16 "" UWORD NO_COMPU_METHOD 0 0 0 65535 ECU_ADDRESS 0x400DF944 /end MEASUREMENT
/begin MEASUREMENT MCore_rb_SipF_ProcessImage.Cat50[45].highRes.IrmsSqFiltered.B.low_16 "" UWORD NO_COMPU_METHOD 0 0 0 65535 ECU_ADDRESS 0x400DF946 /end MEASUREMENT
/begin MEASUREMENT MCore_rb_SipF_ProcessImage.Cat50[45].highRes.IrmsSqFiltered.data_32 "" ULONG NO_COMPU_METHOD 0 0 0 4294967295 ECU_ADDRESS 0x400DF944 /end MEASUREMENT
/begin MEASUREMENT MCore_rb_SipF_ProcessImage.Cat50[45].processed "" UWORD NO_COMPU_METHOD 0 0 0 65535 ECU_ADDRESS 0x400DF94C /end MEASUREMENT
/begin MEASUREMENT MCore_rb_SipF_ProcessImage.Cat50[45].snapshot "" UWORD NO_COMPU_METHOD 0 0 0 65535 ECU_ADDRESS 0x400DF93C /end MEASUREMENT
/begin MEASUREMENT MCore_rb_SipF_ProcessImage.Cat50[45].snapshotDuty "" UWORD NO_COMPU_METHOD 0 0 0 65535 ECU_ADDRESS 0x400DF93E /end MEASUREMENT
/begin MEASUREMENT MCore_rb_SipF_ProcessImage.Cat50[45].snapshotErrorValue "" UBYTE NO_COMPU_METHOD 0 0 0 1 BIT_MASK 0x1 ECU_ADDRESS 0x400DF940 /end MEASUREMENT
/begin MEASUREMENT MCore_rb_SipF_ProcessImage.Cat50[45].snapshotPeriod "" UWORD NO_COMPU_METHOD 0 0 0 65535 ECU_ADDRESS 0x400DF940 /end MEASUREMENT
/begin MEASUREMENT MCore_rb_SipF_ProcessImage.Cat50[45].snapshotReserved "" UBYTE NO_COMPU_METHOD 0 0 0 63 BIT_MASK 0xfc ECU_ADDRESS 0x400DF940 /end MEASUREMENT
/begin MEASUREMENT MCore_rb_SipF_ProcessImage.Cat50[45].snapshotSbmValue "" UBYTE NO_COMPU_METHOD 0 0 0 1 BIT_MASK 0x2 ECU_ADDRESS 0x400DF940 /end MEASUREMENT
/begin MEASUREMENT MCore_rb_SipF_ProcessImage.Cat50[45].switches "" UBYTE NO_COMPU_METHOD 0 0 0 255 ECU_ADDRESS 0x400DF950 /end MEASUREMENT
/begin MEASUREMENT MCore_rb_SipF_ProcessImage.Cat50[45].switches.mcalInputDisconnect "" SBYTE rb_SipF_ProcessImage.Cat50[45].switches.mcalInputDisconnect.CONVERSION 0 0 -128 127 ECU_ADDRESS 0x400DF950 /end MEASUREMENT
/begin MEASUREMENT MCore_rb_SipF_ProcessImage.Cat50[45].switches.sipfInputDisconnect "" SBYTE rb_SipF_ProcessImage.Cat50[45].switches.sipfInputDisconnect.CONVERSION 0 0 -128 127 ECU_ADDRESS 0x400DF951 /end MEASUREMENT
/begin MEASUREMENT MCore_rb_SipF_ProcessImage.Cat50[46].highRes "" UBYTE NO_COMPU_METHOD 0 0 0 255 ECU_ADDRESS 0x400DF95C /end MEASUREMENT
/begin MEASUREMENT MCore_rb_SipF_ProcessImage.Cat50[46].highRes.IrmsSq "" UWORD NO_COMPU_METHOD 0 0 0 65535 ECU_ADDRESS 0x400DF960 /end MEASUREMENT
/begin MEASUREMENT MCore_rb_SipF_ProcessImage.Cat50[46].highRes.IrmsSqFiltered "" UBYTE NO_COMPU_METHOD 0 0 0 255 ECU_ADDRESS 0x400DF95C /end MEASUREMENT
/begin MEASUREMENT MCore_rb_SipF_ProcessImage.Cat50[46].highRes.IrmsSqFiltered.B "" UBYTE NO_COMPU_METHOD 0 0 0 255 ECU_ADDRESS 0x400DF95C /end MEASUREMENT
/begin MEASUREMENT MCore_rb_SipF_ProcessImage.Cat50[46].highRes.IrmsSqFiltered.B.high_16 "" UWORD NO_COMPU_METHOD 0 0 0 65535 ECU_ADDRESS 0x400DF95C /end MEASUREMENT
/begin MEASUREMENT MCore_rb_SipF_ProcessImage.Cat50[46].highRes.IrmsSqFiltered.B.low_16 "" UWORD NO_COMPU_METHOD 0 0 0 65535 ECU_ADDRESS 0x400DF95E /end MEASUREMENT
/begin MEASUREMENT MCore_rb_SipF_ProcessImage.Cat50[46].highRes.IrmsSqFiltered.data_32 "" ULONG NO_COMPU_METHOD 0 0 0 4294967295 ECU_ADDRESS 0x400DF95C /end MEASUREMENT
/begin MEASUREMENT MCore_rb_SipF_ProcessImage.Cat50[46].processed "" UWORD NO_COMPU_METHOD 0 0 0 65535 ECU_ADDRESS 0x400DF964 /end MEASUREMENT
/begin MEASUREMENT MCore_rb_SipF_ProcessImage.Cat50[46].snapshot "" UWORD NO_COMPU_METHOD 0 0 0 65535 ECU_ADDRESS 0x400DF954 /end MEASUREMENT
/begin MEASUREMENT MCore_rb_SipF_ProcessImage.Cat50[46].snapshotDuty "" UWORD NO_COMPU_METHOD 0 0 0 65535 ECU_ADDRESS 0x400DF956 /end MEASUREMENT
/begin MEASUREMENT MCore_rb_SipF_ProcessImage.Cat50[46].snapshotErrorValue "" UBYTE NO_COMPU_METHOD 0 0 0 1 BIT_MASK 0x1 ECU_ADDRESS 0x400DF958 /end MEASUREMENT
/begin MEASUREMENT MCore_rb_SipF_ProcessImage.Cat50[46].snapshotPeriod "" UWORD NO_COMPU_METHOD 0 0 0 65535 ECU_ADDRESS 0x400DF958 /end MEASUREMENT
/begin MEASUREMENT MCore_rb_SipF_ProcessImage.Cat50[46].snapshotReserved "" UBYTE NO_COMPU_METHOD 0 0 0 63 BIT_MASK 0xfc ECU_ADDRESS 0x400DF958 /end MEASUREMENT
/begin MEASUREMENT MCore_rb_SipF_ProcessImage.Cat50[46].snapshotSbmValue "" UBYTE NO_COMPU_METHOD 0 0 0 1 BIT_MASK 0x2 ECU_ADDRESS 0x400DF958 /end MEASUREMENT
/begin MEASUREMENT MCore_rb_SipF_ProcessImage.Cat50[46].switches "" UBYTE NO_COMPU_METHOD 0 0 0 255 ECU_ADDRESS 0x400DF968 /end MEASUREMENT
/begin MEASUREMENT MCore_rb_SipF_ProcessImage.Cat50[46].switches.mcalInputDisconnect "" SBYTE rb_SipF_ProcessImage.Cat50[46].switches.mcalInputDisconnect.CONVERSION 0 0 -128 127 ECU_ADDRESS 0x400DF968 /end MEASUREMENT
/begin MEASUREMENT MCore_rb_SipF_ProcessImage.Cat50[46].switches.sipfInputDisconnect "" SBYTE rb_SipF_ProcessImage.Cat50[46].switches.sipfInputDisconnect.CONVERSION 0 0 -128 127 ECU_ADDRESS 0x400DF969 /end MEASUREMENT
/begin MEASUREMENT MCore_rb_SipF_ProcessImage.Cat50[47].highRes "" UBYTE NO_COMPU_METHOD 0 0 0 255 ECU_ADDRESS 0x400DF974 /end MEASUREMENT
/begin MEASUREMENT MCore_rb_SipF_ProcessImage.Cat50[47].highRes.IrmsSq "" UWORD NO_COMPU_METHOD 0 0 0 65535 ECU_ADDRESS 0x400DF978 /end MEASUREMENT
/begin MEASUREMENT MCore_rb_SipF_ProcessImage.Cat50[47].highRes.IrmsSqFiltered "" UBYTE NO_COMPU_METHOD 0 0 0 255 ECU_ADDRESS 0x400DF974 /end MEASUREMENT
/begin MEASUREMENT MCore_rb_SipF_ProcessImage.Cat50[47].highRes.IrmsSqFiltered.B "" UBYTE NO_COMPU_METHOD 0 0 0 255 ECU_ADDRESS 0x400DF974 /end MEASUREMENT
/begin MEASUREMENT MCore_rb_SipF_ProcessImage.Cat50[47].highRes.IrmsSqFiltered.B.high_16 "" UWORD NO_COMPU_METHOD 0 0 0 65535 ECU_ADDRESS 0x400DF974 /end MEASUREMENT
/begin MEASUREMENT MCore_rb_SipF_ProcessImage.Cat50[47].highRes.IrmsSqFiltered.B.low_16 "" UWORD NO_COMPU_METHOD 0 0 0 65535 ECU_ADDRESS 0x400DF976 /end MEASUREMENT
/begin MEASUREMENT MCore_rb_SipF_ProcessImage.Cat50[47].highRes.IrmsSqFiltered.data_32 "" ULONG NO_COMPU_METHOD 0 0 0 4294967295 ECU_ADDRESS 0x400DF974 /end MEASUREMENT
/begin MEASUREMENT MCore_rb_SipF_ProcessImage.Cat50[47].processed "" UWORD NO_COMPU_METHOD 0 0 0 65535 ECU_ADDRESS 0x400DF97C /end MEASUREMENT
/begin MEASUREMENT MCore_rb_SipF_ProcessImage.Cat50[47].snapshot "" UWORD NO_COMPU_METHOD 0 0 0 65535 ECU_ADDRESS 0x400DF96C /end MEASUREMENT
/begin MEASUREMENT MCore_rb_SipF_ProcessImage.Cat50[47].snapshotDuty "" UWORD NO_COMPU_METHOD 0 0 0 65535 ECU_ADDRESS 0x400DF96E /end MEASUREMENT
/begin MEASUREMENT MCore_rb_SipF_ProcessImage.Cat50[47].snapshotErrorValue "" UBYTE NO_COMPU_METHOD 0 0 0 1 BIT_MASK 0x1 ECU_ADDRESS 0x400DF970 /end MEASUREMENT
/begin MEASUREMENT MCore_rb_SipF_ProcessImage.Cat50[47].snapshotPeriod "" UWORD NO_COMPU_METHOD 0 0 0 65535 ECU_ADDRESS 0x400DF970 /end MEASUREMENT
/begin MEASUREMENT MCore_rb_SipF_ProcessImage.Cat50[47].snapshotReserved "" UBYTE NO_COMPU_METHOD 0 0 0 63 BIT_MASK 0xfc ECU_ADDRESS 0x400DF970 /end MEASUREMENT
/begin MEASUREMENT MCore_rb_SipF_ProcessImage.Cat50[47].snapshotSbmValue "" UBYTE NO_COMPU_METHOD 0 0 0 1 BIT_MASK 0x2 ECU_ADDRESS 0x400DF970 /end MEASUREMENT
/begin MEASUREMENT MCore_rb_SipF_ProcessImage.Cat50[47].switches "" UBYTE NO_COMPU_METHOD 0 0 0 255 ECU_ADDRESS 0x400DF980 /end MEASUREMENT
/begin MEASUREMENT MCore_rb_SipF_ProcessImage.Cat50[47].switches.mcalInputDisconnect "" SBYTE rb_SipF_ProcessImage.Cat50[47].switches.mcalInputDisconnect.CONVERSION 0 0 -128 127 ECU_ADDRESS 0x400DF980 /end MEASUREMENT
/begin MEASUREMENT MCore_rb_SipF_ProcessImage.Cat50[47].switches.sipfInputDisconnect "" SBYTE rb_SipF_ProcessImage.Cat50[47].switches.sipfInputDisconnect.CONVERSION 0 0 -128 127 ECU_ADDRESS 0x400DF981 /end MEASUREMENT
/begin MEASUREMENT MCore_rb_SipF_ProcessImage.Cat50[48].highRes "" UBYTE NO_COMPU_METHOD 0 0 0 255 ECU_ADDRESS 0x400DF98C /end MEASUREMENT
/begin MEASUREMENT MCore_rb_SipF_ProcessImage.Cat50[48].highRes.IrmsSq "" UWORD NO_COMPU_METHOD 0 0 0 65535 ECU_ADDRESS 0x400DF990 /end MEASUREMENT
/begin MEASUREMENT MCore_rb_SipF_ProcessImage.Cat50[48].highRes.IrmsSqFiltered "" UBYTE NO_COMPU_METHOD 0 0 0 255 ECU_ADDRESS 0x400DF98C /end MEASUREMENT
/begin MEASUREMENT MCore_rb_SipF_ProcessImage.Cat50[48].highRes.IrmsSqFiltered.B "" UBYTE NO_COMPU_METHOD 0 0 0 255 ECU_ADDRESS 0x400DF98C /end MEASUREMENT
/begin MEASUREMENT MCore_rb_SipF_ProcessImage.Cat50[48].highRes.IrmsSqFiltered.B.high_16 "" UWORD NO_COMPU_METHOD 0 0 0 65535 ECU_ADDRESS 0x400DF98C /end MEASUREMENT
/begin MEASUREMENT MCore_rb_SipF_ProcessImage.Cat50[48].highRes.IrmsSqFiltered.B.low_16 "" UWORD NO_COMPU_METHOD 0 0 0 65535 ECU_ADDRESS 0x400DF98E /end MEASUREMENT
/begin MEASUREMENT MCore_rb_SipF_ProcessImage.Cat50[48].highRes.IrmsSqFiltered.data_32 "" ULONG NO_COMPU_METHOD 0 0 0 4294967295 ECU_ADDRESS 0x400DF98C /end MEASUREMENT
/begin MEASUREMENT MCore_rb_SipF_ProcessImage.Cat50[48].processed "" UWORD NO_COMPU_METHOD 0 0 0 65535 ECU_ADDRESS 0x400DF994 /end MEASUREMENT
/begin MEASUREMENT MCore_rb_SipF_ProcessImage.Cat50[48].snapshot "" UWORD NO_COMPU_METHOD 0 0 0 65535 ECU_ADDRESS 0x400DF984 /end MEASUREMENT
/begin MEASUREMENT MCore_rb_SipF_ProcessImage.Cat50[48].snapshotDuty "" UWORD NO_COMPU_METHOD 0 0 0 65535 ECU_ADDRESS 0x400DF986 /end MEASUREMENT
/begin MEASUREMENT MCore_rb_SipF_ProcessImage.Cat50[48].snapshotErrorValue "" UBYTE NO_COMPU_METHOD 0 0 0 1 BIT_MASK 0x1 ECU_ADDRESS 0x400DF988 /end MEASUREMENT
/begin MEASUREMENT MCore_rb_SipF_ProcessImage.Cat50[48].snapshotPeriod "" UWORD NO_COMPU_METHOD 0 0 0 65535 ECU_ADDRESS 0x400DF988 /end MEASUREMENT
/begin MEASUREMENT MCore_rb_SipF_ProcessImage.Cat50[48].snapshotReserved "" UBYTE NO_COMPU_METHOD 0 0 0 63 BIT_MASK 0xfc ECU_ADDRESS 0x400DF988 /end MEASUREMENT
/begin MEASUREMENT MCore_rb_SipF_ProcessImage.Cat50[48].snapshotSbmValue "" UBYTE NO_COMPU_METHOD 0 0 0 1 BIT_MASK 0x2 ECU_ADDRESS 0x400DF988 /end MEASUREMENT
/begin MEASUREMENT MCore_rb_SipF_ProcessImage.Cat50[48].switches "" UBYTE NO_COMPU_METHOD 0 0 0 255 ECU_ADDRESS 0x400DF998 /end MEASUREMENT
/begin MEASUREMENT MCore_rb_SipF_ProcessImage.Cat50[48].switches.mcalInputDisconnect "" SBYTE rb_SipF_ProcessImage.Cat50[48].switches.mcalInputDisconnect.CONVERSION 0 0 -128 127 ECU_ADDRESS 0x400DF998 /end MEASUREMENT
/begin MEASUREMENT MCore_rb_SipF_ProcessImage.Cat50[48].switches.sipfInputDisconnect "" SBYTE rb_SipF_ProcessImage.Cat50[48].switches.sipfInputDisconnect.CONVERSION 0 0 -128 127 ECU_ADDRESS 0x400DF999 /end MEASUREMENT
/begin MEASUREMENT MCore_rb_SipF_ProcessImage.Cat50[49].highRes "" UBYTE NO_COMPU_METHOD 0 0 0 255 ECU_ADDRESS 0x400DF9A4 /end MEASUREMENT
/begin MEASUREMENT MCore_rb_SipF_ProcessImage.Cat50[49].highRes.IrmsSq "" UWORD NO_COMPU_METHOD 0 0 0 65535 ECU_ADDRESS 0x400DF9A8 /end MEASUREMENT
/begin MEASUREMENT MCore_rb_SipF_ProcessImage.Cat50[49].highRes.IrmsSqFiltered "" UBYTE NO_COMPU_METHOD 0 0 0 255 ECU_ADDRESS 0x400DF9A4 /end MEASUREMENT
/begin MEASUREMENT MCore_rb_SipF_ProcessImage.Cat50[49].highRes.IrmsSqFiltered.B "" UBYTE NO_COMPU_METHOD 0 0 0 255 ECU_ADDRESS 0x400DF9A4 /end MEASUREMENT
/begin MEASUREMENT MCore_rb_SipF_ProcessImage.Cat50[49].highRes.IrmsSqFiltered.B.high_16 "" UWORD NO_COMPU_METHOD 0 0 0 65535 ECU_ADDRESS 0x400DF9A4 /end MEASUREMENT
/begin MEASUREMENT MCore_rb_SipF_ProcessImage.Cat50[49].highRes.IrmsSqFiltered.B.low_16 "" UWORD NO_COMPU_METHOD 0 0 0 65535 ECU_ADDRESS 0x400DF9A6 /end MEASUREMENT
/begin MEASUREMENT MCore_rb_SipF_ProcessImage.Cat50[49].highRes.IrmsSqFiltered.data_32 "" ULONG NO_COMPU_METHOD 0 0 0 4294967295 ECU_ADDRESS 0x400DF9A4 /end MEASUREMENT
/begin MEASUREMENT MCore_rb_SipF_ProcessImage.Cat50[49].processed "" UWORD NO_COMPU_METHOD 0 0 0 65535 ECU_ADDRESS 0x400DF9AC /end MEASUREMENT
/begin MEASUREMENT MCore_rb_SipF_ProcessImage.Cat50[49].snapshot "" UWORD NO_COMPU_METHOD 0 0 0 65535 ECU_ADDRESS 0x400DF99C /end MEASUREMENT
/begin MEASUREMENT MCore_rb_SipF_ProcessImage.Cat50[49].snapshotDuty "" UWORD NO_COMPU_METHOD 0 0 0 65535 ECU_ADDRESS 0x400DF99E /end MEASUREMENT
/begin MEASUREMENT MCore_rb_SipF_ProcessImage.Cat50[49].snapshotErrorValue "" UBYTE NO_COMPU_METHOD 0 0 0 1 BIT_MASK 0x1 ECU_ADDRESS 0x400DF9A0 /end MEASUREMENT
/begin MEASUREMENT MCore_rb_SipF_ProcessImage.Cat50[49].snapshotPeriod "" UWORD NO_COMPU_METHOD 0 0 0 65535 ECU_ADDRESS 0x400DF9A0 /end MEASUREMENT
/begin MEASUREMENT MCore_rb_SipF_ProcessImage.Cat50[49].snapshotReserved "" UBYTE NO_COMPU_METHOD 0 0 0 63 BIT_MASK 0xfc ECU_ADDRESS 0x400DF9A0 /end MEASUREMENT
/begin MEASUREMENT MCore_rb_SipF_ProcessImage.Cat50[49].snapshotSbmValue "" UBYTE NO_COMPU_METHOD 0 0 0 1 BIT_MASK 0x2 ECU_ADDRESS 0x400DF9A0 /end MEASUREMENT
/begin MEASUREMENT MCore_rb_SipF_ProcessImage.Cat50[49].switches "" UBYTE NO_COMPU_METHOD 0 0 0 255 ECU_ADDRESS 0x400DF9B0 /end MEASUREMENT
/begin MEASUREMENT MCore_rb_SipF_ProcessImage.Cat50[49].switches.mcalInputDisconnect "" SBYTE rb_SipF_ProcessImage.Cat50[49].switches.mcalInputDisconnect.CONVERSION 0 0 -128 127 ECU_ADDRESS 0x400DF9B0 /end MEASUREMENT
/begin MEASUREMENT MCore_rb_SipF_ProcessImage.Cat50[49].switches.sipfInputDisconnect "" SBYTE rb_SipF_ProcessImage.Cat50[49].switches.sipfInputDisconnect.CONVERSION 0 0 -128 127 ECU_ADDRESS 0x400DF9B1 /end MEASUREMENT
/begin MEASUREMENT MCore_rb_SipF_ProcessImage.Cat50[4].highRes "" UBYTE NO_COMPU_METHOD 0 0 0 255 ECU_ADDRESS 0x400DF56C /end MEASUREMENT
/begin MEASUREMENT MCore_rb_SipF_ProcessImage.Cat50[4].highRes.IrmsSq "" UWORD NO_COMPU_METHOD 0 0 0 65535 ECU_ADDRESS 0x400DF570 /end MEASUREMENT
/begin MEASUREMENT MCore_rb_SipF_ProcessImage.Cat50[4].highRes.IrmsSqFiltered "" UBYTE NO_COMPU_METHOD 0 0 0 255 ECU_ADDRESS 0x400DF56C /end MEASUREMENT
/begin MEASUREMENT MCore_rb_SipF_ProcessImage.Cat50[4].highRes.IrmsSqFiltered.B "" UBYTE NO_COMPU_METHOD 0 0 0 255 ECU_ADDRESS 0x400DF56C /end MEASUREMENT
/begin MEASUREMENT MCore_rb_SipF_ProcessImage.Cat50[4].highRes.IrmsSqFiltered.B.high_16 "" UWORD NO_COMPU_METHOD 0 0 0 65535 ECU_ADDRESS 0x400DF56C /end MEASUREMENT
/begin MEASUREMENT MCore_rb_SipF_ProcessImage.Cat50[4].highRes.IrmsSqFiltered.B.low_16 "" UWORD NO_COMPU_METHOD 0 0 0 65535 ECU_ADDRESS 0x400DF56E /end MEASUREMENT
/begin MEASUREMENT MCore_rb_SipF_ProcessImage.Cat50[4].highRes.IrmsSqFiltered.data_32 "" ULONG NO_COMPU_METHOD 0 0 0 4294967295 ECU_ADDRESS 0x400DF56C /end MEASUREMENT
/begin MEASUREMENT MCore_rb_SipF_ProcessImage.Cat50[4].processed "" UWORD NO_COMPU_METHOD 0 0 0 65535 ECU_ADDRESS 0x400DF574 /end MEASUREMENT
/begin MEASUREMENT MCore_rb_SipF_ProcessImage.Cat50[4].snapshot "" UWORD NO_COMPU_METHOD 0 0 0 65535 ECU_ADDRESS 0x400DF564 /end MEASUREMENT
/begin MEASUREMENT MCore_rb_SipF_ProcessImage.Cat50[4].snapshotDuty "" UWORD NO_COMPU_METHOD 0 0 0 65535 ECU_ADDRESS 0x400DF566 /end MEASUREMENT
/begin MEASUREMENT MCore_rb_SipF_ProcessImage.Cat50[4].snapshotErrorValue "" UBYTE NO_COMPU_METHOD 0 0 0 1 BIT_MASK 0x1 ECU_ADDRESS 0x400DF568 /end MEASUREMENT
/begin MEASUREMENT MCore_rb_SipF_ProcessImage.Cat50[4].snapshotPeriod "" UWORD NO_COMPU_METHOD 0 0 0 65535 ECU_ADDRESS 0x400DF568 /end MEASUREMENT
/begin MEASUREMENT MCore_rb_SipF_ProcessImage.Cat50[4].snapshotReserved "" UBYTE NO_COMPU_METHOD 0 0 0 63 BIT_MASK 0xfc ECU_ADDRESS 0x400DF568 /end MEASUREMENT
/begin MEASUREMENT MCore_rb_SipF_ProcessImage.Cat50[4].snapshotSbmValue "" UBYTE NO_COMPU_METHOD 0 0 0 1 BIT_MASK 0x2 ECU_ADDRESS 0x400DF568 /end MEASUREMENT
/begin MEASUREMENT MCore_rb_SipF_ProcessImage.Cat50[4].switches "" UBYTE NO_COMPU_METHOD 0 0 0 255 ECU_ADDRESS 0x400DF578 /end MEASUREMENT
/begin MEASUREMENT MCore_rb_SipF_ProcessImage.Cat50[4].switches.mcalInputDisconnect "" SBYTE rb_SipF_ProcessImage.Cat50[4].switches.mcalInputDisconnect.CONVERSION 0 0 -128 127 ECU_ADDRESS 0x400DF578 /end MEASUREMENT
/begin MEASUREMENT MCore_rb_SipF_ProcessImage.Cat50[4].switches.sipfInputDisconnect "" SBYTE rb_SipF_ProcessImage.Cat50[4].switches.sipfInputDisconnect.CONVERSION 0 0 -128 127 ECU_ADDRESS 0x400DF579 /end MEASUREMENT
/begin MEASUREMENT MCore_rb_SipF_ProcessImage.Cat50[50].highRes "" UBYTE NO_COMPU_METHOD 0 0 0 255 ECU_ADDRESS 0x400DF9BC /end MEASUREMENT
/begin MEASUREMENT MCore_rb_SipF_ProcessImage.Cat50[50].highRes.IrmsSq "" UWORD NO_COMPU_METHOD 0 0 0 65535 ECU_ADDRESS 0x400DF9C0 /end MEASUREMENT
/begin MEASUREMENT MCore_rb_SipF_ProcessImage.Cat50[50].highRes.IrmsSqFiltered "" UBYTE NO_COMPU_METHOD 0 0 0 255 ECU_ADDRESS 0x400DF9BC /end MEASUREMENT
/begin MEASUREMENT MCore_rb_SipF_ProcessImage.Cat50[50].highRes.IrmsSqFiltered.B "" UBYTE NO_COMPU_METHOD 0 0 0 255 ECU_ADDRESS 0x400DF9BC /end MEASUREMENT
/begin MEASUREMENT MCore_rb_SipF_ProcessImage.Cat50[50].highRes.IrmsSqFiltered.B.high_16 "" UWORD NO_COMPU_METHOD 0 0 0 65535 ECU_ADDRESS 0x400DF9BC /end MEASUREMENT
/begin MEASUREMENT MCore_rb_SipF_ProcessImage.Cat50[50].highRes.IrmsSqFiltered.B.low_16 "" UWORD NO_COMPU_METHOD 0 0 0 65535 ECU_ADDRESS 0x400DF9BE /end MEASUREMENT
/begin MEASUREMENT MCore_rb_SipF_ProcessImage.Cat50[50].highRes.IrmsSqFiltered.data_32 "" ULONG NO_COMPU_METHOD 0 0 0 4294967295 ECU_ADDRESS 0x400DF9BC /end MEASUREMENT
/begin MEASUREMENT MCore_rb_SipF_ProcessImage.Cat50[50].processed "" UWORD NO_COMPU_METHOD 0 0 0 65535 ECU_ADDRESS 0x400DF9C4 /end MEASUREMENT
/begin MEASUREMENT MCore_rb_SipF_ProcessImage.Cat50[50].snapshot "" UWORD NO_COMPU_METHOD 0 0 0 65535 ECU_ADDRESS 0x400DF9B4 /end MEASUREMENT
/begin MEASUREMENT MCore_rb_SipF_ProcessImage.Cat50[50].snapshotDuty "" UWORD NO_COMPU_METHOD 0 0 0 65535 ECU_ADDRESS 0x400DF9B6 /end MEASUREMENT
/begin MEASUREMENT MCore_rb_SipF_ProcessImage.Cat50[50].snapshotErrorValue "" UBYTE NO_COMPU_METHOD 0 0 0 1 BIT_MASK 0x1 ECU_ADDRESS 0x400DF9B8 /end MEASUREMENT
/begin MEASUREMENT MCore_rb_SipF_ProcessImage.Cat50[50].snapshotPeriod "" UWORD NO_COMPU_METHOD 0 0 0 65535 ECU_ADDRESS 0x400DF9B8 /end MEASUREMENT
/begin MEASUREMENT MCore_rb_SipF_ProcessImage.Cat50[50].snapshotReserved "" UBYTE NO_COMPU_METHOD 0 0 0 63 BIT_MASK 0xfc ECU_ADDRESS 0x400DF9B8 /end MEASUREMENT
/begin MEASUREMENT MCore_rb_SipF_ProcessImage.Cat50[50].snapshotSbmValue "" UBYTE NO_COMPU_METHOD 0 0 0 1 BIT_MASK 0x2 ECU_ADDRESS 0x400DF9B8 /end MEASUREMENT
/begin MEASUREMENT MCore_rb_SipF_ProcessImage.Cat50[50].switches "" UBYTE NO_COMPU_METHOD 0 0 0 255 ECU_ADDRESS 0x400DF9C8 /end MEASUREMENT
/begin MEASUREMENT MCore_rb_SipF_ProcessImage.Cat50[50].switches.mcalInputDisconnect "" SBYTE rb_SipF_ProcessImage.Cat50[50].switches.mcalInputDisconnect.CONVERSION 0 0 -128 127 ECU_ADDRESS 0x400DF9C8 /end MEASUREMENT
/begin MEASUREMENT MCore_rb_SipF_ProcessImage.Cat50[50].switches.sipfInputDisconnect "" SBYTE rb_SipF_ProcessImage.Cat50[50].switches.sipfInputDisconnect.CONVERSION 0 0 -128 127 ECU_ADDRESS 0x400DF9C9 /end MEASUREMENT
/begin MEASUREMENT MCore_rb_SipF_ProcessImage.Cat50[51].highRes "" UBYTE NO_COMPU_METHOD 0 0 0 255 ECU_ADDRESS 0x400DF9D4 /end MEASUREMENT
/begin MEASUREMENT MCore_rb_SipF_ProcessImage.Cat50[51].highRes.IrmsSq "" UWORD NO_COMPU_METHOD 0 0 0 65535 ECU_ADDRESS 0x400DF9D8 /end MEASUREMENT
/begin MEASUREMENT MCore_rb_SipF_ProcessImage.Cat50[51].highRes.IrmsSqFiltered "" UBYTE NO_COMPU_METHOD 0 0 0 255 ECU_ADDRESS 0x400DF9D4 /end MEASUREMENT
/begin MEASUREMENT MCore_rb_SipF_ProcessImage.Cat50[51].highRes.IrmsSqFiltered.B "" UBYTE NO_COMPU_METHOD 0 0 0 255 ECU_ADDRESS 0x400DF9D4 /end MEASUREMENT
/begin MEASUREMENT MCore_rb_SipF_ProcessImage.Cat50[51].highRes.IrmsSqFiltered.B.high_16 "" UWORD NO_COMPU_METHOD 0 0 0 65535 ECU_ADDRESS 0x400DF9D4 /end MEASUREMENT
/begin MEASUREMENT MCore_rb_SipF_ProcessImage.Cat50[51].highRes.IrmsSqFiltered.B.low_16 "" UWORD NO_COMPU_METHOD 0 0 0 65535 ECU_ADDRESS 0x400DF9D6 /end MEASUREMENT
/begin MEASUREMENT MCore_rb_SipF_ProcessImage.Cat50[51].highRes.IrmsSqFiltered.data_32 "" ULONG NO_COMPU_METHOD 0 0 0 4294967295 ECU_ADDRESS 0x400DF9D4 /end MEASUREMENT
/begin MEASUREMENT MCore_rb_SipF_ProcessImage.Cat50[51].processed "" UWORD NO_COMPU_METHOD 0 0 0 65535 ECU_ADDRESS 0x400DF9DC /end MEASUREMENT
/begin MEASUREMENT MCore_rb_SipF_ProcessImage.Cat50[51].snapshot "" UWORD NO_COMPU_METHOD 0 0 0 65535 ECU_ADDRESS 0x400DF9CC /end MEASUREMENT
/begin MEASUREMENT MCore_rb_SipF_ProcessImage.Cat50[51].snapshotDuty "" UWORD NO_COMPU_METHOD 0 0 0 65535 ECU_ADDRESS 0x400DF9CE /end MEASUREMENT
/begin MEASUREMENT MCore_rb_SipF_ProcessImage.Cat50[51].snapshotErrorValue "" UBYTE NO_COMPU_METHOD 0 0 0 1 BIT_MASK 0x1 ECU_ADDRESS 0x400DF9D0 /end MEASUREMENT
/begin MEASUREMENT MCore_rb_SipF_ProcessImage.Cat50[51].snapshotPeriod "" UWORD NO_COMPU_METHOD 0 0 0 65535 ECU_ADDRESS 0x400DF9D0 /end MEASUREMENT
/begin MEASUREMENT MCore_rb_SipF_ProcessImage.Cat50[51].snapshotReserved "" UBYTE NO_COMPU_METHOD 0 0 0 63 BIT_MASK 0xfc ECU_ADDRESS 0x400DF9D0 /end MEASUREMENT
/begin MEASUREMENT MCore_rb_SipF_ProcessImage.Cat50[51].snapshotSbmValue "" UBYTE NO_COMPU_METHOD 0 0 0 1 BIT_MASK 0x2 ECU_ADDRESS 0x400DF9D0 /end MEASUREMENT
/begin MEASUREMENT MCore_rb_SipF_ProcessImage.Cat50[51].switches "" UBYTE NO_COMPU_METHOD 0 0 0 255 ECU_ADDRESS 0x400DF9E0 /end MEASUREMENT
/begin MEASUREMENT MCore_rb_SipF_ProcessImage.Cat50[51].switches.mcalInputDisconnect "" SBYTE rb_SipF_ProcessImage.Cat50[51].switches.mcalInputDisconnect.CONVERSION 0 0 -128 127 ECU_ADDRESS 0x400DF9E0 /end MEASUREMENT
/begin MEASUREMENT MCore_rb_SipF_ProcessImage.Cat50[51].switches.sipfInputDisconnect "" SBYTE rb_SipF_ProcessImage.Cat50[51].switches.sipfInputDisconnect.CONVERSION 0 0 -128 127 ECU_ADDRESS 0x400DF9E1 /end MEASUREMENT
/begin MEASUREMENT MCore_rb_SipF_ProcessImage.Cat50[52].highRes "" UBYTE NO_COMPU_METHOD 0 0 0 255 ECU_ADDRESS 0x400DF9EC /end MEASUREMENT
/begin MEASUREMENT MCore_rb_SipF_ProcessImage.Cat50[52].highRes.IrmsSq "" UWORD NO_COMPU_METHOD 0 0 0 65535 ECU_ADDRESS 0x400DF9F0 /end MEASUREMENT
/begin MEASUREMENT MCore_rb_SipF_ProcessImage.Cat50[52].highRes.IrmsSqFiltered "" UBYTE NO_COMPU_METHOD 0 0 0 255 ECU_ADDRESS 0x400DF9EC /end MEASUREMENT
/begin MEASUREMENT MCore_rb_SipF_ProcessImage.Cat50[52].highRes.IrmsSqFiltered.B "" UBYTE NO_COMPU_METHOD 0 0 0 255 ECU_ADDRESS 0x400DF9EC /end MEASUREMENT
/begin MEASUREMENT MCore_rb_SipF_ProcessImage.Cat50[52].highRes.IrmsSqFiltered.B.high_16 "" UWORD NO_COMPU_METHOD 0 0 0 65535 ECU_ADDRESS 0x400DF9EC /end MEASUREMENT
/begin MEASUREMENT MCore_rb_SipF_ProcessImage.Cat50[52].highRes.IrmsSqFiltered.B.low_16 "" UWORD NO_COMPU_METHOD 0 0 0 65535 ECU_ADDRESS 0x400DF9EE /end MEASUREMENT
/begin MEASUREMENT MCore_rb_SipF_ProcessImage.Cat50[52].highRes.IrmsSqFiltered.data_32 "" ULONG NO_COMPU_METHOD 0 0 0 4294967295 ECU_ADDRESS 0x400DF9EC /end MEASUREMENT
/begin MEASUREMENT MCore_rb_SipF_ProcessImage.Cat50[52].processed "" UWORD NO_COMPU_METHOD 0 0 0 65535 ECU_ADDRESS 0x400DF9F4 /end MEASUREMENT
/begin MEASUREMENT MCore_rb_SipF_ProcessImage.Cat50[52].snapshot "" UWORD NO_COMPU_METHOD 0 0 0 65535 ECU_ADDRESS 0x400DF9E4 /end MEASUREMENT
/begin MEASUREMENT MCore_rb_SipF_ProcessImage.Cat50[52].snapshotDuty "" UWORD NO_COMPU_METHOD 0 0 0 65535 ECU_ADDRESS 0x400DF9E6 /end MEASUREMENT
/begin MEASUREMENT MCore_rb_SipF_ProcessImage.Cat50[52].snapshotErrorValue "" UBYTE NO_COMPU_METHOD 0 0 0 1 BIT_MASK 0x1 ECU_ADDRESS 0x400DF9E8 /end MEASUREMENT
/begin MEASUREMENT MCore_rb_SipF_ProcessImage.Cat50[52].snapshotPeriod "" UWORD NO_COMPU_METHOD 0 0 0 65535 ECU_ADDRESS 0x400DF9E8 /end MEASUREMENT
/begin MEASUREMENT MCore_rb_SipF_ProcessImage.Cat50[52].snapshotReserved "" UBYTE NO_COMPU_METHOD 0 0 0 63 BIT_MASK 0xfc ECU_ADDRESS 0x400DF9E8 /end MEASUREMENT
/begin MEASUREMENT MCore_rb_SipF_ProcessImage.Cat50[52].snapshotSbmValue "" UBYTE NO_COMPU_METHOD 0 0 0 1 BIT_MASK 0x2 ECU_ADDRESS 0x400DF9E8 /end MEASUREMENT
/begin MEASUREMENT MCore_rb_SipF_ProcessImage.Cat50[52].switches "" UBYTE NO_COMPU_METHOD 0 0 0 255 ECU_ADDRESS 0x400DF9F8 /end MEASUREMENT
/begin MEASUREMENT MCore_rb_SipF_ProcessImage.Cat50[52].switches.mcalInputDisconnect "" SBYTE rb_SipF_ProcessImage.Cat50[52].switches.mcalInputDisconnect.CONVERSION 0 0 -128 127 ECU_ADDRESS 0x400DF9F8 /end MEASUREMENT
/begin MEASUREMENT MCore_rb_SipF_ProcessImage.Cat50[52].switches.sipfInputDisconnect "" SBYTE rb_SipF_ProcessImage.Cat50[52].switches.sipfInputDisconnect.CONVERSION 0 0 -128 127 ECU_ADDRESS 0x400DF9F9 /end MEASUREMENT
/begin MEASUREMENT MCore_rb_SipF_ProcessImage.Cat50[53].highRes "" UBYTE NO_COMPU_METHOD 0 0 0 255 ECU_ADDRESS 0x400DFA04 /end MEASUREMENT
/begin MEASUREMENT MCore_rb_SipF_ProcessImage.Cat50[53].highRes.IrmsSq "" UWORD NO_COMPU_METHOD 0 0 0 65535 ECU_ADDRESS 0x400DFA08 /end MEASUREMENT
/begin MEASUREMENT MCore_rb_SipF_ProcessImage.Cat50[53].highRes.IrmsSqFiltered "" UBYTE NO_COMPU_METHOD 0 0 0 255 ECU_ADDRESS 0x400DFA04 /end MEASUREMENT
/begin MEASUREMENT MCore_rb_SipF_ProcessImage.Cat50[53].highRes.IrmsSqFiltered.B "" UBYTE NO_COMPU_METHOD 0 0 0 255 ECU_ADDRESS 0x400DFA04 /end MEASUREMENT
/begin MEASUREMENT MCore_rb_SipF_ProcessImage.Cat50[53].highRes.IrmsSqFiltered.B.high_16 "" UWORD NO_COMPU_METHOD 0 0 0 65535 ECU_ADDRESS 0x400DFA04 /end MEASUREMENT
/begin MEASUREMENT MCore_rb_SipF_ProcessImage.Cat50[53].highRes.IrmsSqFiltered.B.low_16 "" UWORD NO_COMPU_METHOD 0 0 0 65535 ECU_ADDRESS 0x400DFA06 /end MEASUREMENT
/begin MEASUREMENT MCore_rb_SipF_ProcessImage.Cat50[53].highRes.IrmsSqFiltered.data_32 "" ULONG NO_COMPU_METHOD 0 0 0 4294967295 ECU_ADDRESS 0x400DFA04 /end MEASUREMENT
/begin MEASUREMENT MCore_rb_SipF_ProcessImage.Cat50[53].processed "" UWORD NO_COMPU_METHOD 0 0 0 65535 ECU_ADDRESS 0x400DFA0C /end MEASUREMENT
/begin MEASUREMENT MCore_rb_SipF_ProcessImage.Cat50[53].snapshot "" UWORD NO_COMPU_METHOD 0 0 0 65535 ECU_ADDRESS 0x400DF9FC /end MEASUREMENT
/begin MEASUREMENT MCore_rb_SipF_ProcessImage.Cat50[53].snapshotDuty "" UWORD NO_COMPU_METHOD 0 0 0 65535 ECU_ADDRESS 0x400DF9FE /end MEASUREMENT
/begin MEASUREMENT MCore_rb_SipF_ProcessImage.Cat50[53].snapshotErrorValue "" UBYTE NO_COMPU_METHOD 0 0 0 1 BIT_MASK 0x1 ECU_ADDRESS 0x400DFA00 /end MEASUREMENT
/begin MEASUREMENT MCore_rb_SipF_ProcessImage.Cat50[53].snapshotPeriod "" UWORD NO_COMPU_METHOD 0 0 0 65535 ECU_ADDRESS 0x400DFA00 /end MEASUREMENT
/begin MEASUREMENT MCore_rb_SipF_ProcessImage.Cat50[53].snapshotReserved "" UBYTE NO_COMPU_METHOD 0 0 0 63 BIT_MASK 0xfc ECU_ADDRESS 0x400DFA00 /end MEASUREMENT
/begin MEASUREMENT MCore_rb_SipF_ProcessImage.Cat50[53].snapshotSbmValue "" UBYTE NO_COMPU_METHOD 0 0 0 1 BIT_MASK 0x2 ECU_ADDRESS 0x400DFA00 /end MEASUREMENT
/begin MEASUREMENT MCore_rb_SipF_ProcessImage.Cat50[53].switches "" UBYTE NO_COMPU_METHOD 0 0 0 255 ECU_ADDRESS 0x400DFA10 /end MEASUREMENT
/begin MEASUREMENT MCore_rb_SipF_ProcessImage.Cat50[53].switches.mcalInputDisconnect "" SBYTE rb_SipF_ProcessImage.Cat50[53].switches.mcalInputDisconnect.CONVERSION 0 0 -128 127 ECU_ADDRESS 0x400DFA10 /end MEASUREMENT
/begin MEASUREMENT MCore_rb_SipF_ProcessImage.Cat50[53].switches.sipfInputDisconnect "" SBYTE rb_SipF_ProcessImage.Cat50[53].switches.sipfInputDisconnect.CONVERSION 0 0 -128 127 ECU_ADDRESS 0x400DFA11 /end MEASUREMENT
/begin MEASUREMENT MCore_rb_SipF_ProcessImage.Cat50[54].highRes "" UBYTE NO_COMPU_METHOD 0 0 0 255 ECU_ADDRESS 0x400DFA1C /end MEASUREMENT
/begin MEASUREMENT MCore_rb_SipF_ProcessImage.Cat50[54].highRes.IrmsSq "" UWORD NO_COMPU_METHOD 0 0 0 65535 ECU_ADDRESS 0x400DFA20 /end MEASUREMENT
/begin MEASUREMENT MCore_rb_SipF_ProcessImage.Cat50[54].highRes.IrmsSqFiltered "" UBYTE NO_COMPU_METHOD 0 0 0 255 ECU_ADDRESS 0x400DFA1C /end MEASUREMENT
/begin MEASUREMENT MCore_rb_SipF_ProcessImage.Cat50[54].highRes.IrmsSqFiltered.B "" UBYTE NO_COMPU_METHOD 0 0 0 255 ECU_ADDRESS 0x400DFA1C /end MEASUREMENT
/begin MEASUREMENT MCore_rb_SipF_ProcessImage.Cat50[54].highRes.IrmsSqFiltered.B.high_16 "" UWORD NO_COMPU_METHOD 0 0 0 65535 ECU_ADDRESS 0x400DFA1C /end MEASUREMENT
/begin MEASUREMENT MCore_rb_SipF_ProcessImage.Cat50[54].highRes.IrmsSqFiltered.B.low_16 "" UWORD NO_COMPU_METHOD 0 0 0 65535 ECU_ADDRESS 0x400DFA1E /end MEASUREMENT
/begin MEASUREMENT MCore_rb_SipF_ProcessImage.Cat50[54].highRes.IrmsSqFiltered.data_32 "" ULONG NO_COMPU_METHOD 0 0 0 4294967295 ECU_ADDRESS 0x400DFA1C /end MEASUREMENT
/begin MEASUREMENT MCore_rb_SipF_ProcessImage.Cat50[54].processed "" UWORD NO_COMPU_METHOD 0 0 0 65535 ECU_ADDRESS 0x400DFA24 /end MEASUREMENT
/begin MEASUREMENT MCore_rb_SipF_ProcessImage.Cat50[54].snapshot "" UWORD NO_COMPU_METHOD 0 0 0 65535 ECU_ADDRESS 0x400DFA14 /end MEASUREMENT
/begin MEASUREMENT MCore_rb_SipF_ProcessImage.Cat50[54].snapshotDuty "" UWORD NO_COMPU_METHOD 0 0 0 65535 ECU_ADDRESS 0x400DFA16 /end MEASUREMENT
/begin MEASUREMENT MCore_rb_SipF_ProcessImage.Cat50[54].snapshotErrorValue "" UBYTE NO_COMPU_METHOD 0 0 0 1 BIT_MASK 0x1 ECU_ADDRESS 0x400DFA18 /end MEASUREMENT
/begin MEASUREMENT MCore_rb_SipF_ProcessImage.Cat50[54].snapshotPeriod "" UWORD NO_COMPU_METHOD 0 0 0 65535 ECU_ADDRESS 0x400DFA18 /end MEASUREMENT
/begin MEASUREMENT MCore_rb_SipF_ProcessImage.Cat50[54].snapshotReserved "" UBYTE NO_COMPU_METHOD 0 0 0 63 BIT_MASK 0xfc ECU_ADDRESS 0x400DFA18 /end MEASUREMENT
/begin MEASUREMENT MCore_rb_SipF_ProcessImage.Cat50[54].snapshotSbmValue "" UBYTE NO_COMPU_METHOD 0 0 0 1 BIT_MASK 0x2 ECU_ADDRESS 0x400DFA18 /end MEASUREMENT
/begin MEASUREMENT MCore_rb_SipF_ProcessImage.Cat50[54].switches "" UBYTE NO_COMPU_METHOD 0 0 0 255 ECU_ADDRESS 0x400DFA28 /end MEASUREMENT
/begin MEASUREMENT MCore_rb_SipF_ProcessImage.Cat50[54].switches.mcalInputDisconnect "" SBYTE rb_SipF_ProcessImage.Cat50[54].switches.mcalInputDisconnect.CONVERSION 0 0 -128 127 ECU_ADDRESS 0x400DFA28 /end MEASUREMENT
/begin MEASUREMENT MCore_rb_SipF_ProcessImage.Cat50[54].switches.sipfInputDisconnect "" SBYTE rb_SipF_ProcessImage.Cat50[54].switches.sipfInputDisconnect.CONVERSION 0 0 -128 127 ECU_ADDRESS 0x400DFA29 /end MEASUREMENT
/begin MEASUREMENT MCore_rb_SipF_ProcessImage.Cat50[55].highRes "" UBYTE NO_COMPU_METHOD 0 0 0 255 ECU_ADDRESS 0x400DFA34 /end MEASUREMENT
/begin MEASUREMENT MCore_rb_SipF_ProcessImage.Cat50[55].highRes.IrmsSq "" UWORD NO_COMPU_METHOD 0 0 0 65535 ECU_ADDRESS 0x400DFA38 /end MEASUREMENT
/begin MEASUREMENT MCore_rb_SipF_ProcessImage.Cat50[55].highRes.IrmsSqFiltered "" UBYTE NO_COMPU_METHOD 0 0 0 255 ECU_ADDRESS 0x400DFA34 /end MEASUREMENT
/begin MEASUREMENT MCore_rb_SipF_ProcessImage.Cat50[55].highRes.IrmsSqFiltered.B "" UBYTE NO_COMPU_METHOD 0 0 0 255 ECU_ADDRESS 0x400DFA34 /end MEASUREMENT
/begin MEASUREMENT MCore_rb_SipF_ProcessImage.Cat50[55].highRes.IrmsSqFiltered.B.high_16 "" UWORD NO_COMPU_METHOD 0 0 0 65535 ECU_ADDRESS 0x400DFA34 /end MEASUREMENT
/begin MEASUREMENT MCore_rb_SipF_ProcessImage.Cat50[55].highRes.IrmsSqFiltered.B.low_16 "" UWORD NO_COMPU_METHOD 0 0 0 65535 ECU_ADDRESS 0x400DFA36 /end MEASUREMENT
/begin MEASUREMENT MCore_rb_SipF_ProcessImage.Cat50[55].highRes.IrmsSqFiltered.data_32 "" ULONG NO_COMPU_METHOD 0 0 0 4294967295 ECU_ADDRESS 0x400DFA34 /end MEASUREMENT
/begin MEASUREMENT MCore_rb_SipF_ProcessImage.Cat50[55].processed "" UWORD NO_COMPU_METHOD 0 0 0 65535 ECU_ADDRESS 0x400DFA3C /end MEASUREMENT
/begin MEASUREMENT MCore_rb_SipF_ProcessImage.Cat50[55].snapshot "" UWORD NO_COMPU_METHOD 0 0 0 65535 ECU_ADDRESS 0x400DFA2C /end MEASUREMENT
/begin MEASUREMENT MCore_rb_SipF_ProcessImage.Cat50[55].snapshotDuty "" UWORD NO_COMPU_METHOD 0 0 0 65535 ECU_ADDRESS 0x400DFA2E /end MEASUREMENT
/begin MEASUREMENT MCore_rb_SipF_ProcessImage.Cat50[55].snapshotErrorValue "" UBYTE NO_COMPU_METHOD 0 0 0 1 BIT_MASK 0x1 ECU_ADDRESS 0x400DFA30 /end MEASUREMENT
/begin MEASUREMENT MCore_rb_SipF_ProcessImage.Cat50[55].snapshotPeriod "" UWORD NO_COMPU_METHOD 0 0 0 65535 ECU_ADDRESS 0x400DFA30 /end MEASUREMENT
/begin MEASUREMENT MCore_rb_SipF_ProcessImage.Cat50[55].snapshotReserved "" UBYTE NO_COMPU_METHOD 0 0 0 63 BIT_MASK 0xfc ECU_ADDRESS 0x400DFA30 /end MEASUREMENT
/begin MEASUREMENT MCore_rb_SipF_ProcessImage.Cat50[55].snapshotSbmValue "" UBYTE NO_COMPU_METHOD 0 0 0 1 BIT_MASK 0x2 ECU_ADDRESS 0x400DFA30 /end MEASUREMENT
/begin MEASUREMENT MCore_rb_SipF_ProcessImage.Cat50[55].switches "" UBYTE NO_COMPU_METHOD 0 0 0 255 ECU_ADDRESS 0x400DFA40 /end MEASUREMENT
/begin MEASUREMENT MCore_rb_SipF_ProcessImage.Cat50[55].switches.mcalInputDisconnect "" SBYTE rb_SipF_ProcessImage.Cat50[55].switches.mcalInputDisconnect.CONVERSION 0 0 -128 127 ECU_ADDRESS 0x400DFA40 /end MEASUREMENT
/begin MEASUREMENT MCore_rb_SipF_ProcessImage.Cat50[55].switches.sipfInputDisconnect "" SBYTE rb_SipF_ProcessImage.Cat50[55].switches.sipfInputDisconnect.CONVERSION 0 0 -128 127 ECU_ADDRESS 0x400DFA41 /end MEASUREMENT
/begin MEASUREMENT MCore_rb_SipF_ProcessImage.Cat50[56].highRes "" UBYTE NO_COMPU_METHOD 0 0 0 255 ECU_ADDRESS 0x400DFA4C /end MEASUREMENT
/begin MEASUREMENT MCore_rb_SipF_ProcessImage.Cat50[56].highRes.IrmsSq "" UWORD NO_COMPU_METHOD 0 0 0 65535 ECU_ADDRESS 0x400DFA50 /end MEASUREMENT
/begin MEASUREMENT MCore_rb_SipF_ProcessImage.Cat50[56].highRes.IrmsSqFiltered "" UBYTE NO_COMPU_METHOD 0 0 0 255 ECU_ADDRESS 0x400DFA4C /end MEASUREMENT
/begin MEASUREMENT MCore_rb_SipF_ProcessImage.Cat50[56].highRes.IrmsSqFiltered.B "" UBYTE NO_COMPU_METHOD 0 0 0 255 ECU_ADDRESS 0x400DFA4C /end MEASUREMENT
/begin MEASUREMENT MCore_rb_SipF_ProcessImage.Cat50[56].highRes.IrmsSqFiltered.B.high_16 "" UWORD NO_COMPU_METHOD 0 0 0 65535 ECU_ADDRESS 0x400DFA4C /end MEASUREMENT
/begin MEASUREMENT MCore_rb_SipF_ProcessImage.Cat50[56].highRes.IrmsSqFiltered.B.low_16 "" UWORD NO_COMPU_METHOD 0 0 0 65535 ECU_ADDRESS 0x400DFA4E /end MEASUREMENT
/begin MEASUREMENT MCore_rb_SipF_ProcessImage.Cat50[56].highRes.IrmsSqFiltered.data_32 "" ULONG NO_COMPU_METHOD 0 0 0 4294967295 ECU_ADDRESS 0x400DFA4C /end MEASUREMENT
/begin MEASUREMENT MCore_rb_SipF_ProcessImage.Cat50[56].processed "" UWORD NO_COMPU_METHOD 0 0 0 65535 ECU_ADDRESS 0x400DFA54 /end MEASUREMENT
/begin MEASUREMENT MCore_rb_SipF_ProcessImage.Cat50[56].snapshot "" UWORD NO_COMPU_METHOD 0 0 0 65535 ECU_ADDRESS 0x400DFA44 /end MEASUREMENT
/begin MEASUREMENT MCore_rb_SipF_ProcessImage.Cat50[56].snapshotDuty "" UWORD NO_COMPU_METHOD 0 0 0 65535 ECU_ADDRESS 0x400DFA46 /end MEASUREMENT
/begin MEASUREMENT MCore_rb_SipF_ProcessImage.Cat50[56].snapshotErrorValue "" UBYTE NO_COMPU_METHOD 0 0 0 1 BIT_MASK 0x1 ECU_ADDRESS 0x400DFA48 /end MEASUREMENT
/begin MEASUREMENT MCore_rb_SipF_ProcessImage.Cat50[56].snapshotPeriod "" UWORD NO_COMPU_METHOD 0 0 0 65535 ECU_ADDRESS 0x400DFA48 /end MEASUREMENT
/begin MEASUREMENT MCore_rb_SipF_ProcessImage.Cat50[56].snapshotReserved "" UBYTE NO_COMPU_METHOD 0 0 0 63 BIT_MASK 0xfc ECU_ADDRESS 0x400DFA48 /end MEASUREMENT
/begin MEASUREMENT MCore_rb_SipF_ProcessImage.Cat50[56].snapshotSbmValue "" UBYTE NO_COMPU_METHOD 0 0 0 1 BIT_MASK 0x2 ECU_ADDRESS 0x400DFA48 /end MEASUREMENT
/begin MEASUREMENT MCore_rb_SipF_ProcessImage.Cat50[56].switches "" UBYTE NO_COMPU_METHOD 0 0 0 255 ECU_ADDRESS 0x400DFA58 /end MEASUREMENT
/begin MEASUREMENT MCore_rb_SipF_ProcessImage.Cat50[56].switches.mcalInputDisconnect "" SBYTE rb_SipF_ProcessImage.Cat50[56].switches.mcalInputDisconnect.CONVERSION 0 0 -128 127 ECU_ADDRESS 0x400DFA58 /end MEASUREMENT
/begin MEASUREMENT MCore_rb_SipF_ProcessImage.Cat50[56].switches.sipfInputDisconnect "" SBYTE rb_SipF_ProcessImage.Cat50[56].switches.sipfInputDisconnect.CONVERSION 0 0 -128 127 ECU_ADDRESS 0x400DFA59 /end MEASUREMENT
/begin MEASUREMENT MCore_rb_SipF_ProcessImage.Cat50[57].highRes "" UBYTE NO_COMPU_METHOD 0 0 0 255 ECU_ADDRESS 0x400DFA64 /end MEASUREMENT
/begin MEASUREMENT MCore_rb_SipF_ProcessImage.Cat50[57].highRes.IrmsSq "" UWORD NO_COMPU_METHOD 0 0 0 65535 ECU_ADDRESS 0x400DFA68 /end MEASUREMENT
/begin MEASUREMENT MCore_rb_SipF_ProcessImage.Cat50[57].highRes.IrmsSqFiltered "" UBYTE NO_COMPU_METHOD 0 0 0 255 ECU_ADDRESS 0x400DFA64 /end MEASUREMENT
/begin MEASUREMENT MCore_rb_SipF_ProcessImage.Cat50[57].highRes.IrmsSqFiltered.B "" UBYTE NO_COMPU_METHOD 0 0 0 255 ECU_ADDRESS 0x400DFA64 /end MEASUREMENT
/begin MEASUREMENT MCore_rb_SipF_ProcessImage.Cat50[57].highRes.IrmsSqFiltered.B.high_16 "" UWORD NO_COMPU_METHOD 0 0 0 65535 ECU_ADDRESS 0x400DFA64 /end MEASUREMENT
/begin MEASUREMENT MCore_rb_SipF_ProcessImage.Cat50[57].highRes.IrmsSqFiltered.B.low_16 "" UWORD NO_COMPU_METHOD 0 0 0 65535 ECU_ADDRESS 0x400DFA66 /end MEASUREMENT
/begin MEASUREMENT MCore_rb_SipF_ProcessImage.Cat50[57].highRes.IrmsSqFiltered.data_32 "" ULONG NO_COMPU_METHOD 0 0 0 4294967295 ECU_ADDRESS 0x400DFA64 /end MEASUREMENT
/begin MEASUREMENT MCore_rb_SipF_ProcessImage.Cat50[57].processed "" UWORD NO_COMPU_METHOD 0 0 0 65535 ECU_ADDRESS 0x400DFA6C /end MEASUREMENT
/begin MEASUREMENT MCore_rb_SipF_ProcessImage.Cat50[57].snapshot "" UWORD NO_COMPU_METHOD 0 0 0 65535 ECU_ADDRESS 0x400DFA5C /end MEASUREMENT
/begin MEASUREMENT MCore_rb_SipF_ProcessImage.Cat50[57].snapshotDuty "" UWORD NO_COMPU_METHOD 0 0 0 65535 ECU_ADDRESS 0x400DFA5E /end MEASUREMENT
/begin MEASUREMENT MCore_rb_SipF_ProcessImage.Cat50[57].snapshotErrorValue "" UBYTE NO_COMPU_METHOD 0 0 0 1 BIT_MASK 0x1 ECU_ADDRESS 0x400DFA60 /end MEASUREMENT
/begin MEASUREMENT MCore_rb_SipF_ProcessImage.Cat50[57].snapshotPeriod "" UWORD NO_COMPU_METHOD 0 0 0 65535 ECU_ADDRESS 0x400DFA60 /end MEASUREMENT
/begin MEASUREMENT MCore_rb_SipF_ProcessImage.Cat50[57].snapshotReserved "" UBYTE NO_COMPU_METHOD 0 0 0 63 BIT_MASK 0xfc ECU_ADDRESS 0x400DFA60 /end MEASUREMENT
/begin MEASUREMENT MCore_rb_SipF_ProcessImage.Cat50[57].snapshotSbmValue "" UBYTE NO_COMPU_METHOD 0 0 0 1 BIT_MASK 0x2 ECU_ADDRESS 0x400DFA60 /end MEASUREMENT
/begin MEASUREMENT MCore_rb_SipF_ProcessImage.Cat50[57].switches "" UBYTE NO_COMPU_METHOD 0 0 0 255 ECU_ADDRESS 0x400DFA70 /end MEASUREMENT
/begin MEASUREMENT MCore_rb_SipF_ProcessImage.Cat50[57].switches.mcalInputDisconnect "" SBYTE rb_SipF_ProcessImage.Cat50[57].switches.mcalInputDisconnect.CONVERSION 0 0 -128 127 ECU_ADDRESS 0x400DFA70 /end MEASUREMENT
/begin MEASUREMENT MCore_rb_SipF_ProcessImage.Cat50[57].switches.sipfInputDisconnect "" SBYTE rb_SipF_ProcessImage.Cat50[57].switches.sipfInputDisconnect.CONVERSION 0 0 -128 127 ECU_ADDRESS 0x400DFA71 /end MEASUREMENT
/begin MEASUREMENT MCore_rb_SipF_ProcessImage.Cat50[58].highRes "" UBYTE NO_COMPU_METHOD 0 0 0 255 ECU_ADDRESS 0x400DFA7C /end MEASUREMENT
/begin MEASUREMENT MCore_rb_SipF_ProcessImage.Cat50[58].highRes.IrmsSq "" UWORD NO_COMPU_METHOD 0 0 0 65535 ECU_ADDRESS 0x400DFA80 /end MEASUREMENT
/begin MEASUREMENT MCore_rb_SipF_ProcessImage.Cat50[58].highRes.IrmsSqFiltered "" UBYTE NO_COMPU_METHOD 0 0 0 255 ECU_ADDRESS 0x400DFA7C /end MEASUREMENT
/begin MEASUREMENT MCore_rb_SipF_ProcessImage.Cat50[58].highRes.IrmsSqFiltered.B "" UBYTE NO_COMPU_METHOD 0 0 0 255 ECU_ADDRESS 0x400DFA7C /end MEASUREMENT
/begin MEASUREMENT MCore_rb_SipF_ProcessImage.Cat50[58].highRes.IrmsSqFiltered.B.high_16 "" UWORD NO_COMPU_METHOD 0 0 0 65535 ECU_ADDRESS 0x400DFA7C /end MEASUREMENT
/begin MEASUREMENT MCore_rb_SipF_ProcessImage.Cat50[58].highRes.IrmsSqFiltered.B.low_16 "" UWORD NO_COMPU_METHOD 0 0 0 65535 ECU_ADDRESS 0x400DFA7E /end MEASUREMENT
/begin MEASUREMENT MCore_rb_SipF_ProcessImage.Cat50[58].highRes.IrmsSqFiltered.data_32 "" ULONG NO_COMPU_METHOD 0 0 0 4294967295 ECU_ADDRESS 0x400DFA7C /end MEASUREMENT
/begin MEASUREMENT MCore_rb_SipF_ProcessImage.Cat50[58].processed "" UWORD NO_COMPU_METHOD 0 0 0 65535 ECU_ADDRESS 0x400DFA84 /end MEASUREMENT
/begin MEASUREMENT MCore_rb_SipF_ProcessImage.Cat50[58].snapshot "" UWORD NO_COMPU_METHOD 0 0 0 65535 ECU_ADDRESS 0x400DFA74 /end MEASUREMENT
/begin MEASUREMENT MCore_rb_SipF_ProcessImage.Cat50[58].snapshotDuty "" UWORD NO_COMPU_METHOD 0 0 0 65535 ECU_ADDRESS 0x400DFA76 /end MEASUREMENT
/begin MEASUREMENT MCore_rb_SipF_ProcessImage.Cat50[58].snapshotErrorValue "" UBYTE NO_COMPU_METHOD 0 0 0 1 BIT_MASK 0x1 ECU_ADDRESS 0x400DFA78 /end MEASUREMENT
/begin MEASUREMENT MCore_rb_SipF_ProcessImage.Cat50[58].snapshotPeriod "" UWORD NO_COMPU_METHOD 0 0 0 65535 ECU_ADDRESS 0x400DFA78 /end MEASUREMENT
/begin MEASUREMENT MCore_rb_SipF_ProcessImage.Cat50[58].snapshotReserved "" UBYTE NO_COMPU_METHOD 0 0 0 63 BIT_MASK 0xfc ECU_ADDRESS 0x400DFA78 /end MEASUREMENT
/begin MEASUREMENT MCore_rb_SipF_ProcessImage.Cat50[58].snapshotSbmValue "" UBYTE NO_COMPU_METHOD 0 0 0 1 BIT_MASK 0x2 ECU_ADDRESS 0x400DFA78 /end MEASUREMENT
/begin MEASUREMENT MCore_rb_SipF_ProcessImage.Cat50[58].switches "" UBYTE NO_COMPU_METHOD 0 0 0 255 ECU_ADDRESS 0x400DFA88 /end MEASUREMENT
/begin MEASUREMENT MCore_rb_SipF_ProcessImage.Cat50[58].switches.mcalInputDisconnect "" SBYTE rb_SipF_ProcessImage.Cat50[58].switches.mcalInputDisconnect.CONVERSION 0 0 -128 127 ECU_ADDRESS 0x400DFA88 /end MEASUREMENT
/begin MEASUREMENT MCore_rb_SipF_ProcessImage.Cat50[58].switches.sipfInputDisconnect "" SBYTE rb_SipF_ProcessImage.Cat50[58].switches.sipfInputDisconnect.CONVERSION 0 0 -128 127 ECU_ADDRESS 0x400DFA89 /end MEASUREMENT
/begin MEASUREMENT MCore_rb_SipF_ProcessImage.Cat50[59].highRes "" UBYTE NO_COMPU_METHOD 0 0 0 255 ECU_ADDRESS 0x400DFA94 /end MEASUREMENT
/begin MEASUREMENT MCore_rb_SipF_ProcessImage.Cat50[59].highRes.IrmsSq "" UWORD NO_COMPU_METHOD 0 0 0 65535 ECU_ADDRESS 0x400DFA98 /end MEASUREMENT
/begin MEASUREMENT MCore_rb_SipF_ProcessImage.Cat50[59].highRes.IrmsSqFiltered "" UBYTE NO_COMPU_METHOD 0 0 0 255 ECU_ADDRESS 0x400DFA94 /end MEASUREMENT
/begin MEASUREMENT MCore_rb_SipF_ProcessImage.Cat50[59].highRes.IrmsSqFiltered.B "" UBYTE NO_COMPU_METHOD 0 0 0 255 ECU_ADDRESS 0x400DFA94 /end MEASUREMENT
/begin MEASUREMENT MCore_rb_SipF_ProcessImage.Cat50[59].highRes.IrmsSqFiltered.B.high_16 "" UWORD NO_COMPU_METHOD 0 0 0 65535 ECU_ADDRESS 0x400DFA94 /end MEASUREMENT
/begin MEASUREMENT MCore_rb_SipF_ProcessImage.Cat50[59].highRes.IrmsSqFiltered.B.low_16 "" UWORD NO_COMPU_METHOD 0 0 0 65535 ECU_ADDRESS 0x400DFA96 /end MEASUREMENT
/begin MEASUREMENT MCore_rb_SipF_ProcessImage.Cat50[59].highRes.IrmsSqFiltered.data_32 "" ULONG NO_COMPU_METHOD 0 0 0 4294967295 ECU_ADDRESS 0x400DFA94 /end MEASUREMENT
/begin MEASUREMENT MCore_rb_SipF_ProcessImage.Cat50[59].processed "" UWORD NO_COMPU_METHOD 0 0 0 65535 ECU_ADDRESS 0x400DFA9C /end MEASUREMENT
/begin MEASUREMENT MCore_rb_SipF_ProcessImage.Cat50[59].snapshot "" UWORD NO_COMPU_METHOD 0 0 0 65535 ECU_ADDRESS 0x400DFA8C /end MEASUREMENT
/begin MEASUREMENT MCore_rb_SipF_ProcessImage.Cat50[59].snapshotDuty "" UWORD NO_COMPU_METHOD 0 0 0 65535 ECU_ADDRESS 0x400DFA8E /end MEASUREMENT
/begin MEASUREMENT MCore_rb_SipF_ProcessImage.Cat50[59].snapshotErrorValue "" UBYTE NO_COMPU_METHOD 0 0 0 1 BIT_MASK 0x1 ECU_ADDRESS 0x400DFA90 /end MEASUREMENT
/begin MEASUREMENT MCore_rb_SipF_ProcessImage.Cat50[59].snapshotPeriod "" UWORD NO_COMPU_METHOD 0 0 0 65535 ECU_ADDRESS 0x400DFA90 /end MEASUREMENT
/begin MEASUREMENT MCore_rb_SipF_ProcessImage.Cat50[59].snapshotReserved "" UBYTE NO_COMPU_METHOD 0 0 0 63 BIT_MASK 0xfc ECU_ADDRESS 0x400DFA90 /end MEASUREMENT
/begin MEASUREMENT MCore_rb_SipF_ProcessImage.Cat50[59].snapshotSbmValue "" UBYTE NO_COMPU_METHOD 0 0 0 1 BIT_MASK 0x2 ECU_ADDRESS 0x400DFA90 /end MEASUREMENT
/begin MEASUREMENT MCore_rb_SipF_ProcessImage.Cat50[59].switches "" UBYTE NO_COMPU_METHOD 0 0 0 255 ECU_ADDRESS 0x400DFAA0 /end MEASUREMENT
/begin MEASUREMENT MCore_rb_SipF_ProcessImage.Cat50[59].switches.mcalInputDisconnect "" SBYTE rb_SipF_ProcessImage.Cat50[59].switches.mcalInputDisconnect.CONVERSION 0 0 -128 127 ECU_ADDRESS 0x400DFAA0 /end MEASUREMENT
/begin MEASUREMENT MCore_rb_SipF_ProcessImage.Cat50[59].switches.sipfInputDisconnect "" SBYTE rb_SipF_ProcessImage.Cat50[59].switches.sipfInputDisconnect.CONVERSION 0 0 -128 127 ECU_ADDRESS 0x400DFAA1 /end MEASUREMENT
/begin MEASUREMENT MCore_rb_SipF_ProcessImage.Cat50[5].highRes "" UBYTE NO_COMPU_METHOD 0 0 0 255 ECU_ADDRESS 0x400DF584 /end MEASUREMENT
/begin MEASUREMENT MCore_rb_SipF_ProcessImage.Cat50[5].highRes.IrmsSq "" UWORD NO_COMPU_METHOD 0 0 0 65535 ECU_ADDRESS 0x400DF588 /end MEASUREMENT
/begin MEASUREMENT MCore_rb_SipF_ProcessImage.Cat50[5].highRes.IrmsSqFiltered "" UBYTE NO_COMPU_METHOD 0 0 0 255 ECU_ADDRESS 0x400DF584 /end MEASUREMENT
/begin MEASUREMENT MCore_rb_SipF_ProcessImage.Cat50[5].highRes.IrmsSqFiltered.B "" UBYTE NO_COMPU_METHOD 0 0 0 255 ECU_ADDRESS 0x400DF584 /end MEASUREMENT
/begin MEASUREMENT MCore_rb_SipF_ProcessImage.Cat50[5].highRes.IrmsSqFiltered.B.high_16 "" UWORD NO_COMPU_METHOD 0 0 0 65535 ECU_ADDRESS 0x400DF584 /end MEASUREMENT
/begin MEASUREMENT MCore_rb_SipF_ProcessImage.Cat50[5].highRes.IrmsSqFiltered.B.low_16 "" UWORD NO_COMPU_METHOD 0 0 0 65535 ECU_ADDRESS 0x400DF586 /end MEASUREMENT
/begin MEASUREMENT MCore_rb_SipF_ProcessImage.Cat50[5].highRes.IrmsSqFiltered.data_32 "" ULONG NO_COMPU_METHOD 0 0 0 4294967295 ECU_ADDRESS 0x400DF584 /end MEASUREMENT
/begin MEASUREMENT MCore_rb_SipF_ProcessImage.Cat50[5].processed "" UWORD NO_COMPU_METHOD 0 0 0 65535 ECU_ADDRESS 0x400DF58C /end MEASUREMENT
/begin MEASUREMENT MCore_rb_SipF_ProcessImage.Cat50[5].snapshot "" UWORD NO_COMPU_METHOD 0 0 0 65535 ECU_ADDRESS 0x400DF57C /end MEASUREMENT
/begin MEASUREMENT MCore_rb_SipF_ProcessImage.Cat50[5].snapshotDuty "" UWORD NO_COMPU_METHOD 0 0 0 65535 ECU_ADDRESS 0x400DF57E /end MEASUREMENT
/begin MEASUREMENT MCore_rb_SipF_ProcessImage.Cat50[5].snapshotErrorValue "" UBYTE NO_COMPU_METHOD 0 0 0 1 BIT_MASK 0x1 ECU_ADDRESS 0x400DF580 /end MEASUREMENT
/begin MEASUREMENT MCore_rb_SipF_ProcessImage.Cat50[5].snapshotPeriod "" UWORD NO_COMPU_METHOD 0 0 0 65535 ECU_ADDRESS 0x400DF580 /end MEASUREMENT
/begin MEASUREMENT MCore_rb_SipF_ProcessImage.Cat50[5].snapshotReserved "" UBYTE NO_COMPU_METHOD 0 0 0 63 BIT_MASK 0xfc ECU_ADDRESS 0x400DF580 /end MEASUREMENT
/begin MEASUREMENT MCore_rb_SipF_ProcessImage.Cat50[5].snapshotSbmValue "" UBYTE NO_COMPU_METHOD 0 0 0 1 BIT_MASK 0x2 ECU_ADDRESS 0x400DF580 /end MEASUREMENT
/begin MEASUREMENT MCore_rb_SipF_ProcessImage.Cat50[5].switches "" UBYTE NO_COMPU_METHOD 0 0 0 255 ECU_ADDRESS 0x400DF590 /end MEASUREMENT
/begin MEASUREMENT MCore_rb_SipF_ProcessImage.Cat50[5].switches.mcalInputDisconnect "" SBYTE rb_SipF_ProcessImage.Cat50[5].switches.mcalInputDisconnect.CONVERSION 0 0 -128 127 ECU_ADDRESS 0x400DF590 /end MEASUREMENT
/begin MEASUREMENT MCore_rb_SipF_ProcessImage.Cat50[5].switches.sipfInputDisconnect "" SBYTE rb_SipF_ProcessImage.Cat50[5].switches.sipfInputDisconnect.CONVERSION 0 0 -128 127 ECU_ADDRESS 0x400DF591 /end MEASUREMENT
/begin MEASUREMENT MCore_rb_SipF_ProcessImage.Cat50[60].highRes "" UBYTE NO_COMPU_METHOD 0 0 0 255 ECU_ADDRESS 0x400DFAAC /end MEASUREMENT
/begin MEASUREMENT MCore_rb_SipF_ProcessImage.Cat50[60].highRes.IrmsSq "" UWORD NO_COMPU_METHOD 0 0 0 65535 ECU_ADDRESS 0x400DFAB0 /end MEASUREMENT
/begin MEASUREMENT MCore_rb_SipF_ProcessImage.Cat50[60].highRes.IrmsSqFiltered "" UBYTE NO_COMPU_METHOD 0 0 0 255 ECU_ADDRESS 0x400DFAAC /end MEASUREMENT
/begin MEASUREMENT MCore_rb_SipF_ProcessImage.Cat50[60].highRes.IrmsSqFiltered.B "" UBYTE NO_COMPU_METHOD 0 0 0 255 ECU_ADDRESS 0x400DFAAC /end MEASUREMENT
/begin MEASUREMENT MCore_rb_SipF_ProcessImage.Cat50[60].highRes.IrmsSqFiltered.B.high_16 "" UWORD NO_COMPU_METHOD 0 0 0 65535 ECU_ADDRESS 0x400DFAAC /end MEASUREMENT
/begin MEASUREMENT MCore_rb_SipF_ProcessImage.Cat50[60].highRes.IrmsSqFiltered.B.low_16 "" UWORD NO_COMPU_METHOD 0 0 0 65535 ECU_ADDRESS 0x400DFAAE /end MEASUREMENT
/begin MEASUREMENT MCore_rb_SipF_ProcessImage.Cat50[60].highRes.IrmsSqFiltered.data_32 "" ULONG NO_COMPU_METHOD 0 0 0 4294967295 ECU_ADDRESS 0x400DFAAC /end MEASUREMENT
/begin MEASUREMENT MCore_rb_SipF_ProcessImage.Cat50[60].processed "" UWORD NO_COMPU_METHOD 0 0 0 65535 ECU_ADDRESS 0x400DFAB4 /end MEASUREMENT
/begin MEASUREMENT MCore_rb_SipF_ProcessImage.Cat50[60].snapshot "" UWORD NO_COMPU_METHOD 0 0 0 65535 ECU_ADDRESS 0x400DFAA4 /end MEASUREMENT
/begin MEASUREMENT MCore_rb_SipF_ProcessImage.Cat50[60].snapshotDuty "" UWORD NO_COMPU_METHOD 0 0 0 65535 ECU_ADDRESS 0x400DFAA6 /end MEASUREMENT
/begin MEASUREMENT MCore_rb_SipF_ProcessImage.Cat50[60].snapshotErrorValue "" UBYTE NO_COMPU_METHOD 0 0 0 1 BIT_MASK 0x1 ECU_ADDRESS 0x400DFAA8 /end MEASUREMENT
/begin MEASUREMENT MCore_rb_SipF_ProcessImage.Cat50[60].snapshotPeriod "" UWORD NO_COMPU_METHOD 0 0 0 65535 ECU_ADDRESS 0x400DFAA8 /end MEASUREMENT
/begin MEASUREMENT MCore_rb_SipF_ProcessImage.Cat50[60].snapshotReserved "" UBYTE NO_COMPU_METHOD 0 0 0 63 BIT_MASK 0xfc ECU_ADDRESS 0x400DFAA8 /end MEASUREMENT
/begin MEASUREMENT MCore_rb_SipF_ProcessImage.Cat50[60].snapshotSbmValue "" UBYTE NO_COMPU_METHOD 0 0 0 1 BIT_MASK 0x2 ECU_ADDRESS 0x400DFAA8 /end MEASUREMENT
/begin MEASUREMENT MCore_rb_SipF_ProcessImage.Cat50[60].switches "" UBYTE NO_COMPU_METHOD 0 0 0 255 ECU_ADDRESS 0x400DFAB8 /end MEASUREMENT
/begin MEASUREMENT MCore_rb_SipF_ProcessImage.Cat50[60].switches.mcalInputDisconnect "" SBYTE rb_SipF_ProcessImage.Cat50[60].switches.mcalInputDisconnect.CONVERSION 0 0 -128 127 ECU_ADDRESS 0x400DFAB8 /end MEASUREMENT
/begin MEASUREMENT MCore_rb_SipF_ProcessImage.Cat50[60].switches.sipfInputDisconnect "" SBYTE rb_SipF_ProcessImage.Cat50[60].switches.sipfInputDisconnect.CONVERSION 0 0 -128 127 ECU_ADDRESS 0x400DFAB9 /end MEASUREMENT
/begin MEASUREMENT MCore_rb_SipF_ProcessImage.Cat50[61].highRes "" UBYTE NO_COMPU_METHOD 0 0 0 255 ECU_ADDRESS 0x400DFAC4 /end MEASUREMENT
/begin MEASUREMENT MCore_rb_SipF_ProcessImage.Cat50[61].highRes.IrmsSq "" UWORD NO_COMPU_METHOD 0 0 0 65535 ECU_ADDRESS 0x400DFAC8 /end MEASUREMENT
/begin MEASUREMENT MCore_rb_SipF_ProcessImage.Cat50[61].highRes.IrmsSqFiltered "" UBYTE NO_COMPU_METHOD 0 0 0 255 ECU_ADDRESS 0x400DFAC4 /end MEASUREMENT
/begin MEASUREMENT MCore_rb_SipF_ProcessImage.Cat50[61].highRes.IrmsSqFiltered.B "" UBYTE NO_COMPU_METHOD 0 0 0 255 ECU_ADDRESS 0x400DFAC4 /end MEASUREMENT
/begin MEASUREMENT MCore_rb_SipF_ProcessImage.Cat50[61].highRes.IrmsSqFiltered.B.high_16 "" UWORD NO_COMPU_METHOD 0 0 0 65535 ECU_ADDRESS 0x400DFAC4 /end MEASUREMENT
/begin MEASUREMENT MCore_rb_SipF_ProcessImage.Cat50[61].highRes.IrmsSqFiltered.B.low_16 "" UWORD NO_COMPU_METHOD 0 0 0 65535 ECU_ADDRESS 0x400DFAC6 /end MEASUREMENT
/begin MEASUREMENT MCore_rb_SipF_ProcessImage.Cat50[61].highRes.IrmsSqFiltered.data_32 "" ULONG NO_COMPU_METHOD 0 0 0 4294967295 ECU_ADDRESS 0x400DFAC4 /end MEASUREMENT
/begin MEASUREMENT MCore_rb_SipF_ProcessImage.Cat50[61].processed "" UWORD NO_COMPU_METHOD 0 0 0 65535 ECU_ADDRESS 0x400DFACC /end MEASUREMENT
/begin MEASUREMENT MCore_rb_SipF_ProcessImage.Cat50[61].snapshot "" UWORD NO_COMPU_METHOD 0 0 0 65535 ECU_ADDRESS 0x400DFABC /end MEASUREMENT
/begin MEASUREMENT MCore_rb_SipF_ProcessImage.Cat50[61].snapshotDuty "" UWORD NO_COMPU_METHOD 0 0 0 65535 ECU_ADDRESS 0x400DFABE /end MEASUREMENT
/begin MEASUREMENT MCore_rb_SipF_ProcessImage.Cat50[61].snapshotErrorValue "" UBYTE NO_COMPU_METHOD 0 0 0 1 BIT_MASK 0x1 ECU_ADDRESS 0x400DFAC0 /end MEASUREMENT
/begin MEASUREMENT MCore_rb_SipF_ProcessImage.Cat50[61].snapshotPeriod "" UWORD NO_COMPU_METHOD 0 0 0 65535 ECU_ADDRESS 0x400DFAC0 /end MEASUREMENT
/begin MEASUREMENT MCore_rb_SipF_ProcessImage.Cat50[61].snapshotReserved "" UBYTE NO_COMPU_METHOD 0 0 0 63 BIT_MASK 0xfc ECU_ADDRESS 0x400DFAC0 /end MEASUREMENT
/begin MEASUREMENT MCore_rb_SipF_ProcessImage.Cat50[61].snapshotSbmValue "" UBYTE NO_COMPU_METHOD 0 0 0 1 BIT_MASK 0x2 ECU_ADDRESS 0x400DFAC0 /end MEASUREMENT
/begin MEASUREMENT MCore_rb_SipF_ProcessImage.Cat50[61].switches "" UBYTE NO_COMPU_METHOD 0 0 0 255 ECU_ADDRESS 0x400DFAD0 /end MEASUREMENT
/begin MEASUREMENT MCore_rb_SipF_ProcessImage.Cat50[61].switches.mcalInputDisconnect "" SBYTE rb_SipF_ProcessImage.Cat50[61].switches.mcalInputDisconnect.CONVERSION 0 0 -128 127 ECU_ADDRESS 0x400DFAD0 /end MEASUREMENT
/begin MEASUREMENT MCore_rb_SipF_ProcessImage.Cat50[61].switches.sipfInputDisconnect "" SBYTE rb_SipF_ProcessImage.Cat50[61].switches.sipfInputDisconnect.CONVERSION 0 0 -128 127 ECU_ADDRESS 0x400DFAD1 /end MEASUREMENT
/begin MEASUREMENT MCore_rb_SipF_ProcessImage.Cat50[6].highRes "" UBYTE NO_COMPU_METHOD 0 0 0 255 ECU_ADDRESS 0x400DF59C /end MEASUREMENT
/begin MEASUREMENT MCore_rb_SipF_ProcessImage.Cat50[6].highRes.IrmsSq "" UWORD NO_COMPU_METHOD 0 0 0 65535 ECU_ADDRESS 0x400DF5A0 /end MEASUREMENT
/begin MEASUREMENT MCore_rb_SipF_ProcessImage.Cat50[6].highRes.IrmsSqFiltered "" UBYTE NO_COMPU_METHOD 0 0 0 255 ECU_ADDRESS 0x400DF59C /end MEASUREMENT
/begin MEASUREMENT MCore_rb_SipF_ProcessImage.Cat50[6].highRes.IrmsSqFiltered.B "" UBYTE NO_COMPU_METHOD 0 0 0 255 ECU_ADDRESS 0x400DF59C /end MEASUREMENT
/begin MEASUREMENT MCore_rb_SipF_ProcessImage.Cat50[6].highRes.IrmsSqFiltered.B.high_16 "" UWORD NO_COMPU_METHOD 0 0 0 65535 ECU_ADDRESS 0x400DF59C /end MEASUREMENT
/begin MEASUREMENT MCore_rb_SipF_ProcessImage.Cat50[6].highRes.IrmsSqFiltered.B.low_16 "" UWORD NO_COMPU_METHOD 0 0 0 65535 ECU_ADDRESS 0x400DF59E /end MEASUREMENT
/begin MEASUREMENT MCore_rb_SipF_ProcessImage.Cat50[6].highRes.IrmsSqFiltered.data_32 "" ULONG NO_COMPU_METHOD 0 0 0 4294967295 ECU_ADDRESS 0x400DF59C /end MEASUREMENT
/begin MEASUREMENT MCore_rb_SipF_ProcessImage.Cat50[6].processed "" UWORD NO_COMPU_METHOD 0 0 0 65535 ECU_ADDRESS 0x400DF5A4 /end MEASUREMENT
/begin MEASUREMENT MCore_rb_SipF_ProcessImage.Cat50[6].snapshot "" UWORD NO_COMPU_METHOD 0 0 0 65535 ECU_ADDRESS 0x400DF594 /end MEASUREMENT
/begin MEASUREMENT MCore_rb_SipF_ProcessImage.Cat50[6].snapshotDuty "" UWORD NO_COMPU_METHOD 0 0 0 65535 ECU_ADDRESS 0x400DF596 /end MEASUREMENT
/begin MEASUREMENT MCore_rb_SipF_ProcessImage.Cat50[6].snapshotErrorValue "" UBYTE NO_COMPU_METHOD 0 0 0 1 BIT_MASK 0x1 ECU_ADDRESS 0x400DF598 /end MEASUREMENT
/begin MEASUREMENT MCore_rb_SipF_ProcessImage.Cat50[6].snapshotPeriod "" UWORD NO_COMPU_METHOD 0 0 0 65535 ECU_ADDRESS 0x400DF598 /end MEASUREMENT
/begin MEASUREMENT MCore_rb_SipF_ProcessImage.Cat50[6].snapshotReserved "" UBYTE NO_COMPU_METHOD 0 0 0 63 BIT_MASK 0xfc ECU_ADDRESS 0x400DF598 /end MEASUREMENT
/begin MEASUREMENT MCore_rb_SipF_ProcessImage.Cat50[6].snapshotSbmValue "" UBYTE NO_COMPU_METHOD 0 0 0 1 BIT_MASK 0x2 ECU_ADDRESS 0x400DF598 /end MEASUREMENT
/begin MEASUREMENT MCore_rb_SipF_ProcessImage.Cat50[6].switches "" UBYTE NO_COMPU_METHOD 0 0 0 255 ECU_ADDRESS 0x400DF5A8 /end MEASUREMENT
/begin MEASUREMENT MCore_rb_SipF_ProcessImage.Cat50[6].switches.mcalInputDisconnect "" SBYTE rb_SipF_ProcessImage.Cat50[6].switches.mcalInputDisconnect.CONVERSION 0 0 -128 127 ECU_ADDRESS 0x400DF5A8 /end MEASUREMENT
/begin MEASUREMENT MCore_rb_SipF_ProcessImage.Cat50[6].switches.sipfInputDisconnect "" SBYTE rb_SipF_ProcessImage.Cat50[6].switches.sipfInputDisconnect.CONVERSION 0 0 -128 127 ECU_ADDRESS 0x400DF5A9 /end MEASUREMENT
/begin MEASUREMENT MCore_rb_SipF_ProcessImage.Cat50[7].highRes "" UBYTE NO_COMPU_METHOD 0 0 0 255 ECU_ADDRESS 0x400DF5B4 /end MEASUREMENT
/begin MEASUREMENT MCore_rb_SipF_ProcessImage.Cat50[7].highRes.IrmsSq "" UWORD NO_COMPU_METHOD 0 0 0 65535 ECU_ADDRESS 0x400DF5B8 /end MEASUREMENT
/begin MEASUREMENT MCore_rb_SipF_ProcessImage.Cat50[7].highRes.IrmsSqFiltered "" UBYTE NO_COMPU_METHOD 0 0 0 255 ECU_ADDRESS 0x400DF5B4 /end MEASUREMENT
/begin MEASUREMENT MCore_rb_SipF_ProcessImage.Cat50[7].highRes.IrmsSqFiltered.B "" UBYTE NO_COMPU_METHOD 0 0 0 255 ECU_ADDRESS 0x400DF5B4 /end MEASUREMENT
/begin MEASUREMENT MCore_rb_SipF_ProcessImage.Cat50[7].highRes.IrmsSqFiltered.B.high_16 "" UWORD NO_COMPU_METHOD 0 0 0 65535 ECU_ADDRESS 0x400DF5B4 /end MEASUREMENT
/begin MEASUREMENT MCore_rb_SipF_ProcessImage.Cat50[7].highRes.IrmsSqFiltered.B.low_16 "" UWORD NO_COMPU_METHOD 0 0 0 65535 ECU_ADDRESS 0x400DF5B6 /end MEASUREMENT
/begin MEASUREMENT MCore_rb_SipF_ProcessImage.Cat50[7].highRes.IrmsSqFiltered.data_32 "" ULONG NO_COMPU_METHOD 0 0 0 4294967295 ECU_ADDRESS 0x400DF5B4 /end MEASUREMENT
/begin MEASUREMENT MCore_rb_SipF_ProcessImage.Cat50[7].processed "" UWORD NO_COMPU_METHOD 0 0 0 65535 ECU_ADDRESS 0x400DF5BC /end MEASUREMENT
/begin MEASUREMENT MCore_rb_SipF_ProcessImage.Cat50[7].snapshot "" UWORD NO_COMPU_METHOD 0 0 0 65535 ECU_ADDRESS 0x400DF5AC /end MEASUREMENT
/begin MEASUREMENT MCore_rb_SipF_ProcessImage.Cat50[7].snapshotDuty "" UWORD NO_COMPU_METHOD 0 0 0 65535 ECU_ADDRESS 0x400DF5AE /end MEASUREMENT
/begin MEASUREMENT MCore_rb_SipF_ProcessImage.Cat50[7].snapshotErrorValue "" UBYTE NO_COMPU_METHOD 0 0 0 1 BIT_MASK 0x1 ECU_ADDRESS 0x400DF5B0 /end MEASUREMENT
/begin MEASUREMENT MCore_rb_SipF_ProcessImage.Cat50[7].snapshotPeriod "" UWORD NO_COMPU_METHOD 0 0 0 65535 ECU_ADDRESS 0x400DF5B0 /end MEASUREMENT
/begin MEASUREMENT MCore_rb_SipF_ProcessImage.Cat50[7].snapshotReserved "" UBYTE NO_COMPU_METHOD 0 0 0 63 BIT_MASK 0xfc ECU_ADDRESS 0x400DF5B0 /end MEASUREMENT
/begin MEASUREMENT MCore_rb_SipF_ProcessImage.Cat50[7].snapshotSbmValue "" UBYTE NO_COMPU_METHOD 0 0 0 1 BIT_MASK 0x2 ECU_ADDRESS 0x400DF5B0 /end MEASUREMENT
/begin MEASUREMENT MCore_rb_SipF_ProcessImage.Cat50[7].switches "" UBYTE NO_COMPU_METHOD 0 0 0 255 ECU_ADDRESS 0x400DF5C0 /end MEASUREMENT
/begin MEASUREMENT MCore_rb_SipF_ProcessImage.Cat50[7].switches.mcalInputDisconnect "" SBYTE rb_SipF_ProcessImage.Cat50[7].switches.mcalInputDisconnect.CONVERSION 0 0 -128 127 ECU_ADDRESS 0x400DF5C0 /end MEASUREMENT
/begin MEASUREMENT MCore_rb_SipF_ProcessImage.Cat50[7].switches.sipfInputDisconnect "" SBYTE rb_SipF_ProcessImage.Cat50[7].switches.sipfInputDisconnect.CONVERSION 0 0 -128 127 ECU_ADDRESS 0x400DF5C1 /end MEASUREMENT
/begin MEASUREMENT MCore_rb_SipF_ProcessImage.Cat50[8].highRes "" UBYTE NO_COMPU_METHOD 0 0 0 255 ECU_ADDRESS 0x400DF5CC /end MEASUREMENT
/begin MEASUREMENT MCore_rb_SipF_ProcessImage.Cat50[8].highRes.IrmsSq "" UWORD NO_COMPU_METHOD 0 0 0 65535 ECU_ADDRESS 0x400DF5D0 /end MEASUREMENT
/begin MEASUREMENT MCore_rb_SipF_ProcessImage.Cat50[8].highRes.IrmsSqFiltered "" UBYTE NO_COMPU_METHOD 0 0 0 255 ECU_ADDRESS 0x400DF5CC /end MEASUREMENT
/begin MEASUREMENT MCore_rb_SipF_ProcessImage.Cat50[8].highRes.IrmsSqFiltered.B "" UBYTE NO_COMPU_METHOD 0 0 0 255 ECU_ADDRESS 0x400DF5CC /end MEASUREMENT
/begin MEASUREMENT MCore_rb_SipF_ProcessImage.Cat50[8].highRes.IrmsSqFiltered.B.high_16 "" UWORD NO_COMPU_METHOD 0 0 0 65535 ECU_ADDRESS 0x400DF5CC /end MEASUREMENT
/begin MEASUREMENT MCore_rb_SipF_ProcessImage.Cat50[8].highRes.IrmsSqFiltered.B.low_16 "" UWORD NO_COMPU_METHOD 0 0 0 65535 ECU_ADDRESS 0x400DF5CE /end MEASUREMENT
/begin MEASUREMENT MCore_rb_SipF_ProcessImage.Cat50[8].highRes.IrmsSqFiltered.data_32 "" ULONG NO_COMPU_METHOD 0 0 0 4294967295 ECU_ADDRESS 0x400DF5CC /end MEASUREMENT
/begin MEASUREMENT MCore_rb_SipF_ProcessImage.Cat50[8].processed "" UWORD NO_COMPU_METHOD 0 0 0 65535 ECU_ADDRESS 0x400DF5D4 /end MEASUREMENT
/begin MEASUREMENT MCore_rb_SipF_ProcessImage.Cat50[8].snapshot "" UWORD NO_COMPU_METHOD 0 0 0 65535 ECU_ADDRESS 0x400DF5C4 /end MEASUREMENT
/begin MEASUREMENT MCore_rb_SipF_ProcessImage.Cat50[8].snapshotDuty "" UWORD NO_COMPU_METHOD 0 0 0 65535 ECU_ADDRESS 0x400DF5C6 /end MEASUREMENT
/begin MEASUREMENT MCore_rb_SipF_ProcessImage.Cat50[8].snapshotErrorValue "" UBYTE NO_COMPU_METHOD 0 0 0 1 BIT_MASK 0x1 ECU_ADDRESS 0x400DF5C8 /end MEASUREMENT
/begin MEASUREMENT MCore_rb_SipF_ProcessImage.Cat50[8].snapshotPeriod "" UWORD NO_COMPU_METHOD 0 0 0 65535 ECU_ADDRESS 0x400DF5C8 /end MEASUREMENT
/begin MEASUREMENT MCore_rb_SipF_ProcessImage.Cat50[8].snapshotReserved "" UBYTE NO_COMPU_METHOD 0 0 0 63 BIT_MASK 0xfc ECU_ADDRESS 0x400DF5C8 /end MEASUREMENT
/begin MEASUREMENT MCore_rb_SipF_ProcessImage.Cat50[8].snapshotSbmValue "" UBYTE NO_COMPU_METHOD 0 0 0 1 BIT_MASK 0x2 ECU_ADDRESS 0x400DF5C8 /end MEASUREMENT
/begin MEASUREMENT MCore_rb_SipF_ProcessImage.Cat50[8].switches "" UBYTE NO_COMPU_METHOD 0 0 0 255 ECU_ADDRESS 0x400DF5D8 /end MEASUREMENT
/begin MEASUREMENT MCore_rb_SipF_ProcessImage.Cat50[8].switches.mcalInputDisconnect "" SBYTE rb_SipF_ProcessImage.Cat50[8].switches.mcalInputDisconnect.CONVERSION 0 0 -128 127 ECU_ADDRESS 0x400DF5D8 /end MEASUREMENT
/begin MEASUREMENT MCore_rb_SipF_ProcessImage.Cat50[8].switches.sipfInputDisconnect "" SBYTE rb_SipF_ProcessImage.Cat50[8].switches.sipfInputDisconnect.CONVERSION 0 0 -128 127 ECU_ADDRESS 0x400DF5D9 /end MEASUREMENT
/begin MEASUREMENT MCore_rb_SipF_ProcessImage.Cat50[9].highRes "" UBYTE NO_COMPU_METHOD 0 0 0 255 ECU_ADDRESS 0x400DF5E4 /end MEASUREMENT
/begin MEASUREMENT MCore_rb_SipF_ProcessImage.Cat50[9].highRes.IrmsSq "" UWORD NO_COMPU_METHOD 0 0 0 65535 ECU_ADDRESS 0x400DF5E8 /end MEASUREMENT
/begin MEASUREMENT MCore_rb_SipF_ProcessImage.Cat50[9].highRes.IrmsSqFiltered "" UBYTE NO_COMPU_METHOD 0 0 0 255 ECU_ADDRESS 0x400DF5E4 /end MEASUREMENT
/begin MEASUREMENT MCore_rb_SipF_ProcessImage.Cat50[9].highRes.IrmsSqFiltered.B "" UBYTE NO_COMPU_METHOD 0 0 0 255 ECU_ADDRESS 0x400DF5E4 /end MEASUREMENT
/begin MEASUREMENT MCore_rb_SipF_ProcessImage.Cat50[9].highRes.IrmsSqFiltered.B.high_16 "" UWORD NO_COMPU_METHOD 0 0 0 65535 ECU_ADDRESS 0x400DF5E4 /end MEASUREMENT
/begin MEASUREMENT MCore_rb_SipF_ProcessImage.Cat50[9].highRes.IrmsSqFiltered.B.low_16 "" UWORD NO_COMPU_METHOD 0 0 0 65535 ECU_ADDRESS 0x400DF5E6 /end MEASUREMENT
/begin MEASUREMENT MCore_rb_SipF_ProcessImage.Cat50[9].highRes.IrmsSqFiltered.data_32 "" ULONG NO_COMPU_METHOD 0 0 0 4294967295 ECU_ADDRESS 0x400DF5E4 /end MEASUREMENT
/begin MEASUREMENT MCore_rb_SipF_ProcessImage.Cat50[9].processed "" UWORD NO_COMPU_METHOD 0 0 0 65535 ECU_ADDRESS 0x400DF5EC /end MEASUREMENT
/begin MEASUREMENT MCore_rb_SipF_ProcessImage.Cat50[9].snapshot "" UWORD NO_COMPU_METHOD 0 0 0 65535 ECU_ADDRESS 0x400DF5DC /end MEASUREMENT
/begin MEASUREMENT MCore_rb_SipF_ProcessImage.Cat50[9].snapshotDuty "" UWORD NO_COMPU_METHOD 0 0 0 65535 ECU_ADDRESS 0x400DF5DE /end MEASUREMENT
/begin MEASUREMENT MCore_rb_SipF_ProcessImage.Cat50[9].snapshotErrorValue "" UBYTE NO_COMPU_METHOD 0 0 0 1 BIT_MASK 0x1 ECU_ADDRESS 0x400DF5E0 /end MEASUREMENT
/begin MEASUREMENT MCore_rb_SipF_ProcessImage.Cat50[9].snapshotPeriod "" UWORD NO_COMPU_METHOD 0 0 0 65535 ECU_ADDRESS 0x400DF5E0 /end MEASUREMENT
/begin MEASUREMENT MCore_rb_SipF_ProcessImage.Cat50[9].snapshotReserved "" UBYTE NO_COMPU_METHOD 0 0 0 63 BIT_MASK 0xfc ECU_ADDRESS 0x400DF5E0 /end MEASUREMENT
/begin MEASUREMENT MCore_rb_SipF_ProcessImage.Cat50[9].snapshotSbmValue "" UBYTE NO_COMPU_METHOD 0 0 0 1 BIT_MASK 0x2 ECU_ADDRESS 0x400DF5E0 /end MEASUREMENT
/begin MEASUREMENT MCore_rb_SipF_ProcessImage.Cat50[9].switches "" UBYTE NO_COMPU_METHOD 0 0 0 255 ECU_ADDRESS 0x400DF5F0 /end MEASUREMENT
/begin MEASUREMENT MCore_rb_SipF_ProcessImage.Cat50[9].switches.mcalInputDisconnect "" SBYTE rb_SipF_ProcessImage.Cat50[9].switches.mcalInputDisconnect.CONVERSION 0 0 -128 127 ECU_ADDRESS 0x400DF5F0 /end MEASUREMENT
/begin MEASUREMENT MCore_rb_SipF_ProcessImage.Cat50[9].switches.sipfInputDisconnect "" SBYTE rb_SipF_ProcessImage.Cat50[9].switches.sipfInputDisconnect.CONVERSION 0 0 -128 127 ECU_ADDRESS 0x400DF5F1 /end MEASUREMENT
/begin MEASUREMENT MCore_rb_SipF_ProcessImage.Cat52 "" UBYTE NO_COMPU_METHOD 0 0 0 255 ECU_ADDRESS 0x400DFB64 /end MEASUREMENT
/begin MEASUREMENT MCore_rb_SipF_ProcessImage.Cat52[0].processed "" UWORD NO_COMPU_METHOD 0 0 0 65535 ECU_ADDRESS 0x400DFB6C /end MEASUREMENT
/begin MEASUREMENT MCore_rb_SipF_ProcessImage.Cat52[0].reserved "" UBYTE NO_COMPU_METHOD 0 0 0 31 BIT_MASK 0xf8 ECU_ADDRESS 0x400DFB68 /end MEASUREMENT
/begin MEASUREMENT MCore_rb_SipF_ProcessImage.Cat52[0].snapshot "" UWORD NO_COMPU_METHOD 0 0 0 65535 ECU_ADDRESS 0x400DFB64 /end MEASUREMENT
/begin MEASUREMENT MCore_rb_SipF_ProcessImage.Cat52[0].snapshotDuty "" UWORD NO_COMPU_METHOD 0 0 0 65535 ECU_ADDRESS 0x400DFB66 /end MEASUREMENT
/begin MEASUREMENT MCore_rb_SipF_ProcessImage.Cat52[0].snapshotFrequency "" UWORD NO_COMPU_METHOD 0 0 0 65535 ECU_ADDRESS 0x400DFB68 /end MEASUREMENT
/begin MEASUREMENT MCore_rb_SipF_ProcessImage.Cat52[0].snapshotOlAtOffErrFlag "" UBYTE NO_COMPU_METHOD 0 0 0 1 BIT_MASK 0x1 ECU_ADDRESS 0x400DFB68 /end MEASUREMENT
/begin MEASUREMENT MCore_rb_SipF_ProcessImage.Cat52[0].snapshotOlAtOnErrFlag "" UBYTE NO_COMPU_METHOD 0 0 0 1 BIT_MASK 0x2 ECU_ADDRESS 0x400DFB68 /end MEASUREMENT
/begin MEASUREMENT MCore_rb_SipF_ProcessImage.Cat52[0].snapshotScErrFlag "" UBYTE NO_COMPU_METHOD 0 0 0 1 BIT_MASK 0x4 ECU_ADDRESS 0x400DFB68 /end MEASUREMENT
/begin MEASUREMENT MCore_rb_SipF_ProcessImage.Cat52[0].switches "" UBYTE NO_COMPU_METHOD 0 0 0 255 ECU_ADDRESS 0x400DFB70 /end MEASUREMENT
/begin MEASUREMENT MCore_rb_SipF_ProcessImage.Cat52[0].switches.mcalInputDisconnect "" SBYTE rb_SipF_ProcessImage.Cat52[0].switches.mcalInputDisconnect.CONVERSION 0 0 -128 127 ECU_ADDRESS 0x400DFB70 /end MEASUREMENT
/begin MEASUREMENT MCore_rb_SipF_ProcessImage.Cat52[0].switches.sipfInputDisconnect "" SBYTE rb_SipF_ProcessImage.Cat52[0].switches.sipfInputDisconnect.CONVERSION 0 0 -128 127 ECU_ADDRESS 0x400DFB71 /end MEASUREMENT
/begin MEASUREMENT MCore_rb_SipF_ProcessImage.Cat52[10].processed "" UWORD NO_COMPU_METHOD 0 0 0 65535 ECU_ADDRESS 0x400DFBF8 /end MEASUREMENT
/begin MEASUREMENT MCore_rb_SipF_ProcessImage.Cat52[10].reserved "" UBYTE NO_COMPU_METHOD 0 0 0 31 BIT_MASK 0xf8 ECU_ADDRESS 0x400DFBF4 /end MEASUREMENT
/begin MEASUREMENT MCore_rb_SipF_ProcessImage.Cat52[10].snapshot "" UWORD NO_COMPU_METHOD 0 0 0 65535 ECU_ADDRESS 0x400DFBF0 /end MEASUREMENT
/begin MEASUREMENT MCore_rb_SipF_ProcessImage.Cat52[10].snapshotDuty "" UWORD NO_COMPU_METHOD 0 0 0 65535 ECU_ADDRESS 0x400DFBF2 /end MEASUREMENT
/begin MEASUREMENT MCore_rb_SipF_ProcessImage.Cat52[10].snapshotFrequency "" UWORD NO_COMPU_METHOD 0 0 0 65535 ECU_ADDRESS 0x400DFBF4 /end MEASUREMENT
/begin MEASUREMENT MCore_rb_SipF_ProcessImage.Cat52[10].snapshotOlAtOffErrFlag "" UBYTE NO_COMPU_METHOD 0 0 0 1 BIT_MASK 0x1 ECU_ADDRESS 0x400DFBF4 /end MEASUREMENT
/begin MEASUREMENT MCore_rb_SipF_ProcessImage.Cat52[10].snapshotOlAtOnErrFlag "" UBYTE NO_COMPU_METHOD 0 0 0 1 BIT_MASK 0x2 ECU_ADDRESS 0x400DFBF4 /end MEASUREMENT
/begin MEASUREMENT MCore_rb_SipF_ProcessImage.Cat52[10].snapshotScErrFlag "" UBYTE NO_COMPU_METHOD 0 0 0 1 BIT_MASK 0x4 ECU_ADDRESS 0x400DFBF4 /end MEASUREMENT
/begin MEASUREMENT MCore_rb_SipF_ProcessImage.Cat52[10].switches "" UBYTE NO_COMPU_METHOD 0 0 0 255 ECU_ADDRESS 0x400DFBFC /end MEASUREMENT
/begin MEASUREMENT MCore_rb_SipF_ProcessImage.Cat52[10].switches.mcalInputDisconnect "" SBYTE rb_SipF_ProcessImage.Cat52[10].switches.mcalInputDisconnect.CONVERSION 0 0 -128 127 ECU_ADDRESS 0x400DFBFC /end MEASUREMENT
/begin MEASUREMENT MCore_rb_SipF_ProcessImage.Cat52[10].switches.sipfInputDisconnect "" SBYTE rb_SipF_ProcessImage.Cat52[10].switches.sipfInputDisconnect.CONVERSION 0 0 -128 127 ECU_ADDRESS 0x400DFBFD /end MEASUREMENT
/begin MEASUREMENT MCore_rb_SipF_ProcessImage.Cat52[11].processed "" UWORD NO_COMPU_METHOD 0 0 0 65535 ECU_ADDRESS 0x400DFC06 /end MEASUREMENT
/begin MEASUREMENT MCore_rb_SipF_ProcessImage.Cat52[11].reserved "" UBYTE NO_COMPU_METHOD 0 0 0 31 BIT_MASK 0xf8 ECU_ADDRESS 0x400DFC02 /end MEASUREMENT
/begin MEASUREMENT MCore_rb_SipF_ProcessImage.Cat52[11].snapshot "" UWORD NO_COMPU_METHOD 0 0 0 65535 ECU_ADDRESS 0x400DFBFE /end MEASUREMENT
/begin MEASUREMENT MCore_rb_SipF_ProcessImage.Cat52[11].snapshotDuty "" UWORD NO_COMPU_METHOD 0 0 0 65535 ECU_ADDRESS 0x400DFC00 /end MEASUREMENT
/begin MEASUREMENT MCore_rb_SipF_ProcessImage.Cat52[11].snapshotFrequency "" UWORD NO_COMPU_METHOD 0 0 0 65535 ECU_ADDRESS 0x400DFC02 /end MEASUREMENT
/begin MEASUREMENT MCore_rb_SipF_ProcessImage.Cat52[11].snapshotOlAtOffErrFlag "" UBYTE NO_COMPU_METHOD 0 0 0 1 BIT_MASK 0x1 ECU_ADDRESS 0x400DFC02 /end MEASUREMENT
/begin MEASUREMENT MCore_rb_SipF_ProcessImage.Cat52[11].snapshotOlAtOnErrFlag "" UBYTE NO_COMPU_METHOD 0 0 0 1 BIT_MASK 0x2 ECU_ADDRESS 0x400DFC02 /end MEASUREMENT
/begin MEASUREMENT MCore_rb_SipF_ProcessImage.Cat52[11].snapshotScErrFlag "" UBYTE NO_COMPU_METHOD 0 0 0 1 BIT_MASK 0x4 ECU_ADDRESS 0x400DFC02 /end MEASUREMENT
/begin MEASUREMENT MCore_rb_SipF_ProcessImage.Cat52[11].switches "" UBYTE NO_COMPU_METHOD 0 0 0 255 ECU_ADDRESS 0x400DFC0A /end MEASUREMENT
/begin MEASUREMENT MCore_rb_SipF_ProcessImage.Cat52[11].switches.mcalInputDisconnect "" SBYTE rb_SipF_ProcessImage.Cat52[11].switches.mcalInputDisconnect.CONVERSION 0 0 -128 127 ECU_ADDRESS 0x400DFC0A /end MEASUREMENT
/begin MEASUREMENT MCore_rb_SipF_ProcessImage.Cat52[11].switches.sipfInputDisconnect "" SBYTE rb_SipF_ProcessImage.Cat52[11].switches.sipfInputDisconnect.CONVERSION 0 0 -128 127 ECU_ADDRESS 0x400DFC0B /end MEASUREMENT
/begin MEASUREMENT MCore_rb_SipF_ProcessImage.Cat52[1].processed "" UWORD NO_COMPU_METHOD 0 0 0 65535 ECU_ADDRESS 0x400DFB7A /end MEASUREMENT
/begin MEASUREMENT MCore_rb_SipF_ProcessImage.Cat52[1].reserved "" UBYTE NO_COMPU_METHOD 0 0 0 31 BIT_MASK 0xf8 ECU_ADDRESS 0x400DFB76 /end MEASUREMENT
/begin MEASUREMENT MCore_rb_SipF_ProcessImage.Cat52[1].snapshot "" UWORD NO_COMPU_METHOD 0 0 0 65535 ECU_ADDRESS 0x400DFB72 /end MEASUREMENT
/begin MEASUREMENT MCore_rb_SipF_ProcessImage.Cat52[1].snapshotDuty "" UWORD NO_COMPU_METHOD 0 0 0 65535 ECU_ADDRESS 0x400DFB74 /end MEASUREMENT
/begin MEASUREMENT MCore_rb_SipF_ProcessImage.Cat52[1].snapshotFrequency "" UWORD NO_COMPU_METHOD 0 0 0 65535 ECU_ADDRESS 0x400DFB76 /end MEASUREMENT
/begin MEASUREMENT MCore_rb_SipF_ProcessImage.Cat52[1].snapshotOlAtOffErrFlag "" UBYTE NO_COMPU_METHOD 0 0 0 1 BIT_MASK 0x1 ECU_ADDRESS 0x400DFB76 /end MEASUREMENT
/begin MEASUREMENT MCore_rb_SipF_ProcessImage.Cat52[1].snapshotOlAtOnErrFlag "" UBYTE NO_COMPU_METHOD 0 0 0 1 BIT_MASK 0x2 ECU_ADDRESS 0x400DFB76 /end MEASUREMENT
/begin MEASUREMENT MCore_rb_SipF_ProcessImage.Cat52[1].snapshotScErrFlag "" UBYTE NO_COMPU_METHOD 0 0 0 1 BIT_MASK 0x4 ECU_ADDRESS 0x400DFB76 /end MEASUREMENT
/begin MEASUREMENT MCore_rb_SipF_ProcessImage.Cat52[1].switches "" UBYTE NO_COMPU_METHOD 0 0 0 255 ECU_ADDRESS 0x400DFB7E /end MEASUREMENT
/begin MEASUREMENT MCore_rb_SipF_ProcessImage.Cat52[1].switches.mcalInputDisconnect "" SBYTE rb_SipF_ProcessImage.Cat52[1].switches.mcalInputDisconnect.CONVERSION 0 0 -128 127 ECU_ADDRESS 0x400DFB7E /end MEASUREMENT
/begin MEASUREMENT MCore_rb_SipF_ProcessImage.Cat52[1].switches.sipfInputDisconnect "" SBYTE rb_SipF_ProcessImage.Cat52[1].switches.sipfInputDisconnect.CONVERSION 0 0 -128 127 ECU_ADDRESS 0x400DFB7F /end MEASUREMENT
/begin MEASUREMENT MCore_rb_SipF_ProcessImage.Cat52[2].processed "" UWORD NO_COMPU_METHOD 0 0 0 65535 ECU_ADDRESS 0x400DFB88 /end MEASUREMENT
/begin MEASUREMENT MCore_rb_SipF_ProcessImage.Cat52[2].reserved "" UBYTE NO_COMPU_METHOD 0 0 0 31 BIT_MASK 0xf8 ECU_ADDRESS 0x400DFB84 /end MEASUREMENT
/begin MEASUREMENT MCore_rb_SipF_ProcessImage.Cat52[2].snapshot "" UWORD NO_COMPU_METHOD 0 0 0 65535 ECU_ADDRESS 0x400DFB80 /end MEASUREMENT
/begin MEASUREMENT MCore_rb_SipF_ProcessImage.Cat52[2].snapshotDuty "" UWORD NO_COMPU_METHOD 0 0 0 65535 ECU_ADDRESS 0x400DFB82 /end MEASUREMENT
/begin MEASUREMENT MCore_rb_SipF_ProcessImage.Cat52[2].snapshotFrequency "" UWORD NO_COMPU_METHOD 0 0 0 65535 ECU_ADDRESS 0x400DFB84 /end MEASUREMENT
/begin MEASUREMENT MCore_rb_SipF_ProcessImage.Cat52[2].snapshotOlAtOffErrFlag "" UBYTE NO_COMPU_METHOD 0 0 0 1 BIT_MASK 0x1 ECU_ADDRESS 0x400DFB84 /end MEASUREMENT
/begin MEASUREMENT MCore_rb_SipF_ProcessImage.Cat52[2].snapshotOlAtOnErrFlag "" UBYTE NO_COMPU_METHOD 0 0 0 1 BIT_MASK 0x2 ECU_ADDRESS 0x400DFB84 /end MEASUREMENT
/begin MEASUREMENT MCore_rb_SipF_ProcessImage.Cat52[2].snapshotScErrFlag "" UBYTE NO_COMPU_METHOD 0 0 0 1 BIT_MASK 0x4 ECU_ADDRESS 0x400DFB84 /end MEASUREMENT
/begin MEASUREMENT MCore_rb_SipF_ProcessImage.Cat52[2].switches "" UBYTE NO_COMPU_METHOD 0 0 0 255 ECU_ADDRESS 0x400DFB8C /end MEASUREMENT
/begin MEASUREMENT MCore_rb_SipF_ProcessImage.Cat52[2].switches.mcalInputDisconnect "" SBYTE rb_SipF_ProcessImage.Cat52[2].switches.mcalInputDisconnect.CONVERSION 0 0 -128 127 ECU_ADDRESS 0x400DFB8C /end MEASUREMENT
/begin MEASUREMENT MCore_rb_SipF_ProcessImage.Cat52[2].switches.sipfInputDisconnect "" SBYTE rb_SipF_ProcessImage.Cat52[2].switches.sipfInputDisconnect.CONVERSION 0 0 -128 127 ECU_ADDRESS 0x400DFB8D /end MEASUREMENT
/begin MEASUREMENT MCore_rb_SipF_ProcessImage.Cat52[3].processed "" UWORD NO_COMPU_METHOD 0 0 0 65535 ECU_ADDRESS 0x400DFB96 /end MEASUREMENT
/begin MEASUREMENT MCore_rb_SipF_ProcessImage.Cat52[3].reserved "" UBYTE NO_COMPU_METHOD 0 0 0 31 BIT_MASK 0xf8 ECU_ADDRESS 0x400DFB92 /end MEASUREMENT
/begin MEASUREMENT MCore_rb_SipF_ProcessImage.Cat52[3].snapshot "" UWORD NO_COMPU_METHOD 0 0 0 65535 ECU_ADDRESS 0x400DFB8E /end MEASUREMENT
/begin MEASUREMENT MCore_rb_SipF_ProcessImage.Cat52[3].snapshotDuty "" UWORD NO_COMPU_METHOD 0 0 0 65535 ECU_ADDRESS 0x400DFB90 /end MEASUREMENT
/begin MEASUREMENT MCore_rb_SipF_ProcessImage.Cat52[3].snapshotFrequency "" UWORD NO_COMPU_METHOD 0 0 0 65535 ECU_ADDRESS 0x400DFB92 /end MEASUREMENT
/begin MEASUREMENT MCore_rb_SipF_ProcessImage.Cat52[3].snapshotOlAtOffErrFlag "" UBYTE NO_COMPU_METHOD 0 0 0 1 BIT_MASK 0x1 ECU_ADDRESS 0x400DFB92 /end MEASUREMENT
/begin MEASUREMENT MCore_rb_SipF_ProcessImage.Cat52[3].snapshotOlAtOnErrFlag "" UBYTE NO_COMPU_METHOD 0 0 0 1 BIT_MASK 0x2 ECU_ADDRESS 0x400DFB92 /end MEASUREMENT
/begin MEASUREMENT MCore_rb_SipF_ProcessImage.Cat52[3].snapshotScErrFlag "" UBYTE NO_COMPU_METHOD 0 0 0 1 BIT_MASK 0x4 ECU_ADDRESS 0x400DFB92 /end MEASUREMENT
/begin MEASUREMENT MCore_rb_SipF_ProcessImage.Cat52[3].switches "" UBYTE NO_COMPU_METHOD 0 0 0 255 ECU_ADDRESS 0x400DFB9A /end MEASUREMENT
/begin MEASUREMENT MCore_rb_SipF_ProcessImage.Cat52[3].switches.mcalInputDisconnect "" SBYTE rb_SipF_ProcessImage.Cat52[3].switches.mcalInputDisconnect.CONVERSION 0 0 -128 127 ECU_ADDRESS 0x400DFB9A /end MEASUREMENT
/begin MEASUREMENT MCore_rb_SipF_ProcessImage.Cat52[3].switches.sipfInputDisconnect "" SBYTE rb_SipF_ProcessImage.Cat52[3].switches.sipfInputDisconnect.CONVERSION 0 0 -128 127 ECU_ADDRESS 0x400DFB9B /end MEASUREMENT
/begin MEASUREMENT MCore_rb_SipF_ProcessImage.Cat52[4].processed "" UWORD NO_COMPU_METHOD 0 0 0 65535 ECU_ADDRESS 0x400DFBA4 /end MEASUREMENT
/begin MEASUREMENT MCore_rb_SipF_ProcessImage.Cat52[4].reserved "" UBYTE NO_COMPU_METHOD 0 0 0 31 BIT_MASK 0xf8 ECU_ADDRESS 0x400DFBA0 /end MEASUREMENT
/begin MEASUREMENT MCore_rb_SipF_ProcessImage.Cat52[4].snapshot "" UWORD NO_COMPU_METHOD 0 0 0 65535 ECU_ADDRESS 0x400DFB9C /end MEASUREMENT
/begin MEASUREMENT MCore_rb_SipF_ProcessImage.Cat52[4].snapshotDuty "" UWORD NO_COMPU_METHOD 0 0 0 65535 ECU_ADDRESS 0x400DFB9E /end MEASUREMENT
/begin MEASUREMENT MCore_rb_SipF_ProcessImage.Cat52[4].snapshotFrequency "" UWORD NO_COMPU_METHOD 0 0 0 65535 ECU_ADDRESS 0x400DFBA0 /end MEASUREMENT
/begin MEASUREMENT MCore_rb_SipF_ProcessImage.Cat52[4].snapshotOlAtOffErrFlag "" UBYTE NO_COMPU_METHOD 0 0 0 1 BIT_MASK 0x1 ECU_ADDRESS 0x400DFBA0 /end MEASUREMENT
/begin MEASUREMENT MCore_rb_SipF_ProcessImage.Cat52[4].snapshotOlAtOnErrFlag "" UBYTE NO_COMPU_METHOD 0 0 0 1 BIT_MASK 0x2 ECU_ADDRESS 0x400DFBA0 /end MEASUREMENT
/begin MEASUREMENT MCore_rb_SipF_ProcessImage.Cat52[4].snapshotScErrFlag "" UBYTE NO_COMPU_METHOD 0 0 0 1 BIT_MASK 0x4 ECU_ADDRESS 0x400DFBA0 /end MEASUREMENT
/begin MEASUREMENT MCore_rb_SipF_ProcessImage.Cat52[4].switches "" UBYTE NO_COMPU_METHOD 0 0 0 255 ECU_ADDRESS 0x400DFBA8 /end MEASUREMENT
/begin MEASUREMENT MCore_rb_SipF_ProcessImage.Cat52[4].switches.mcalInputDisconnect "" SBYTE rb_SipF_ProcessImage.Cat52[4].switches.mcalInputDisconnect.CONVERSION 0 0 -128 127 ECU_ADDRESS 0x400DFBA8 /end MEASUREMENT
/begin MEASUREMENT MCore_rb_SipF_ProcessImage.Cat52[4].switches.sipfInputDisconnect "" SBYTE rb_SipF_ProcessImage.Cat52[4].switches.sipfInputDisconnect.CONVERSION 0 0 -128 127 ECU_ADDRESS 0x400DFBA9 /end MEASUREMENT
/begin MEASUREMENT MCore_rb_SipF_ProcessImage.Cat52[5].processed "" UWORD NO_COMPU_METHOD 0 0 0 65535 ECU_ADDRESS 0x400DFBB2 /end MEASUREMENT
/begin MEASUREMENT MCore_rb_SipF_ProcessImage.Cat52[5].reserved "" UBYTE NO_COMPU_METHOD 0 0 0 31 BIT_MASK 0xf8 ECU_ADDRESS 0x400DFBAE /end MEASUREMENT
/begin MEASUREMENT MCore_rb_SipF_ProcessImage.Cat52[5].snapshot "" UWORD NO_COMPU_METHOD 0 0 0 65535 ECU_ADDRESS 0x400DFBAA /end MEASUREMENT
/begin MEASUREMENT MCore_rb_SipF_ProcessImage.Cat52[5].snapshotDuty "" UWORD NO_COMPU_METHOD 0 0 0 65535 ECU_ADDRESS 0x400DFBAC /end MEASUREMENT
/begin MEASUREMENT MCore_rb_SipF_ProcessImage.Cat52[5].snapshotFrequency "" UWORD NO_COMPU_METHOD 0 0 0 65535 ECU_ADDRESS 0x400DFBAE /end MEASUREMENT
/begin MEASUREMENT MCore_rb_SipF_ProcessImage.Cat52[5].snapshotOlAtOffErrFlag "" UBYTE NO_COMPU_METHOD 0 0 0 1 BIT_MASK 0x1 ECU_ADDRESS 0x400DFBAE /end MEASUREMENT
/begin MEASUREMENT MCore_rb_SipF_ProcessImage.Cat52[5].snapshotOlAtOnErrFlag "" UBYTE NO_COMPU_METHOD 0 0 0 1 BIT_MASK 0x2 ECU_ADDRESS 0x400DFBAE /end MEASUREMENT
/begin MEASUREMENT MCore_rb_SipF_ProcessImage.Cat52[5].snapshotScErrFlag "" UBYTE NO_COMPU_METHOD 0 0 0 1 BIT_MASK 0x4 ECU_ADDRESS 0x400DFBAE /end MEASUREMENT
/begin MEASUREMENT MCore_rb_SipF_ProcessImage.Cat52[5].switches "" UBYTE NO_COMPU_METHOD 0 0 0 255 ECU_ADDRESS 0x400DFBB6 /end MEASUREMENT
/begin MEASUREMENT MCore_rb_SipF_ProcessImage.Cat52[5].switches.mcalInputDisconnect "" SBYTE rb_SipF_ProcessImage.Cat52[5].switches.mcalInputDisconnect.CONVERSION 0 0 -128 127 ECU_ADDRESS 0x400DFBB6 /end MEASUREMENT
/begin MEASUREMENT MCore_rb_SipF_ProcessImage.Cat52[5].switches.sipfInputDisconnect "" SBYTE rb_SipF_ProcessImage.Cat52[5].switches.sipfInputDisconnect.CONVERSION 0 0 -128 127 ECU_ADDRESS 0x400DFBB7 /end MEASUREMENT
/begin MEASUREMENT MCore_rb_SipF_ProcessImage.Cat52[6].processed "" UWORD NO_COMPU_METHOD 0 0 0 65535 ECU_ADDRESS 0x400DFBC0 /end MEASUREMENT
/begin MEASUREMENT MCore_rb_SipF_ProcessImage.Cat52[6].reserved "" UBYTE NO_COMPU_METHOD 0 0 0 31 BIT_MASK 0xf8 ECU_ADDRESS 0x400DFBBC /end MEASUREMENT
/begin MEASUREMENT MCore_rb_SipF_ProcessImage.Cat52[6].snapshot "" UWORD NO_COMPU_METHOD 0 0 0 65535 ECU_ADDRESS 0x400DFBB8 /end MEASUREMENT
/begin MEASUREMENT MCore_rb_SipF_ProcessImage.Cat52[6].snapshotDuty "" UWORD NO_COMPU_METHOD 0 0 0 65535 ECU_ADDRESS 0x400DFBBA /end MEASUREMENT
/begin MEASUREMENT MCore_rb_SipF_ProcessImage.Cat52[6].snapshotFrequency "" UWORD NO_COMPU_METHOD 0 0 0 65535 ECU_ADDRESS 0x400DFBBC /end MEASUREMENT
/begin MEASUREMENT MCore_rb_SipF_ProcessImage.Cat52[6].snapshotOlAtOffErrFlag "" UBYTE NO_COMPU_METHOD 0 0 0 1 BIT_MASK 0x1 ECU_ADDRESS 0x400DFBBC /end MEASUREMENT
/begin MEASUREMENT MCore_rb_SipF_ProcessImage.Cat52[6].snapshotOlAtOnErrFlag "" UBYTE NO_COMPU_METHOD 0 0 0 1 BIT_MASK 0x2 ECU_ADDRESS 0x400DFBBC /end MEASUREMENT
/begin MEASUREMENT MCore_rb_SipF_ProcessImage.Cat52[6].snapshotScErrFlag "" UBYTE NO_COMPU_METHOD 0 0 0 1 BIT_MASK 0x4 ECU_ADDRESS 0x400DFBBC /end MEASUREMENT
/begin MEASUREMENT MCore_rb_SipF_ProcessImage.Cat52[6].switches "" UBYTE NO_COMPU_METHOD 0 0 0 255 ECU_ADDRESS 0x400DFBC4 /end MEASUREMENT
/begin MEASUREMENT MCore_rb_SipF_ProcessImage.Cat52[6].switches.mcalInputDisconnect "" SBYTE rb_SipF_ProcessImage.Cat52[6].switches.mcalInputDisconnect.CONVERSION 0 0 -128 127 ECU_ADDRESS 0x400DFBC4 /end MEASUREMENT
/begin MEASUREMENT MCore_rb_SipF_ProcessImage.Cat52[6].switches.sipfInputDisconnect "" SBYTE rb_SipF_ProcessImage.Cat52[6].switches.sipfInputDisconnect.CONVERSION 0 0 -128 127 ECU_ADDRESS 0x400DFBC5 /end MEASUREMENT
/begin MEASUREMENT MCore_rb_SipF_ProcessImage.Cat52[7].processed "" UWORD NO_COMPU_METHOD 0 0 0 65535 ECU_ADDRESS 0x400DFBCE /end MEASUREMENT
/begin MEASUREMENT MCore_rb_SipF_ProcessImage.Cat52[7].reserved "" UBYTE NO_COMPU_METHOD 0 0 0 31 BIT_MASK 0xf8 ECU_ADDRESS 0x400DFBCA /end MEASUREMENT
/begin MEASUREMENT MCore_rb_SipF_ProcessImage.Cat52[7].snapshot "" UWORD NO_COMPU_METHOD 0 0 0 65535 ECU_ADDRESS 0x400DFBC6 /end MEASUREMENT
/begin MEASUREMENT MCore_rb_SipF_ProcessImage.Cat52[7].snapshotDuty "" UWORD NO_COMPU_METHOD 0 0 0 65535 ECU_ADDRESS 0x400DFBC8 /end MEASUREMENT
/begin MEASUREMENT MCore_rb_SipF_ProcessImage.Cat52[7].snapshotFrequency "" UWORD NO_COMPU_METHOD 0 0 0 65535 ECU_ADDRESS 0x400DFBCA /end MEASUREMENT
/begin MEASUREMENT MCore_rb_SipF_ProcessImage.Cat52[7].snapshotOlAtOffErrFlag "" UBYTE NO_COMPU_METHOD 0 0 0 1 BIT_MASK 0x1 ECU_ADDRESS 0x400DFBCA /end MEASUREMENT
/begin MEASUREMENT MCore_rb_SipF_ProcessImage.Cat52[7].snapshotOlAtOnErrFlag "" UBYTE NO_COMPU_METHOD 0 0 0 1 BIT_MASK 0x2 ECU_ADDRESS 0x400DFBCA /end MEASUREMENT
/begin MEASUREMENT MCore_rb_SipF_ProcessImage.Cat52[7].snapshotScErrFlag "" UBYTE NO_COMPU_METHOD 0 0 0 1 BIT_MASK 0x4 ECU_ADDRESS 0x400DFBCA /end MEASUREMENT
/begin MEASUREMENT MCore_rb_SipF_ProcessImage.Cat52[7].switches "" UBYTE NO_COMPU_METHOD 0 0 0 255 ECU_ADDRESS 0x400DFBD2 /end MEASUREMENT
/begin MEASUREMENT MCore_rb_SipF_ProcessImage.Cat52[7].switches.mcalInputDisconnect "" SBYTE rb_SipF_ProcessImage.Cat52[7].switches.mcalInputDisconnect.CONVERSION 0 0 -128 127 ECU_ADDRESS 0x400DFBD2 /end MEASUREMENT
/begin MEASUREMENT MCore_rb_SipF_ProcessImage.Cat52[7].switches.sipfInputDisconnect "" SBYTE rb_SipF_ProcessImage.Cat52[7].switches.sipfInputDisconnect.CONVERSION 0 0 -128 127 ECU_ADDRESS 0x400DFBD3 /end MEASUREMENT
/begin MEASUREMENT MCore_rb_SipF_ProcessImage.Cat52[8].processed "" UWORD NO_COMPU_METHOD 0 0 0 65535 ECU_ADDRESS 0x400DFBDC /end MEASUREMENT
/begin MEASUREMENT MCore_rb_SipF_ProcessImage.Cat52[8].reserved "" UBYTE NO_COMPU_METHOD 0 0 0 31 BIT_MASK 0xf8 ECU_ADDRESS 0x400DFBD8 /end MEASUREMENT
/begin MEASUREMENT MCore_rb_SipF_ProcessImage.Cat52[8].snapshot "" UWORD NO_COMPU_METHOD 0 0 0 65535 ECU_ADDRESS 0x400DFBD4 /end MEASUREMENT
/begin MEASUREMENT MCore_rb_SipF_ProcessImage.Cat52[8].snapshotDuty "" UWORD NO_COMPU_METHOD 0 0 0 65535 ECU_ADDRESS 0x400DFBD6 /end MEASUREMENT
/begin MEASUREMENT MCore_rb_SipF_ProcessImage.Cat52[8].snapshotFrequency "" UWORD NO_COMPU_METHOD 0 0 0 65535 ECU_ADDRESS 0x400DFBD8 /end MEASUREMENT
/begin MEASUREMENT MCore_rb_SipF_ProcessImage.Cat52[8].snapshotOlAtOffErrFlag "" UBYTE NO_COMPU_METHOD 0 0 0 1 BIT_MASK 0x1 ECU_ADDRESS 0x400DFBD8 /end MEASUREMENT
/begin MEASUREMENT MCore_rb_SipF_ProcessImage.Cat52[8].snapshotOlAtOnErrFlag "" UBYTE NO_COMPU_METHOD 0 0 0 1 BIT_MASK 0x2 ECU_ADDRESS 0x400DFBD8 /end MEASUREMENT
/begin MEASUREMENT MCore_rb_SipF_ProcessImage.Cat52[8].snapshotScErrFlag "" UBYTE NO_COMPU_METHOD 0 0 0 1 BIT_MASK 0x4 ECU_ADDRESS 0x400DFBD8 /end MEASUREMENT
/begin MEASUREMENT MCore_rb_SipF_ProcessImage.Cat52[8].switches "" UBYTE NO_COMPU_METHOD 0 0 0 255 ECU_ADDRESS 0x400DFBE0 /end MEASUREMENT
/begin MEASUREMENT MCore_rb_SipF_ProcessImage.Cat52[8].switches.mcalInputDisconnect "" SBYTE rb_SipF_ProcessImage.Cat52[8].switches.mcalInputDisconnect.CONVERSION 0 0 -128 127 ECU_ADDRESS 0x400DFBE0 /end MEASUREMENT
/begin MEASUREMENT MCore_rb_SipF_ProcessImage.Cat52[8].switches.sipfInputDisconnect "" SBYTE rb_SipF_ProcessImage.Cat52[8].switches.sipfInputDisconnect.CONVERSION 0 0 -128 127 ECU_ADDRESS 0x400DFBE1 /end MEASUREMENT
/begin MEASUREMENT MCore_rb_SipF_ProcessImage.Cat52[9].processed "" UWORD NO_COMPU_METHOD 0 0 0 65535 ECU_ADDRESS 0x400DFBEA /end MEASUREMENT
/begin MEASUREMENT MCore_rb_SipF_ProcessImage.Cat52[9].reserved "" UBYTE NO_COMPU_METHOD 0 0 0 31 BIT_MASK 0xf8 ECU_ADDRESS 0x400DFBE6 /end MEASUREMENT
/begin MEASUREMENT MCore_rb_SipF_ProcessImage.Cat52[9].snapshot "" UWORD NO_COMPU_METHOD 0 0 0 65535 ECU_ADDRESS 0x400DFBE2 /end MEASUREMENT
/begin MEASUREMENT MCore_rb_SipF_ProcessImage.Cat52[9].snapshotDuty "" UWORD NO_COMPU_METHOD 0 0 0 65535 ECU_ADDRESS 0x400DFBE4 /end MEASUREMENT
/begin MEASUREMENT MCore_rb_SipF_ProcessImage.Cat52[9].snapshotFrequency "" UWORD NO_COMPU_METHOD 0 0 0 65535 ECU_ADDRESS 0x400DFBE6 /end MEASUREMENT
/begin MEASUREMENT MCore_rb_SipF_ProcessImage.Cat52[9].snapshotOlAtOffErrFlag "" UBYTE NO_COMPU_METHOD 0 0 0 1 BIT_MASK 0x1 ECU_ADDRESS 0x400DFBE6 /end MEASUREMENT
/begin MEASUREMENT MCore_rb_SipF_ProcessImage.Cat52[9].snapshotOlAtOnErrFlag "" UBYTE NO_COMPU_METHOD 0 0 0 1 BIT_MASK 0x2 ECU_ADDRESS 0x400DFBE6 /end MEASUREMENT
/begin MEASUREMENT MCore_rb_SipF_ProcessImage.Cat52[9].snapshotScErrFlag "" UBYTE NO_COMPU_METHOD 0 0 0 1 BIT_MASK 0x4 ECU_ADDRESS 0x400DFBE6 /end MEASUREMENT
/begin MEASUREMENT MCore_rb_SipF_ProcessImage.Cat52[9].switches "" UBYTE NO_COMPU_METHOD 0 0 0 255 ECU_ADDRESS 0x400DFBEE /end MEASUREMENT
/begin MEASUREMENT MCore_rb_SipF_ProcessImage.Cat52[9].switches.mcalInputDisconnect "" SBYTE rb_SipF_ProcessImage.Cat52[9].switches.mcalInputDisconnect.CONVERSION 0 0 -128 127 ECU_ADDRESS 0x400DFBEE /end MEASUREMENT
/begin MEASUREMENT MCore_rb_SipF_ProcessImage.Cat52[9].switches.sipfInputDisconnect "" SBYTE rb_SipF_ProcessImage.Cat52[9].switches.sipfInputDisconnect.CONVERSION 0 0 -128 127 ECU_ADDRESS 0x400DFBEF /end MEASUREMENT
/begin MEASUREMENT MCore_rb_SipF_ProcessImage.Cat53 "" UBYTE NO_COMPU_METHOD 0 0 0 255 ECU_ADDRESS 0x400DFC0C /end MEASUREMENT
/begin MEASUREMENT MCore_rb_SipF_ProcessImage.Cat53[0].highRes "" UBYTE NO_COMPU_METHOD 0 0 0 255 ECU_ADDRESS 0x400DFC14 /end MEASUREMENT
/begin MEASUREMENT MCore_rb_SipF_ProcessImage.Cat53[0].highRes.IrmsSq "" UWORD NO_COMPU_METHOD 0 0 0 65535 ECU_ADDRESS 0x400DFC18 /end MEASUREMENT
/begin MEASUREMENT MCore_rb_SipF_ProcessImage.Cat53[0].highRes.IrmsSqFiltered "" UBYTE NO_COMPU_METHOD 0 0 0 255 ECU_ADDRESS 0x400DFC14 /end MEASUREMENT
/begin MEASUREMENT MCore_rb_SipF_ProcessImage.Cat53[0].highRes.IrmsSqFiltered.B "" UBYTE NO_COMPU_METHOD 0 0 0 255 ECU_ADDRESS 0x400DFC14 /end MEASUREMENT
/begin MEASUREMENT MCore_rb_SipF_ProcessImage.Cat53[0].highRes.IrmsSqFiltered.B.high_16 "" UWORD NO_COMPU_METHOD 0 0 0 65535 ECU_ADDRESS 0x400DFC14 /end MEASUREMENT
/begin MEASUREMENT MCore_rb_SipF_ProcessImage.Cat53[0].highRes.IrmsSqFiltered.B.low_16 "" UWORD NO_COMPU_METHOD 0 0 0 65535 ECU_ADDRESS 0x400DFC16 /end MEASUREMENT
/begin MEASUREMENT MCore_rb_SipF_ProcessImage.Cat53[0].highRes.IrmsSqFiltered.data_32 "" ULONG NO_COMPU_METHOD 0 0 0 4294967295 ECU_ADDRESS 0x400DFC14 /end MEASUREMENT
/begin MEASUREMENT MCore_rb_SipF_ProcessImage.Cat53[0].processed "" UWORD NO_COMPU_METHOD 0 0 0 65535 ECU_ADDRESS 0x400DFC1C /end MEASUREMENT
/begin MEASUREMENT MCore_rb_SipF_ProcessImage.Cat53[0].snapshot "" UWORD NO_COMPU_METHOD 0 0 0 65535 ECU_ADDRESS 0x400DFC0C /end MEASUREMENT
/begin MEASUREMENT MCore_rb_SipF_ProcessImage.Cat53[0].snapshotDuty "" UWORD NO_COMPU_METHOD 0 0 0 65535 ECU_ADDRESS 0x400DFC0E /end MEASUREMENT
/begin MEASUREMENT MCore_rb_SipF_ProcessImage.Cat53[0].snapshotErrorValue "" UBYTE NO_COMPU_METHOD 0 0 0 1 BIT_MASK 0x1 ECU_ADDRESS 0x400DFC10 /end MEASUREMENT
/begin MEASUREMENT MCore_rb_SipF_ProcessImage.Cat53[0].snapshotPeriod "" UWORD NO_COMPU_METHOD 0 0 0 65535 ECU_ADDRESS 0x400DFC10 /end MEASUREMENT
/begin MEASUREMENT MCore_rb_SipF_ProcessImage.Cat53[0].snapshotReserved "" UBYTE NO_COMPU_METHOD 0 0 0 63 BIT_MASK 0xfc ECU_ADDRESS 0x400DFC10 /end MEASUREMENT
/begin MEASUREMENT MCore_rb_SipF_ProcessImage.Cat53[0].snapshotSbmValue "" UBYTE NO_COMPU_METHOD 0 0 0 1 BIT_MASK 0x2 ECU_ADDRESS 0x400DFC10 /end MEASUREMENT
/begin MEASUREMENT MCore_rb_SipF_ProcessImage.Cat53[0].switches "" UBYTE NO_COMPU_METHOD 0 0 0 255 ECU_ADDRESS 0x400DFC20 /end MEASUREMENT
/begin MEASUREMENT MCore_rb_SipF_ProcessImage.Cat53[0].switches.mcalInputDisconnect "" SBYTE rb_SipF_ProcessImage.Cat53[0].switches.mcalInputDisconnect.CONVERSION 0 0 -128 127 ECU_ADDRESS 0x400DFC20 /end MEASUREMENT
/begin MEASUREMENT MCore_rb_SipF_ProcessImage.Cat53[0].switches.sipfInputDisconnect "" SBYTE rb_SipF_ProcessImage.Cat53[0].switches.sipfInputDisconnect.CONVERSION 0 0 -128 127 ECU_ADDRESS 0x400DFC21 /end MEASUREMENT
/begin MEASUREMENT MCore_rb_SipF_ProcessImage.Cat53[1].highRes "" UBYTE NO_COMPU_METHOD 0 0 0 255 ECU_ADDRESS 0x400DFC2C /end MEASUREMENT
/begin MEASUREMENT MCore_rb_SipF_ProcessImage.Cat53[1].highRes.IrmsSq "" UWORD NO_COMPU_METHOD 0 0 0 65535 ECU_ADDRESS 0x400DFC30 /end MEASUREMENT
/begin MEASUREMENT MCore_rb_SipF_ProcessImage.Cat53[1].highRes.IrmsSqFiltered "" UBYTE NO_COMPU_METHOD 0 0 0 255 ECU_ADDRESS 0x400DFC2C /end MEASUREMENT
/begin MEASUREMENT MCore_rb_SipF_ProcessImage.Cat53[1].highRes.IrmsSqFiltered.B "" UBYTE NO_COMPU_METHOD 0 0 0 255 ECU_ADDRESS 0x400DFC2C /end MEASUREMENT
/begin MEASUREMENT MCore_rb_SipF_ProcessImage.Cat53[1].highRes.IrmsSqFiltered.B.high_16 "" UWORD NO_COMPU_METHOD 0 0 0 65535 ECU_ADDRESS 0x400DFC2C /end MEASUREMENT
/begin MEASUREMENT MCore_rb_SipF_ProcessImage.Cat53[1].highRes.IrmsSqFiltered.B.low_16 "" UWORD NO_COMPU_METHOD 0 0 0 65535 ECU_ADDRESS 0x400DFC2E /end MEASUREMENT
/begin MEASUREMENT MCore_rb_SipF_ProcessImage.Cat53[1].highRes.IrmsSqFiltered.data_32 "" ULONG NO_COMPU_METHOD 0 0 0 4294967295 ECU_ADDRESS 0x400DFC2C /end MEASUREMENT
/begin MEASUREMENT MCore_rb_SipF_ProcessImage.Cat53[1].processed "" UWORD NO_COMPU_METHOD 0 0 0 65535 ECU_ADDRESS 0x400DFC34 /end MEASUREMENT
/begin MEASUREMENT MCore_rb_SipF_ProcessImage.Cat53[1].snapshot "" UWORD NO_COMPU_METHOD 0 0 0 65535 ECU_ADDRESS 0x400DFC24 /end MEASUREMENT
/begin MEASUREMENT MCore_rb_SipF_ProcessImage.Cat53[1].snapshotDuty "" UWORD NO_COMPU_METHOD 0 0 0 65535 ECU_ADDRESS 0x400DFC26 /end MEASUREMENT
/begin MEASUREMENT MCore_rb_SipF_ProcessImage.Cat53[1].snapshotErrorValue "" UBYTE NO_COMPU_METHOD 0 0 0 1 BIT_MASK 0x1 ECU_ADDRESS 0x400DFC28 /end MEASUREMENT
/begin MEASUREMENT MCore_rb_SipF_ProcessImage.Cat53[1].snapshotPeriod "" UWORD NO_COMPU_METHOD 0 0 0 65535 ECU_ADDRESS 0x400DFC28 /end MEASUREMENT
/begin MEASUREMENT MCore_rb_SipF_ProcessImage.Cat53[1].snapshotReserved "" UBYTE NO_COMPU_METHOD 0 0 0 63 BIT_MASK 0xfc ECU_ADDRESS 0x400DFC28 /end MEASUREMENT
/begin MEASUREMENT MCore_rb_SipF_ProcessImage.Cat53[1].snapshotSbmValue "" UBYTE NO_COMPU_METHOD 0 0 0 1 BIT_MASK 0x2 ECU_ADDRESS 0x400DFC28 /end MEASUREMENT
/begin MEASUREMENT MCore_rb_SipF_ProcessImage.Cat53[1].switches "" UBYTE NO_COMPU_METHOD 0 0 0 255 ECU_ADDRESS 0x400DFC38 /end MEASUREMENT
/begin MEASUREMENT MCore_rb_SipF_ProcessImage.Cat53[1].switches.mcalInputDisconnect "" SBYTE rb_SipF_ProcessImage.Cat53[1].switches.mcalInputDisconnect.CONVERSION 0 0 -128 127 ECU_ADDRESS 0x400DFC38 /end MEASUREMENT
/begin MEASUREMENT MCore_rb_SipF_ProcessImage.Cat53[1].switches.sipfInputDisconnect "" SBYTE rb_SipF_ProcessImage.Cat53[1].switches.sipfInputDisconnect.CONVERSION 0 0 -128 127 ECU_ADDRESS 0x400DFC39 /end MEASUREMENT
/begin MEASUREMENT MCore_rb_SipF_ProcessImage.Cat54 "" UBYTE NO_COMPU_METHOD 0 0 0 255 ECU_ADDRESS 0x400DFC3C /end MEASUREMENT
/begin MEASUREMENT MCore_rb_SipF_ProcessImage.Cat54[0].debCounter "" UWORD NO_COMPU_METHOD 0 0 0 65535 ECU_ADDRESS 0x400DFC48 /end MEASUREMENT
/begin MEASUREMENT MCore_rb_SipF_ProcessImage.Cat54[0].debounced "" UWORD NO_COMPU_METHOD 0 0 0 65535 ECU_ADDRESS 0x400DFC46 /end MEASUREMENT
/begin MEASUREMENT MCore_rb_SipF_ProcessImage.Cat54[0].discrete "" UWORD NO_COMPU_METHOD 0 0 0 65535 ECU_ADDRESS 0x400DFC42 /end MEASUREMENT
/begin MEASUREMENT MCore_rb_SipF_ProcessImage.Cat54[0].discreteOld "" UWORD NO_COMPU_METHOD 0 0 0 65535 ECU_ADDRESS 0x400DFC44 /end MEASUREMENT
/begin MEASUREMENT MCore_rb_SipF_ProcessImage.Cat54[0].processed "" UWORD NO_COMPU_METHOD 0 0 0 65535 ECU_ADDRESS 0x400DFC4A /end MEASUREMENT
/begin MEASUREMENT MCore_rb_SipF_ProcessImage.Cat54[0].snapshot "" UWORD NO_COMPU_METHOD 0 0 0 65535 ECU_ADDRESS 0x400DFC3C /end MEASUREMENT
/begin MEASUREMENT MCore_rb_SipF_ProcessImage.Cat54[0].snapshotDuty "" UWORD NO_COMPU_METHOD 0 0 0 65535 ECU_ADDRESS 0x400DFC3E /end MEASUREMENT
/begin MEASUREMENT MCore_rb_SipF_ProcessImage.Cat54[0].snapshotPeriod "" UWORD NO_COMPU_METHOD 0 0 0 65535 ECU_ADDRESS 0x400DFC40 /end MEASUREMENT
/begin MEASUREMENT MCore_rb_SipF_ProcessImage.Cat54[0].switches "" UBYTE NO_COMPU_METHOD 0 0 0 255 ECU_ADDRESS 0x400DFC4E /end MEASUREMENT
/begin MEASUREMENT MCore_rb_SipF_ProcessImage.Cat54[0].switches.mcalInputDisconnect "" SBYTE rb_SipF_ProcessImage.Cat54[0].switches.mcalInputDisconnect.CONVERSION 0 0 -128 127 ECU_ADDRESS 0x400DFC4E /end MEASUREMENT
/begin MEASUREMENT MCore_rb_SipF_ProcessImage.Cat54[0].switches.sipfInputDisconnect "" SBYTE rb_SipF_ProcessImage.Cat54[0].switches.sipfInputDisconnect.CONVERSION 0 0 -128 127 ECU_ADDRESS 0x400DFC4F /end MEASUREMENT
/begin MEASUREMENT MCore_rb_SipF_ProcessImage.Cat55 "" UBYTE NO_COMPU_METHOD 0 0 0 255 ECU_ADDRESS 0x400DFC50 /end MEASUREMENT
/begin MEASUREMENT MCore_rb_SipF_ProcessImage.Cat55[0].processed "" UWORD NO_COMPU_METHOD 0 0 0 65535 ECU_ADDRESS 0x400DFC52 /end MEASUREMENT
/begin MEASUREMENT MCore_rb_SipF_ProcessImage.Cat55[0].snapshot "" UWORD NO_COMPU_METHOD 0 0 0 65535 ECU_ADDRESS 0x400DFC50 /end MEASUREMENT
/begin MEASUREMENT MCore_rb_SipF_ProcessImage.Cat55[0].switches "" UBYTE NO_COMPU_METHOD 0 0 0 255 ECU_ADDRESS 0x400DFC54 /end MEASUREMENT
/begin MEASUREMENT MCore_rb_SipF_ProcessImage.Cat55[0].switches.mcalInputDisconnect "" SBYTE rb_SipF_ProcessImage.Cat55[0].switches.mcalInputDisconnect.CONVERSION 0 0 -128 127 ECU_ADDRESS 0x400DFC54 /end MEASUREMENT
/begin MEASUREMENT MCore_rb_SipF_ProcessImage.Cat55[0].switches.sipfInputDisconnect "" SBYTE rb_SipF_ProcessImage.Cat55[0].switches.sipfInputDisconnect.CONVERSION 0 0 -128 127 ECU_ADDRESS 0x400DFC55 /end MEASUREMENT
/begin MEASUREMENT MCore_rb_SopF_ProcessImage.Cat10 "" UBYTE NO_COMPU_METHOD 0 0 0 255 ECU_ADDRESS 0x400E0148 /end MEASUREMENT
/begin MEASUREMENT MCore_rb_SopF_ProcessImage.Cat10[0].bridgeData "" UBYTE NO_COMPU_METHOD 0 0 0 255 ECU_ADDRESS 0x400E0148 /end MEASUREMENT
/begin MEASUREMENT MCore_rb_SopF_ProcessImage.Cat10[0].bridgeData.applValuePwm "" UWORD NO_COMPU_METHOD 0 0 0 65535 ECU_ADDRESS 0x400E014A /end MEASUREMENT
/begin MEASUREMENT MCore_rb_SopF_ProcessImage.Cat10[0].bridgeData.applValueState "" SBYTE rb_SopF_ProcessImage.Cat10[0].bridgeData.applValueState.CONVERSION 0 0 -128 127 ECU_ADDRESS 0x400E0148 /end MEASUREMENT
/begin MEASUREMENT MCore_rb_SopF_ProcessImage.Cat10[0].bridgeData.brakeTimer "" UWORD NO_COMPU_METHOD 0 0 0 65535 ECU_ADDRESS 0x400E014E /end MEASUREMENT
/begin MEASUREMENT MCore_rb_SopF_ProcessImage.Cat10[0].bridgeData.bridgeState "" SBYTE rb_SopF_ProcessImage.Cat10[0].bridgeData.bridgeState.CONVERSION 0 0 -128 127 ECU_ADDRESS 0x400E014C /end MEASUREMENT
/begin MEASUREMENT MCore_rb_SopF_ProcessImage.Cat10[0].bridgeData.processedA "" UWORD NO_COMPU_METHOD 0 0 0 65535 ECU_ADDRESS 0x400E0150 /end MEASUREMENT
/begin MEASUREMENT MCore_rb_SopF_ProcessImage.Cat10[0].bridgeData.processedB "" UWORD NO_COMPU_METHOD 0 0 0 65535 ECU_ADDRESS 0x400E0152 /end MEASUREMENT
/begin MEASUREMENT MCore_rb_SopF_ProcessImage.Cat10[0].bridgeData.processedPwm "" UWORD NO_COMPU_METHOD 0 0 0 65535 ECU_ADDRESS 0x400E0154 /end MEASUREMENT
/begin MEASUREMENT MCore_rb_SopF_ProcessImage.Cat10[0].switches "" UBYTE NO_COMPU_METHOD 0 0 0 255 ECU_ADDRESS 0x400E0156 /end MEASUREMENT
/begin MEASUREMENT MCore_rb_SopF_ProcessImage.Cat10[0].switches.applDisconnect "" SBYTE rb_SopF_ProcessImage.Cat10[0].switches.applDisconnect.CONVERSION 0 0 -128 127 ECU_ADDRESS 0x400E0156 /end MEASUREMENT
/begin MEASUREMENT MCore_rb_SopF_ProcessImage.Cat10[0].switches.hardwareDisconnect "" SBYTE rb_SopF_ProcessImage.Cat10[0].switches.hardwareDisconnect.CONVERSION 0 0 -128 127 ECU_ADDRESS 0x400E0157 /end MEASUREMENT
/begin MEASUREMENT MCore_rb_SopF_ProcessImage.Cat10[1].bridgeData "" UBYTE NO_COMPU_METHOD 0 0 0 255 ECU_ADDRESS 0x400E0158 /end MEASUREMENT
/begin MEASUREMENT MCore_rb_SopF_ProcessImage.Cat10[1].bridgeData.applValuePwm "" UWORD NO_COMPU_METHOD 0 0 0 65535 ECU_ADDRESS 0x400E015A /end MEASUREMENT
/begin MEASUREMENT MCore_rb_SopF_ProcessImage.Cat10[1].bridgeData.applValueState "" SBYTE rb_SopF_ProcessImage.Cat10[1].bridgeData.applValueState.CONVERSION 0 0 -128 127 ECU_ADDRESS 0x400E0158 /end MEASUREMENT
/begin MEASUREMENT MCore_rb_SopF_ProcessImage.Cat10[1].bridgeData.brakeTimer "" UWORD NO_COMPU_METHOD 0 0 0 65535 ECU_ADDRESS 0x400E015E /end MEASUREMENT
/begin MEASUREMENT MCore_rb_SopF_ProcessImage.Cat10[1].bridgeData.bridgeState "" SBYTE rb_SopF_ProcessImage.Cat10[1].bridgeData.bridgeState.CONVERSION 0 0 -128 127 ECU_ADDRESS 0x400E015C /end MEASUREMENT
/begin MEASUREMENT MCore_rb_SopF_ProcessImage.Cat10[1].bridgeData.processedA "" UWORD NO_COMPU_METHOD 0 0 0 65535 ECU_ADDRESS 0x400E0160 /end MEASUREMENT
/begin MEASUREMENT MCore_rb_SopF_ProcessImage.Cat10[1].bridgeData.processedB "" UWORD NO_COMPU_METHOD 0 0 0 65535 ECU_ADDRESS 0x400E0162 /end MEASUREMENT
/begin MEASUREMENT MCore_rb_SopF_ProcessImage.Cat10[1].bridgeData.processedPwm "" UWORD NO_COMPU_METHOD 0 0 0 65535 ECU_ADDRESS 0x400E0164 /end MEASUREMENT
/begin MEASUREMENT MCore_rb_SopF_ProcessImage.Cat10[1].switches "" UBYTE NO_COMPU_METHOD 0 0 0 255 ECU_ADDRESS 0x400E0166 /end MEASUREMENT
/begin MEASUREMENT MCore_rb_SopF_ProcessImage.Cat10[1].switches.applDisconnect "" SBYTE rb_SopF_ProcessImage.Cat10[1].switches.applDisconnect.CONVERSION 0 0 -128 127 ECU_ADDRESS 0x400E0166 /end MEASUREMENT
/begin MEASUREMENT MCore_rb_SopF_ProcessImage.Cat10[1].switches.hardwareDisconnect "" SBYTE rb_SopF_ProcessImage.Cat10[1].switches.hardwareDisconnect.CONVERSION 0 0 -128 127 ECU_ADDRESS 0x400E0167 /end MEASUREMENT
/begin MEASUREMENT MCore_rb_SopF_ProcessImage.Cat10[2].bridgeData "" UBYTE NO_COMPU_METHOD 0 0 0 255 ECU_ADDRESS 0x400E0168 /end MEASUREMENT
/begin MEASUREMENT MCore_rb_SopF_ProcessImage.Cat10[2].bridgeData.applValuePwm "" UWORD NO_COMPU_METHOD 0 0 0 65535 ECU_ADDRESS 0x400E016A /end MEASUREMENT
/begin MEASUREMENT MCore_rb_SopF_ProcessImage.Cat10[2].bridgeData.applValueState "" SBYTE rb_SopF_ProcessImage.Cat10[2].bridgeData.applValueState.CONVERSION 0 0 -128 127 ECU_ADDRESS 0x400E0168 /end MEASUREMENT
/begin MEASUREMENT MCore_rb_SopF_ProcessImage.Cat10[2].bridgeData.brakeTimer "" UWORD NO_COMPU_METHOD 0 0 0 65535 ECU_ADDRESS 0x400E016E /end MEASUREMENT
/begin MEASUREMENT MCore_rb_SopF_ProcessImage.Cat10[2].bridgeData.bridgeState "" SBYTE rb_SopF_ProcessImage.Cat10[2].bridgeData.bridgeState.CONVERSION 0 0 -128 127 ECU_ADDRESS 0x400E016C /end MEASUREMENT
/begin MEASUREMENT MCore_rb_SopF_ProcessImage.Cat10[2].bridgeData.processedA "" UWORD NO_COMPU_METHOD 0 0 0 65535 ECU_ADDRESS 0x400E0170 /end MEASUREMENT
/begin MEASUREMENT MCore_rb_SopF_ProcessImage.Cat10[2].bridgeData.processedB "" UWORD NO_COMPU_METHOD 0 0 0 65535 ECU_ADDRESS 0x400E0172 /end MEASUREMENT
/begin MEASUREMENT MCore_rb_SopF_ProcessImage.Cat10[2].bridgeData.processedPwm "" UWORD NO_COMPU_METHOD 0 0 0 65535 ECU_ADDRESS 0x400E0174 /end MEASUREMENT
/begin MEASUREMENT MCore_rb_SopF_ProcessImage.Cat10[2].switches "" UBYTE NO_COMPU_METHOD 0 0 0 255 ECU_ADDRESS 0x400E0176 /end MEASUREMENT
/begin MEASUREMENT MCore_rb_SopF_ProcessImage.Cat10[2].switches.applDisconnect "" SBYTE rb_SopF_ProcessImage.Cat10[2].switches.applDisconnect.CONVERSION 0 0 -128 127 ECU_ADDRESS 0x400E0176 /end MEASUREMENT
/begin MEASUREMENT MCore_rb_SopF_ProcessImage.Cat10[2].switches.hardwareDisconnect "" SBYTE rb_SopF_ProcessImage.Cat10[2].switches.hardwareDisconnect.CONVERSION 0 0 -128 127 ECU_ADDRESS 0x400E0177 /end MEASUREMENT
/begin MEASUREMENT MCore_rb_SopF_ProcessImage.Cat11 "" UBYTE NO_COMPU_METHOD 0 0 0 255 ECU_ADDRESS 0x400E0178 /end MEASUREMENT
/begin MEASUREMENT MCore_rb_SopF_ProcessImage.Cat11[0].applValue "" SBYTE NO_COMPU_METHOD 0 0 -128 127 ECU_ADDRESS 0x400E0178 /end MEASUREMENT
/begin MEASUREMENT MCore_rb_SopF_ProcessImage.Cat11[0].processed "" SBYTE NO_COMPU_METHOD 0 0 -128 127 ECU_ADDRESS 0x400E0179 /end MEASUREMENT
/begin MEASUREMENT MCore_rb_SopF_ProcessImage.Cat11[0].switches "" UBYTE NO_COMPU_METHOD 0 0 0 255 ECU_ADDRESS 0x400E017A /end MEASUREMENT
/begin MEASUREMENT MCore_rb_SopF_ProcessImage.Cat11[0].switches.applDisconnect "" SBYTE rb_SopF_ProcessImage.Cat11[0].switches.applDisconnect.CONVERSION 0 0 -128 127 ECU_ADDRESS 0x400E017A /end MEASUREMENT
/begin MEASUREMENT MCore_rb_SopF_ProcessImage.Cat11[0].switches.hardwareDisconnect "" SBYTE rb_SopF_ProcessImage.Cat11[0].switches.hardwareDisconnect.CONVERSION 0 0 -128 127 ECU_ADDRESS 0x400E017B /end MEASUREMENT
/begin MEASUREMENT MCore_rb_SopF_ProcessImage.Cat11[1].applValue "" SBYTE NO_COMPU_METHOD 0 0 -128 127 ECU_ADDRESS 0x400E017C /end MEASUREMENT
/begin MEASUREMENT MCore_rb_SopF_ProcessImage.Cat11[1].processed "" SBYTE NO_COMPU_METHOD 0 0 -128 127 ECU_ADDRESS 0x400E017D /end MEASUREMENT
/begin MEASUREMENT MCore_rb_SopF_ProcessImage.Cat11[1].switches "" UBYTE NO_COMPU_METHOD 0 0 0 255 ECU_ADDRESS 0x400E017E /end MEASUREMENT
/begin MEASUREMENT MCore_rb_SopF_ProcessImage.Cat11[1].switches.applDisconnect "" SBYTE rb_SopF_ProcessImage.Cat11[1].switches.applDisconnect.CONVERSION 0 0 -128 127 ECU_ADDRESS 0x400E017E /end MEASUREMENT
/begin MEASUREMENT MCore_rb_SopF_ProcessImage.Cat11[1].switches.hardwareDisconnect "" SBYTE rb_SopF_ProcessImage.Cat11[1].switches.hardwareDisconnect.CONVERSION 0 0 -128 127 ECU_ADDRESS 0x400E017F /end MEASUREMENT
/begin MEASUREMENT MCore_rb_SopF_ProcessImage.Cat11[2].applValue "" SBYTE NO_COMPU_METHOD 0 0 -128 127 ECU_ADDRESS 0x400E0180 /end MEASUREMENT
/begin MEASUREMENT MCore_rb_SopF_ProcessImage.Cat11[2].processed "" SBYTE NO_COMPU_METHOD 0 0 -128 127 ECU_ADDRESS 0x400E0181 /end MEASUREMENT
/begin MEASUREMENT MCore_rb_SopF_ProcessImage.Cat11[2].switches "" UBYTE NO_COMPU_METHOD 0 0 0 255 ECU_ADDRESS 0x400E0182 /end MEASUREMENT
/begin MEASUREMENT MCore_rb_SopF_ProcessImage.Cat11[2].switches.applDisconnect "" SBYTE rb_SopF_ProcessImage.Cat11[2].switches.applDisconnect.CONVERSION 0 0 -128 127 ECU_ADDRESS 0x400E0182 /end MEASUREMENT
/begin MEASUREMENT MCore_rb_SopF_ProcessImage.Cat11[2].switches.hardwareDisconnect "" SBYTE rb_SopF_ProcessImage.Cat11[2].switches.hardwareDisconnect.CONVERSION 0 0 -128 127 ECU_ADDRESS 0x400E0183 /end MEASUREMENT
/begin MEASUREMENT MCore_rb_SopF_ProcessImage.Cat12 "" UBYTE NO_COMPU_METHOD 0 0 0 255 ECU_ADDRESS 0x400E018C /end MEASUREMENT
/begin MEASUREMENT MCore_rb_SopF_ProcessImage.Cat12[0].applValue "" SBYTE rb_SopF_ProcessImage.Cat12[0].applValue.CONVERSION 0 0 -128 127 ECU_ADDRESS 0x400E018C /end MEASUREMENT
/begin MEASUREMENT MCore_rb_SopF_ProcessImage.Cat12[0].processed "" SBYTE rb_SopF_ProcessImage.Cat12[0].processed.CONVERSION 0 0 -128 127 ECU_ADDRESS 0x400E018D /end MEASUREMENT
/begin MEASUREMENT MCore_rb_SopF_ProcessImage.Cat12[0].switches "" UBYTE NO_COMPU_METHOD 0 0 0 255 ECU_ADDRESS 0x400E018E /end MEASUREMENT
/begin MEASUREMENT MCore_rb_SopF_ProcessImage.Cat12[0].switches.applDisconnect "" SBYTE rb_SopF_ProcessImage.Cat12[0].switches.applDisconnect.CONVERSION 0 0 -128 127 ECU_ADDRESS 0x400E018E /end MEASUREMENT
/begin MEASUREMENT MCore_rb_SopF_ProcessImage.Cat12[0].switches.hardwareDisconnect "" SBYTE rb_SopF_ProcessImage.Cat12[0].switches.hardwareDisconnect.CONVERSION 0 0 -128 127 ECU_ADDRESS 0x400E018F /end MEASUREMENT
/begin MEASUREMENT MCore_rb_SopF_ProcessImage.Cat12[10].applValue "" SBYTE rb_SopF_ProcessImage.Cat12[10].applValue.CONVERSION 0 0 -128 127 ECU_ADDRESS 0x400E01B4 /end MEASUREMENT
/begin MEASUREMENT MCore_rb_SopF_ProcessImage.Cat12[10].processed "" SBYTE rb_SopF_ProcessImage.Cat12[10].processed.CONVERSION 0 0 -128 127 ECU_ADDRESS 0x400E01B5 /end MEASUREMENT
/begin MEASUREMENT MCore_rb_SopF_ProcessImage.Cat12[10].switches "" UBYTE NO_COMPU_METHOD 0 0 0 255 ECU_ADDRESS 0x400E01B6 /end MEASUREMENT
/begin MEASUREMENT MCore_rb_SopF_ProcessImage.Cat12[10].switches.applDisconnect "" SBYTE rb_SopF_ProcessImage.Cat12[10].switches.applDisconnect.CONVERSION 0 0 -128 127 ECU_ADDRESS 0x400E01B6 /end MEASUREMENT
/begin MEASUREMENT MCore_rb_SopF_ProcessImage.Cat12[10].switches.hardwareDisconnect "" SBYTE rb_SopF_ProcessImage.Cat12[10].switches.hardwareDisconnect.CONVERSION 0 0 -128 127 ECU_ADDRESS 0x400E01B7 /end MEASUREMENT
/begin MEASUREMENT MCore_rb_SopF_ProcessImage.Cat12[11].applValue "" SBYTE rb_SopF_ProcessImage.Cat12[11].applValue.CONVERSION 0 0 -128 127 ECU_ADDRESS 0x400E01B8 /end MEASUREMENT
/begin MEASUREMENT MCore_rb_SopF_ProcessImage.Cat12[11].processed "" SBYTE rb_SopF_ProcessImage.Cat12[11].processed.CONVERSION 0 0 -128 127 ECU_ADDRESS 0x400E01B9 /end MEASUREMENT
/begin MEASUREMENT MCore_rb_SopF_ProcessImage.Cat12[11].switches "" UBYTE NO_COMPU_METHOD 0 0 0 255 ECU_ADDRESS 0x400E01BA /end MEASUREMENT
/begin MEASUREMENT MCore_rb_SopF_ProcessImage.Cat12[11].switches.applDisconnect "" SBYTE rb_SopF_ProcessImage.Cat12[11].switches.applDisconnect.CONVERSION 0 0 -128 127 ECU_ADDRESS 0x400E01BA /end MEASUREMENT
/begin MEASUREMENT MCore_rb_SopF_ProcessImage.Cat12[11].switches.hardwareDisconnect "" SBYTE rb_SopF_ProcessImage.Cat12[11].switches.hardwareDisconnect.CONVERSION 0 0 -128 127 ECU_ADDRESS 0x400E01BB /end MEASUREMENT
/begin MEASUREMENT MCore_rb_SopF_ProcessImage.Cat12[1].applValue "" SBYTE rb_SopF_ProcessImage.Cat12[1].applValue.CONVERSION 0 0 -128 127 ECU_ADDRESS 0x400E0190 /end MEASUREMENT
/begin MEASUREMENT MCore_rb_SopF_ProcessImage.Cat12[1].processed "" SBYTE rb_SopF_ProcessImage.Cat12[1].processed.CONVERSION 0 0 -128 127 ECU_ADDRESS 0x400E0191 /end MEASUREMENT
/begin MEASUREMENT MCore_rb_SopF_ProcessImage.Cat12[1].switches "" UBYTE NO_COMPU_METHOD 0 0 0 255 ECU_ADDRESS 0x400E0192 /end MEASUREMENT
/begin MEASUREMENT MCore_rb_SopF_ProcessImage.Cat12[1].switches.applDisconnect "" SBYTE rb_SopF_ProcessImage.Cat12[1].switches.applDisconnect.CONVERSION 0 0 -128 127 ECU_ADDRESS 0x400E0192 /end MEASUREMENT
/begin MEASUREMENT MCore_rb_SopF_ProcessImage.Cat12[1].switches.hardwareDisconnect "" SBYTE rb_SopF_ProcessImage.Cat12[1].switches.hardwareDisconnect.CONVERSION 0 0 -128 127 ECU_ADDRESS 0x400E0193 /end MEASUREMENT
/begin MEASUREMENT MCore_rb_SopF_ProcessImage.Cat12[2].applValue "" SBYTE rb_SopF_ProcessImage.Cat12[2].applValue.CONVERSION 0 0 -128 127 ECU_ADDRESS 0x400E0194 /end MEASUREMENT
/begin MEASUREMENT MCore_rb_SopF_ProcessImage.Cat12[2].processed "" SBYTE rb_SopF_ProcessImage.Cat12[2].processed.CONVERSION 0 0 -128 127 ECU_ADDRESS 0x400E0195 /end MEASUREMENT
/begin MEASUREMENT MCore_rb_SopF_ProcessImage.Cat12[2].switches "" UBYTE NO_COMPU_METHOD 0 0 0 255 ECU_ADDRESS 0x400E0196 /end MEASUREMENT
/begin MEASUREMENT MCore_rb_SopF_ProcessImage.Cat12[2].switches.applDisconnect "" SBYTE rb_SopF_ProcessImage.Cat12[2].switches.applDisconnect.CONVERSION 0 0 -128 127 ECU_ADDRESS 0x400E0196 /end MEASUREMENT
/begin MEASUREMENT MCore_rb_SopF_ProcessImage.Cat12[2].switches.hardwareDisconnect "" SBYTE rb_SopF_ProcessImage.Cat12[2].switches.hardwareDisconnect.CONVERSION 0 0 -128 127 ECU_ADDRESS 0x400E0197 /end MEASUREMENT
/begin MEASUREMENT MCore_rb_SopF_ProcessImage.Cat12[3].applValue "" SBYTE rb_SopF_ProcessImage.Cat12[3].applValue.CONVERSION 0 0 -128 127 ECU_ADDRESS 0x400E0198 /end MEASUREMENT
/begin MEASUREMENT MCore_rb_SopF_ProcessImage.Cat12[3].processed "" SBYTE rb_SopF_ProcessImage.Cat12[3].processed.CONVERSION 0 0 -128 127 ECU_ADDRESS 0x400E0199 /end MEASUREMENT
/begin MEASUREMENT MCore_rb_SopF_ProcessImage.Cat12[3].switches "" UBYTE NO_COMPU_METHOD 0 0 0 255 ECU_ADDRESS 0x400E019A /end MEASUREMENT
/begin MEASUREMENT MCore_rb_SopF_ProcessImage.Cat12[3].switches.applDisconnect "" SBYTE rb_SopF_ProcessImage.Cat12[3].switches.applDisconnect.CONVERSION 0 0 -128 127 ECU_ADDRESS 0x400E019A /end MEASUREMENT
/begin MEASUREMENT MCore_rb_SopF_ProcessImage.Cat12[3].switches.hardwareDisconnect "" SBYTE rb_SopF_ProcessImage.Cat12[3].switches.hardwareDisconnect.CONVERSION 0 0 -128 127 ECU_ADDRESS 0x400E019B /end MEASUREMENT
/begin MEASUREMENT MCore_rb_SopF_ProcessImage.Cat12[4].applValue "" SBYTE rb_SopF_ProcessImage.Cat12[4].applValue.CONVERSION 0 0 -128 127 ECU_ADDRESS 0x400E019C /end MEASUREMENT
/begin MEASUREMENT MCore_rb_SopF_ProcessImage.Cat12[4].processed "" SBYTE rb_SopF_ProcessImage.Cat12[4].processed.CONVERSION 0 0 -128 127 ECU_ADDRESS 0x400E019D /end MEASUREMENT
/begin MEASUREMENT MCore_rb_SopF_ProcessImage.Cat12[4].switches "" UBYTE NO_COMPU_METHOD 0 0 0 255 ECU_ADDRESS 0x400E019E /end MEASUREMENT
/begin MEASUREMENT MCore_rb_SopF_ProcessImage.Cat12[4].switches.applDisconnect "" SBYTE rb_SopF_ProcessImage.Cat12[4].switches.applDisconnect.CONVERSION 0 0 -128 127 ECU_ADDRESS 0x400E019E /end MEASUREMENT
/begin MEASUREMENT MCore_rb_SopF_ProcessImage.Cat12[4].switches.hardwareDisconnect "" SBYTE rb_SopF_ProcessImage.Cat12[4].switches.hardwareDisconnect.CONVERSION 0 0 -128 127 ECU_ADDRESS 0x400E019F /end MEASUREMENT
/begin MEASUREMENT MCore_rb_SopF_ProcessImage.Cat12[5].applValue "" SBYTE rb_SopF_ProcessImage.Cat12[5].applValue.CONVERSION 0 0 -128 127 ECU_ADDRESS 0x400E01A0 /end MEASUREMENT
/begin MEASUREMENT MCore_rb_SopF_ProcessImage.Cat12[5].processed "" SBYTE rb_SopF_ProcessImage.Cat12[5].processed.CONVERSION 0 0 -128 127 ECU_ADDRESS 0x400E01A1 /end MEASUREMENT
/begin MEASUREMENT MCore_rb_SopF_ProcessImage.Cat12[5].switches "" UBYTE NO_COMPU_METHOD 0 0 0 255 ECU_ADDRESS 0x400E01A2 /end MEASUREMENT
/begin MEASUREMENT MCore_rb_SopF_ProcessImage.Cat12[5].switches.applDisconnect "" SBYTE rb_SopF_ProcessImage.Cat12[5].switches.applDisconnect.CONVERSION 0 0 -128 127 ECU_ADDRESS 0x400E01A2 /end MEASUREMENT
/begin MEASUREMENT MCore_rb_SopF_ProcessImage.Cat12[5].switches.hardwareDisconnect "" SBYTE rb_SopF_ProcessImage.Cat12[5].switches.hardwareDisconnect.CONVERSION 0 0 -128 127 ECU_ADDRESS 0x400E01A3 /end MEASUREMENT
/begin MEASUREMENT MCore_rb_SopF_ProcessImage.Cat12[6].applValue "" SBYTE rb_SopF_ProcessImage.Cat12[6].applValue.CONVERSION 0 0 -128 127 ECU_ADDRESS 0x400E01A4 /end MEASUREMENT
/begin MEASUREMENT MCore_rb_SopF_ProcessImage.Cat12[6].processed "" SBYTE rb_SopF_ProcessImage.Cat12[6].processed.CONVERSION 0 0 -128 127 ECU_ADDRESS 0x400E01A5 /end MEASUREMENT
/begin MEASUREMENT MCore_rb_SopF_ProcessImage.Cat12[6].switches "" UBYTE NO_COMPU_METHOD 0 0 0 255 ECU_ADDRESS 0x400E01A6 /end MEASUREMENT
/begin MEASUREMENT MCore_rb_SopF_ProcessImage.Cat12[6].switches.applDisconnect "" SBYTE rb_SopF_ProcessImage.Cat12[6].switches.applDisconnect.CONVERSION 0 0 -128 127 ECU_ADDRESS 0x400E01A6 /end MEASUREMENT
/begin MEASUREMENT MCore_rb_SopF_ProcessImage.Cat12[6].switches.hardwareDisconnect "" SBYTE rb_SopF_ProcessImage.Cat12[6].switches.hardwareDisconnect.CONVERSION 0 0 -128 127 ECU_ADDRESS 0x400E01A7 /end MEASUREMENT
/begin MEASUREMENT MCore_rb_SopF_ProcessImage.Cat12[7].applValue "" SBYTE rb_SopF_ProcessImage.Cat12[7].applValue.CONVERSION 0 0 -128 127 ECU_ADDRESS 0x400E01A8 /end MEASUREMENT
/begin MEASUREMENT MCore_rb_SopF_ProcessImage.Cat12[7].processed "" SBYTE rb_SopF_ProcessImage.Cat12[7].processed.CONVERSION 0 0 -128 127 ECU_ADDRESS 0x400E01A9 /end MEASUREMENT
/begin MEASUREMENT MCore_rb_SopF_ProcessImage.Cat12[7].switches "" UBYTE NO_COMPU_METHOD 0 0 0 255 ECU_ADDRESS 0x400E01AA /end MEASUREMENT
/begin MEASUREMENT MCore_rb_SopF_ProcessImage.Cat12[7].switches.applDisconnect "" SBYTE rb_SopF_ProcessImage.Cat12[7].switches.applDisconnect.CONVERSION 0 0 -128 127 ECU_ADDRESS 0x400E01AA /end MEASUREMENT
/begin MEASUREMENT MCore_rb_SopF_ProcessImage.Cat12[7].switches.hardwareDisconnect "" SBYTE rb_SopF_ProcessImage.Cat12[7].switches.hardwareDisconnect.CONVERSION 0 0 -128 127 ECU_ADDRESS 0x400E01AB /end MEASUREMENT
/begin MEASUREMENT MCore_rb_SopF_ProcessImage.Cat12[8].applValue "" SBYTE rb_SopF_ProcessImage.Cat12[8].applValue.CONVERSION 0 0 -128 127 ECU_ADDRESS 0x400E01AC /end MEASUREMENT
/begin MEASUREMENT MCore_rb_SopF_ProcessImage.Cat12[8].processed "" SBYTE rb_SopF_ProcessImage.Cat12[8].processed.CONVERSION 0 0 -128 127 ECU_ADDRESS 0x400E01AD /end MEASUREMENT
/begin MEASUREMENT MCore_rb_SopF_ProcessImage.Cat12[8].switches "" UBYTE NO_COMPU_METHOD 0 0 0 255 ECU_ADDRESS 0x400E01AE /end MEASUREMENT
/begin MEASUREMENT MCore_rb_SopF_ProcessImage.Cat12[8].switches.applDisconnect "" SBYTE rb_SopF_ProcessImage.Cat12[8].switches.applDisconnect.CONVERSION 0 0 -128 127 ECU_ADDRESS 0x400E01AE /end MEASUREMENT
/begin MEASUREMENT MCore_rb_SopF_ProcessImage.Cat12[8].switches.hardwareDisconnect "" SBYTE rb_SopF_ProcessImage.Cat12[8].switches.hardwareDisconnect.CONVERSION 0 0 -128 127 ECU_ADDRESS 0x400E01AF /end MEASUREMENT
/begin MEASUREMENT MCore_rb_SopF_ProcessImage.Cat12[9].applValue "" SBYTE rb_SopF_ProcessImage.Cat12[9].applValue.CONVERSION 0 0 -128 127 ECU_ADDRESS 0x400E01B0 /end MEASUREMENT
/begin MEASUREMENT MCore_rb_SopF_ProcessImage.Cat12[9].processed "" SBYTE rb_SopF_ProcessImage.Cat12[9].processed.CONVERSION 0 0 -128 127 ECU_ADDRESS 0x400E01B1 /end MEASUREMENT
/begin MEASUREMENT MCore_rb_SopF_ProcessImage.Cat12[9].switches "" UBYTE NO_COMPU_METHOD 0 0 0 255 ECU_ADDRESS 0x400E01B2 /end MEASUREMENT
/begin MEASUREMENT MCore_rb_SopF_ProcessImage.Cat12[9].switches.applDisconnect "" SBYTE rb_SopF_ProcessImage.Cat12[9].switches.applDisconnect.CONVERSION 0 0 -128 127 ECU_ADDRESS 0x400E01B2 /end MEASUREMENT
/begin MEASUREMENT MCore_rb_SopF_ProcessImage.Cat12[9].switches.hardwareDisconnect "" SBYTE rb_SopF_ProcessImage.Cat12[9].switches.hardwareDisconnect.CONVERSION 0 0 -128 127 ECU_ADDRESS 0x400E01B3 /end MEASUREMENT
/begin MEASUREMENT MCore_rb_SopF_ProcessImage.Cat13 "" UBYTE NO_COMPU_METHOD 0 0 0 255 ECU_ADDRESS 0x400E01BC /end MEASUREMENT
/begin MEASUREMENT MCore_rb_SopF_ProcessImage.Cat13[0].bridgeData "" UBYTE NO_COMPU_METHOD 0 0 0 255 ECU_ADDRESS 0x400E01BC /end MEASUREMENT
/begin MEASUREMENT MCore_rb_SopF_ProcessImage.Cat13[0].bridgeData.applValueState "" SBYTE rb_SopF_ProcessImage.Cat13[0].bridgeData.applValueState.CONVERSION 0 0 -128 127 ECU_ADDRESS 0x400E01BC /end MEASUREMENT
/begin MEASUREMENT MCore_rb_SopF_ProcessImage.Cat13[0].bridgeData.blankingTimer "" UWORD NO_COMPU_METHOD 0 0 0 65535 ECU_ADDRESS 0x400E01BE /end MEASUREMENT
/begin MEASUREMENT MCore_rb_SopF_ProcessImage.Cat13[0].bridgeData.bridgeState "" SBYTE rb_SopF_ProcessImage.Cat13[0].bridgeData.bridgeState.CONVERSION 0 0 -128 127 ECU_ADDRESS 0x400E01BD /end MEASUREMENT
/begin MEASUREMENT MCore_rb_SopF_ProcessImage.Cat13[0].bridgeData.processedHs "" UWORD NO_COMPU_METHOD 0 0 0 65535 ECU_ADDRESS 0x400E01C0 /end MEASUREMENT
/begin MEASUREMENT MCore_rb_SopF_ProcessImage.Cat13[0].bridgeData.processedLs "" UWORD NO_COMPU_METHOD 0 0 0 65535 ECU_ADDRESS 0x400E01C2 /end MEASUREMENT
/begin MEASUREMENT MCore_rb_SopF_ProcessImage.Cat13[0].switches "" UBYTE NO_COMPU_METHOD 0 0 0 255 ECU_ADDRESS 0x400E01C4 /end MEASUREMENT
/begin MEASUREMENT MCore_rb_SopF_ProcessImage.Cat13[0].switches.applDisconnect "" SBYTE rb_SopF_ProcessImage.Cat13[0].switches.applDisconnect.CONVERSION 0 0 -128 127 ECU_ADDRESS 0x400E01C4 /end MEASUREMENT
/begin MEASUREMENT MCore_rb_SopF_ProcessImage.Cat13[0].switches.hardwareDisconnect "" SBYTE rb_SopF_ProcessImage.Cat13[0].switches.hardwareDisconnect.CONVERSION 0 0 -128 127 ECU_ADDRESS 0x400E01C5 /end MEASUREMENT
/begin MEASUREMENT MCore_rb_SopF_ProcessImage.Cat2 "" UBYTE NO_COMPU_METHOD 0 0 0 255 ECU_ADDRESS 0x400DFFF8 /end MEASUREMENT
/begin MEASUREMENT MCore_rb_SopF_ProcessImage.Cat2[0].applValue "" UWORD NO_COMPU_METHOD 0 0 0 65535 ECU_ADDRESS 0x400DFFF8 /end MEASUREMENT
/begin MEASUREMENT MCore_rb_SopF_ProcessImage.Cat2[0].processed "" UWORD NO_COMPU_METHOD 0 0 0 65535 ECU_ADDRESS 0x400DFFFA /end MEASUREMENT
/begin MEASUREMENT MCore_rb_SopF_ProcessImage.Cat2[0].switches "" UBYTE NO_COMPU_METHOD 0 0 0 255 ECU_ADDRESS 0x400DFFFC /end MEASUREMENT
/begin MEASUREMENT MCore_rb_SopF_ProcessImage.Cat2[0].switches.applDisconnect "" SBYTE rb_SopF_ProcessImage.Cat2[0].switches.applDisconnect.CONVERSION 0 0 -128 127 ECU_ADDRESS 0x400DFFFC /end MEASUREMENT
/begin MEASUREMENT MCore_rb_SopF_ProcessImage.Cat2[0].switches.hardwareDisconnect "" SBYTE rb_SopF_ProcessImage.Cat2[0].switches.hardwareDisconnect.CONVERSION 0 0 -128 127 ECU_ADDRESS 0x400DFFFD /end MEASUREMENT
/begin MEASUREMENT MCore_rb_SopF_ProcessImage.Cat2[10].applValue "" UWORD NO_COMPU_METHOD 0 0 0 65535 ECU_ADDRESS 0x400E0034 /end MEASUREMENT
/begin MEASUREMENT MCore_rb_SopF_ProcessImage.Cat2[10].processed "" UWORD NO_COMPU_METHOD 0 0 0 65535 ECU_ADDRESS 0x400E0036 /end MEASUREMENT
/begin MEASUREMENT MCore_rb_SopF_ProcessImage.Cat2[10].switches "" UBYTE NO_COMPU_METHOD 0 0 0 255 ECU_ADDRESS 0x400E0038 /end MEASUREMENT
/begin MEASUREMENT MCore_rb_SopF_ProcessImage.Cat2[10].switches.applDisconnect "" SBYTE rb_SopF_ProcessImage.Cat2[10].switches.applDisconnect.CONVERSION 0 0 -128 127 ECU_ADDRESS 0x400E0038 /end MEASUREMENT
/begin MEASUREMENT MCore_rb_SopF_ProcessImage.Cat2[10].switches.hardwareDisconnect "" SBYTE rb_SopF_ProcessImage.Cat2[10].switches.hardwareDisconnect.CONVERSION 0 0 -128 127 ECU_ADDRESS 0x400E0039 /end MEASUREMENT
/begin MEASUREMENT MCore_rb_SopF_ProcessImage.Cat2[11].applValue "" UWORD NO_COMPU_METHOD 0 0 0 65535 ECU_ADDRESS 0x400E003A /end MEASUREMENT
/begin MEASUREMENT MCore_rb_SopF_ProcessImage.Cat2[11].processed "" UWORD NO_COMPU_METHOD 0 0 0 65535 ECU_ADDRESS 0x400E003C /end MEASUREMENT
/begin MEASUREMENT MCore_rb_SopF_ProcessImage.Cat2[11].switches "" UBYTE NO_COMPU_METHOD 0 0 0 255 ECU_ADDRESS 0x400E003E /end MEASUREMENT
/begin MEASUREMENT MCore_rb_SopF_ProcessImage.Cat2[11].switches.applDisconnect "" SBYTE rb_SopF_ProcessImage.Cat2[11].switches.applDisconnect.CONVERSION 0 0 -128 127 ECU_ADDRESS 0x400E003E /end MEASUREMENT
/begin MEASUREMENT MCore_rb_SopF_ProcessImage.Cat2[11].switches.hardwareDisconnect "" SBYTE rb_SopF_ProcessImage.Cat2[11].switches.hardwareDisconnect.CONVERSION 0 0 -128 127 ECU_ADDRESS 0x400E003F /end MEASUREMENT
/begin MEASUREMENT MCore_rb_SopF_ProcessImage.Cat2[12].applValue "" UWORD NO_COMPU_METHOD 0 0 0 65535 ECU_ADDRESS 0x400E0040 /end MEASUREMENT
/begin MEASUREMENT MCore_rb_SopF_ProcessImage.Cat2[12].processed "" UWORD NO_COMPU_METHOD 0 0 0 65535 ECU_ADDRESS 0x400E0042 /end MEASUREMENT
/begin MEASUREMENT MCore_rb_SopF_ProcessImage.Cat2[12].switches "" UBYTE NO_COMPU_METHOD 0 0 0 255 ECU_ADDRESS 0x400E0044 /end MEASUREMENT
/begin MEASUREMENT MCore_rb_SopF_ProcessImage.Cat2[12].switches.applDisconnect "" SBYTE rb_SopF_ProcessImage.Cat2[12].switches.applDisconnect.CONVERSION 0 0 -128 127 ECU_ADDRESS 0x400E0044 /end MEASUREMENT
/begin MEASUREMENT MCore_rb_SopF_ProcessImage.Cat2[12].switches.hardwareDisconnect "" SBYTE rb_SopF_ProcessImage.Cat2[12].switches.hardwareDisconnect.CONVERSION 0 0 -128 127 ECU_ADDRESS 0x400E0045 /end MEASUREMENT
/begin MEASUREMENT MCore_rb_SopF_ProcessImage.Cat2[13].applValue "" UWORD NO_COMPU_METHOD 0 0 0 65535 ECU_ADDRESS 0x400E0046 /end MEASUREMENT
/begin MEASUREMENT MCore_rb_SopF_ProcessImage.Cat2[13].processed "" UWORD NO_COMPU_METHOD 0 0 0 65535 ECU_ADDRESS 0x400E0048 /end MEASUREMENT
/begin MEASUREMENT MCore_rb_SopF_ProcessImage.Cat2[13].switches "" UBYTE NO_COMPU_METHOD 0 0 0 255 ECU_ADDRESS 0x400E004A /end MEASUREMENT
/begin MEASUREMENT MCore_rb_SopF_ProcessImage.Cat2[13].switches.applDisconnect "" SBYTE rb_SopF_ProcessImage.Cat2[13].switches.applDisconnect.CONVERSION 0 0 -128 127 ECU_ADDRESS 0x400E004A /end MEASUREMENT
/begin MEASUREMENT MCore_rb_SopF_ProcessImage.Cat2[13].switches.hardwareDisconnect "" SBYTE rb_SopF_ProcessImage.Cat2[13].switches.hardwareDisconnect.CONVERSION 0 0 -128 127 ECU_ADDRESS 0x400E004B /end MEASUREMENT
/begin MEASUREMENT MCore_rb_SopF_ProcessImage.Cat2[14].applValue "" UWORD NO_COMPU_METHOD 0 0 0 65535 ECU_ADDRESS 0x400E004C /end MEASUREMENT
/begin MEASUREMENT MCore_rb_SopF_ProcessImage.Cat2[14].processed "" UWORD NO_COMPU_METHOD 0 0 0 65535 ECU_ADDRESS 0x400E004E /end MEASUREMENT
/begin MEASUREMENT MCore_rb_SopF_ProcessImage.Cat2[14].switches "" UBYTE NO_COMPU_METHOD 0 0 0 255 ECU_ADDRESS 0x400E0050 /end MEASUREMENT
/begin MEASUREMENT MCore_rb_SopF_ProcessImage.Cat2[14].switches.applDisconnect "" SBYTE rb_SopF_ProcessImage.Cat2[14].switches.applDisconnect.CONVERSION 0 0 -128 127 ECU_ADDRESS 0x400E0050 /end MEASUREMENT
/begin MEASUREMENT MCore_rb_SopF_ProcessImage.Cat2[14].switches.hardwareDisconnect "" SBYTE rb_SopF_ProcessImage.Cat2[14].switches.hardwareDisconnect.CONVERSION 0 0 -128 127 ECU_ADDRESS 0x400E0051 /end MEASUREMENT
/begin MEASUREMENT MCore_rb_SopF_ProcessImage.Cat2[15].applValue "" UWORD NO_COMPU_METHOD 0 0 0 65535 ECU_ADDRESS 0x400E0052 /end MEASUREMENT
/begin MEASUREMENT MCore_rb_SopF_ProcessImage.Cat2[15].processed "" UWORD NO_COMPU_METHOD 0 0 0 65535 ECU_ADDRESS 0x400E0054 /end MEASUREMENT
/begin MEASUREMENT MCore_rb_SopF_ProcessImage.Cat2[15].switches "" UBYTE NO_COMPU_METHOD 0 0 0 255 ECU_ADDRESS 0x400E0056 /end MEASUREMENT
/begin MEASUREMENT MCore_rb_SopF_ProcessImage.Cat2[15].switches.applDisconnect "" SBYTE rb_SopF_ProcessImage.Cat2[15].switches.applDisconnect.CONVERSION 0 0 -128 127 ECU_ADDRESS 0x400E0056 /end MEASUREMENT
/begin MEASUREMENT MCore_rb_SopF_ProcessImage.Cat2[15].switches.hardwareDisconnect "" SBYTE rb_SopF_ProcessImage.Cat2[15].switches.hardwareDisconnect.CONVERSION 0 0 -128 127 ECU_ADDRESS 0x400E0057 /end MEASUREMENT
/begin MEASUREMENT MCore_rb_SopF_ProcessImage.Cat2[16].applValue "" UWORD NO_COMPU_METHOD 0 0 0 65535 ECU_ADDRESS 0x400E0058 /end MEASUREMENT
/begin MEASUREMENT MCore_rb_SopF_ProcessImage.Cat2[16].processed "" UWORD NO_COMPU_METHOD 0 0 0 65535 ECU_ADDRESS 0x400E005A /end MEASUREMENT
/begin MEASUREMENT MCore_rb_SopF_ProcessImage.Cat2[16].switches "" UBYTE NO_COMPU_METHOD 0 0 0 255 ECU_ADDRESS 0x400E005C /end MEASUREMENT
/begin MEASUREMENT MCore_rb_SopF_ProcessImage.Cat2[16].switches.applDisconnect "" SBYTE rb_SopF_ProcessImage.Cat2[16].switches.applDisconnect.CONVERSION 0 0 -128 127 ECU_ADDRESS 0x400E005C /end MEASUREMENT
/begin MEASUREMENT MCore_rb_SopF_ProcessImage.Cat2[16].switches.hardwareDisconnect "" SBYTE rb_SopF_ProcessImage.Cat2[16].switches.hardwareDisconnect.CONVERSION 0 0 -128 127 ECU_ADDRESS 0x400E005D /end MEASUREMENT
/begin MEASUREMENT MCore_rb_SopF_ProcessImage.Cat2[17].applValue "" UWORD NO_COMPU_METHOD 0 0 0 65535 ECU_ADDRESS 0x400E005E /end MEASUREMENT
/begin MEASUREMENT MCore_rb_SopF_ProcessImage.Cat2[17].processed "" UWORD NO_COMPU_METHOD 0 0 0 65535 ECU_ADDRESS 0x400E0060 /end MEASUREMENT
/begin MEASUREMENT MCore_rb_SopF_ProcessImage.Cat2[17].switches "" UBYTE NO_COMPU_METHOD 0 0 0 255 ECU_ADDRESS 0x400E0062 /end MEASUREMENT
/begin MEASUREMENT MCore_rb_SopF_ProcessImage.Cat2[17].switches.applDisconnect "" SBYTE rb_SopF_ProcessImage.Cat2[17].switches.applDisconnect.CONVERSION 0 0 -128 127 ECU_ADDRESS 0x400E0062 /end MEASUREMENT
/begin MEASUREMENT MCore_rb_SopF_ProcessImage.Cat2[17].switches.hardwareDisconnect "" SBYTE rb_SopF_ProcessImage.Cat2[17].switches.hardwareDisconnect.CONVERSION 0 0 -128 127 ECU_ADDRESS 0x400E0063 /end MEASUREMENT
/begin MEASUREMENT MCore_rb_SopF_ProcessImage.Cat2[18].applValue "" UWORD NO_COMPU_METHOD 0 0 0 65535 ECU_ADDRESS 0x400E0064 /end MEASUREMENT
/begin MEASUREMENT MCore_rb_SopF_ProcessImage.Cat2[18].processed "" UWORD NO_COMPU_METHOD 0 0 0 65535 ECU_ADDRESS 0x400E0066 /end MEASUREMENT
/begin MEASUREMENT MCore_rb_SopF_ProcessImage.Cat2[18].switches "" UBYTE NO_COMPU_METHOD 0 0 0 255 ECU_ADDRESS 0x400E0068 /end MEASUREMENT
/begin MEASUREMENT MCore_rb_SopF_ProcessImage.Cat2[18].switches.applDisconnect "" SBYTE rb_SopF_ProcessImage.Cat2[18].switches.applDisconnect.CONVERSION 0 0 -128 127 ECU_ADDRESS 0x400E0068 /end MEASUREMENT
/begin MEASUREMENT MCore_rb_SopF_ProcessImage.Cat2[18].switches.hardwareDisconnect "" SBYTE rb_SopF_ProcessImage.Cat2[18].switches.hardwareDisconnect.CONVERSION 0 0 -128 127 ECU_ADDRESS 0x400E0069 /end MEASUREMENT
/begin MEASUREMENT MCore_rb_SopF_ProcessImage.Cat2[19].applValue "" UWORD NO_COMPU_METHOD 0 0 0 65535 ECU_ADDRESS 0x400E006A /end MEASUREMENT
/begin MEASUREMENT MCore_rb_SopF_ProcessImage.Cat2[19].processed "" UWORD NO_COMPU_METHOD 0 0 0 65535 ECU_ADDRESS 0x400E006C /end MEASUREMENT
/begin MEASUREMENT MCore_rb_SopF_ProcessImage.Cat2[19].switches "" UBYTE NO_COMPU_METHOD 0 0 0 255 ECU_ADDRESS 0x400E006E /end MEASUREMENT
/begin MEASUREMENT MCore_rb_SopF_ProcessImage.Cat2[19].switches.applDisconnect "" SBYTE rb_SopF_ProcessImage.Cat2[19].switches.applDisconnect.CONVERSION 0 0 -128 127 ECU_ADDRESS 0x400E006E /end MEASUREMENT
/begin MEASUREMENT MCore_rb_SopF_ProcessImage.Cat2[19].switches.hardwareDisconnect "" SBYTE rb_SopF_ProcessImage.Cat2[19].switches.hardwareDisconnect.CONVERSION 0 0 -128 127 ECU_ADDRESS 0x400E006F /end MEASUREMENT
/begin MEASUREMENT MCore_rb_SopF_ProcessImage.Cat2[1].applValue "" UWORD NO_COMPU_METHOD 0 0 0 65535 ECU_ADDRESS 0x400DFFFE /end MEASUREMENT
/begin MEASUREMENT MCore_rb_SopF_ProcessImage.Cat2[1].processed "" UWORD NO_COMPU_METHOD 0 0 0 65535 ECU_ADDRESS 0x400E0000 /end MEASUREMENT
/begin MEASUREMENT MCore_rb_SopF_ProcessImage.Cat2[1].switches "" UBYTE NO_COMPU_METHOD 0 0 0 255 ECU_ADDRESS 0x400E0002 /end MEASUREMENT
/begin MEASUREMENT MCore_rb_SopF_ProcessImage.Cat2[1].switches.applDisconnect "" SBYTE rb_SopF_ProcessImage.Cat2[1].switches.applDisconnect.CONVERSION 0 0 -128 127 ECU_ADDRESS 0x400E0002 /end MEASUREMENT
/begin MEASUREMENT MCore_rb_SopF_ProcessImage.Cat2[1].switches.hardwareDisconnect "" SBYTE rb_SopF_ProcessImage.Cat2[1].switches.hardwareDisconnect.CONVERSION 0 0 -128 127 ECU_ADDRESS 0x400E0003 /end MEASUREMENT
/begin MEASUREMENT MCore_rb_SopF_ProcessImage.Cat2[20].applValue "" UWORD NO_COMPU_METHOD 0 0 0 65535 ECU_ADDRESS 0x400E0070 /end MEASUREMENT
/begin MEASUREMENT MCore_rb_SopF_ProcessImage.Cat2[20].processed "" UWORD NO_COMPU_METHOD 0 0 0 65535 ECU_ADDRESS 0x400E0072 /end MEASUREMENT
/begin MEASUREMENT MCore_rb_SopF_ProcessImage.Cat2[20].switches "" UBYTE NO_COMPU_METHOD 0 0 0 255 ECU_ADDRESS 0x400E0074 /end MEASUREMENT
/begin MEASUREMENT MCore_rb_SopF_ProcessImage.Cat2[20].switches.applDisconnect "" SBYTE rb_SopF_ProcessImage.Cat2[20].switches.applDisconnect.CONVERSION 0 0 -128 127 ECU_ADDRESS 0x400E0074 /end MEASUREMENT
/begin MEASUREMENT MCore_rb_SopF_ProcessImage.Cat2[20].switches.hardwareDisconnect "" SBYTE rb_SopF_ProcessImage.Cat2[20].switches.hardwareDisconnect.CONVERSION 0 0 -128 127 ECU_ADDRESS 0x400E0075 /end MEASUREMENT
/begin MEASUREMENT MCore_rb_SopF_ProcessImage.Cat2[21].applValue "" UWORD NO_COMPU_METHOD 0 0 0 65535 ECU_ADDRESS 0x400E0076 /end MEASUREMENT
/begin MEASUREMENT MCore_rb_SopF_ProcessImage.Cat2[21].processed "" UWORD NO_COMPU_METHOD 0 0 0 65535 ECU_ADDRESS 0x400E0078 /end MEASUREMENT
/begin MEASUREMENT MCore_rb_SopF_ProcessImage.Cat2[21].switches "" UBYTE NO_COMPU_METHOD 0 0 0 255 ECU_ADDRESS 0x400E007A /end MEASUREMENT
/begin MEASUREMENT MCore_rb_SopF_ProcessImage.Cat2[21].switches.applDisconnect "" SBYTE rb_SopF_ProcessImage.Cat2[21].switches.applDisconnect.CONVERSION 0 0 -128 127 ECU_ADDRESS 0x400E007A /end MEASUREMENT
/begin MEASUREMENT MCore_rb_SopF_ProcessImage.Cat2[21].switches.hardwareDisconnect "" SBYTE rb_SopF_ProcessImage.Cat2[21].switches.hardwareDisconnect.CONVERSION 0 0 -128 127 ECU_ADDRESS 0x400E007B /end MEASUREMENT
/begin MEASUREMENT MCore_rb_SopF_ProcessImage.Cat2[22].applValue "" UWORD NO_COMPU_METHOD 0 0 0 65535 ECU_ADDRESS 0x400E007C /end MEASUREMENT
/begin MEASUREMENT MCore_rb_SopF_ProcessImage.Cat2[22].processed "" UWORD NO_COMPU_METHOD 0 0 0 65535 ECU_ADDRESS 0x400E007E /end MEASUREMENT
/begin MEASUREMENT MCore_rb_SopF_ProcessImage.Cat2[22].switches "" UBYTE NO_COMPU_METHOD 0 0 0 255 ECU_ADDRESS 0x400E0080 /end MEASUREMENT
/begin MEASUREMENT MCore_rb_SopF_ProcessImage.Cat2[22].switches.applDisconnect "" SBYTE rb_SopF_ProcessImage.Cat2[22].switches.applDisconnect.CONVERSION 0 0 -128 127 ECU_ADDRESS 0x400E0080 /end MEASUREMENT
/begin MEASUREMENT MCore_rb_SopF_ProcessImage.Cat2[22].switches.hardwareDisconnect "" SBYTE rb_SopF_ProcessImage.Cat2[22].switches.hardwareDisconnect.CONVERSION 0 0 -128 127 ECU_ADDRESS 0x400E0081 /end MEASUREMENT
/begin MEASUREMENT MCore_rb_SopF_ProcessImage.Cat2[23].applValue "" UWORD NO_COMPU_METHOD 0 0 0 65535 ECU_ADDRESS 0x400E0082 /end MEASUREMENT
/begin MEASUREMENT MCore_rb_SopF_ProcessImage.Cat2[23].processed "" UWORD NO_COMPU_METHOD 0 0 0 65535 ECU_ADDRESS 0x400E0084 /end MEASUREMENT
/begin MEASUREMENT MCore_rb_SopF_ProcessImage.Cat2[23].switches "" UBYTE NO_COMPU_METHOD 0 0 0 255 ECU_ADDRESS 0x400E0086 /end MEASUREMENT
/begin MEASUREMENT MCore_rb_SopF_ProcessImage.Cat2[23].switches.applDisconnect "" SBYTE rb_SopF_ProcessImage.Cat2[23].switches.applDisconnect.CONVERSION 0 0 -128 127 ECU_ADDRESS 0x400E0086 /end MEASUREMENT
/begin MEASUREMENT MCore_rb_SopF_ProcessImage.Cat2[23].switches.hardwareDisconnect "" SBYTE rb_SopF_ProcessImage.Cat2[23].switches.hardwareDisconnect.CONVERSION 0 0 -128 127 ECU_ADDRESS 0x400E0087 /end MEASUREMENT
/begin MEASUREMENT MCore_rb_SopF_ProcessImage.Cat2[24].applValue "" UWORD NO_COMPU_METHOD 0 0 0 65535 ECU_ADDRESS 0x400E0088 /end MEASUREMENT
/begin MEASUREMENT MCore_rb_SopF_ProcessImage.Cat2[24].processed "" UWORD NO_COMPU_METHOD 0 0 0 65535 ECU_ADDRESS 0x400E008A /end MEASUREMENT
/begin MEASUREMENT MCore_rb_SopF_ProcessImage.Cat2[24].switches "" UBYTE NO_COMPU_METHOD 0 0 0 255 ECU_ADDRESS 0x400E008C /end MEASUREMENT
/begin MEASUREMENT MCore_rb_SopF_ProcessImage.Cat2[24].switches.applDisconnect "" SBYTE rb_SopF_ProcessImage.Cat2[24].switches.applDisconnect.CONVERSION 0 0 -128 127 ECU_ADDRESS 0x400E008C /end MEASUREMENT
/begin MEASUREMENT MCore_rb_SopF_ProcessImage.Cat2[24].switches.hardwareDisconnect "" SBYTE rb_SopF_ProcessImage.Cat2[24].switches.hardwareDisconnect.CONVERSION 0 0 -128 127 ECU_ADDRESS 0x400E008D /end MEASUREMENT
/begin MEASUREMENT MCore_rb_SopF_ProcessImage.Cat2[25].applValue "" UWORD NO_COMPU_METHOD 0 0 0 65535 ECU_ADDRESS 0x400E008E /end MEASUREMENT
/begin MEASUREMENT MCore_rb_SopF_ProcessImage.Cat2[25].processed "" UWORD NO_COMPU_METHOD 0 0 0 65535 ECU_ADDRESS 0x400E0090 /end MEASUREMENT
/begin MEASUREMENT MCore_rb_SopF_ProcessImage.Cat2[25].switches "" UBYTE NO_COMPU_METHOD 0 0 0 255 ECU_ADDRESS 0x400E0092 /end MEASUREMENT
/begin MEASUREMENT MCore_rb_SopF_ProcessImage.Cat2[25].switches.applDisconnect "" SBYTE rb_SopF_ProcessImage.Cat2[25].switches.applDisconnect.CONVERSION 0 0 -128 127 ECU_ADDRESS 0x400E0092 /end MEASUREMENT
/begin MEASUREMENT MCore_rb_SopF_ProcessImage.Cat2[25].switches.hardwareDisconnect "" SBYTE rb_SopF_ProcessImage.Cat2[25].switches.hardwareDisconnect.CONVERSION 0 0 -128 127 ECU_ADDRESS 0x400E0093 /end MEASUREMENT
/begin MEASUREMENT MCore_rb_SopF_ProcessImage.Cat2[26].applValue "" UWORD NO_COMPU_METHOD 0 0 0 65535 ECU_ADDRESS 0x400E0094 /end MEASUREMENT
/begin MEASUREMENT MCore_rb_SopF_ProcessImage.Cat2[26].processed "" UWORD NO_COMPU_METHOD 0 0 0 65535 ECU_ADDRESS 0x400E0096 /end MEASUREMENT
/begin MEASUREMENT MCore_rb_SopF_ProcessImage.Cat2[26].switches "" UBYTE NO_COMPU_METHOD 0 0 0 255 ECU_ADDRESS 0x400E0098 /end MEASUREMENT
/begin MEASUREMENT MCore_rb_SopF_ProcessImage.Cat2[26].switches.applDisconnect "" SBYTE rb_SopF_ProcessImage.Cat2[26].switches.applDisconnect.CONVERSION 0 0 -128 127 ECU_ADDRESS 0x400E0098 /end MEASUREMENT
/begin MEASUREMENT MCore_rb_SopF_ProcessImage.Cat2[26].switches.hardwareDisconnect "" SBYTE rb_SopF_ProcessImage.Cat2[26].switches.hardwareDisconnect.CONVERSION 0 0 -128 127 ECU_ADDRESS 0x400E0099 /end MEASUREMENT
/begin MEASUREMENT MCore_rb_SopF_ProcessImage.Cat2[27].applValue "" UWORD NO_COMPU_METHOD 0 0 0 65535 ECU_ADDRESS 0x400E009A /end MEASUREMENT
/begin MEASUREMENT MCore_rb_SopF_ProcessImage.Cat2[27].processed "" UWORD NO_COMPU_METHOD 0 0 0 65535 ECU_ADDRESS 0x400E009C /end MEASUREMENT
/begin MEASUREMENT MCore_rb_SopF_ProcessImage.Cat2[27].switches "" UBYTE NO_COMPU_METHOD 0 0 0 255 ECU_ADDRESS 0x400E009E /end MEASUREMENT
/begin MEASUREMENT MCore_rb_SopF_ProcessImage.Cat2[27].switches.applDisconnect "" SBYTE rb_SopF_ProcessImage.Cat2[27].switches.applDisconnect.CONVERSION 0 0 -128 127 ECU_ADDRESS 0x400E009E /end MEASUREMENT
/begin MEASUREMENT MCore_rb_SopF_ProcessImage.Cat2[27].switches.hardwareDisconnect "" SBYTE rb_SopF_ProcessImage.Cat2[27].switches.hardwareDisconnect.CONVERSION 0 0 -128 127 ECU_ADDRESS 0x400E009F /end MEASUREMENT
/begin MEASUREMENT MCore_rb_SopF_ProcessImage.Cat2[28].applValue "" UWORD NO_COMPU_METHOD 0 0 0 65535 ECU_ADDRESS 0x400E00A0 /end MEASUREMENT
/begin MEASUREMENT MCore_rb_SopF_ProcessImage.Cat2[28].processed "" UWORD NO_COMPU_METHOD 0 0 0 65535 ECU_ADDRESS 0x400E00A2 /end MEASUREMENT
/begin MEASUREMENT MCore_rb_SopF_ProcessImage.Cat2[28].switches "" UBYTE NO_COMPU_METHOD 0 0 0 255 ECU_ADDRESS 0x400E00A4 /end MEASUREMENT
/begin MEASUREMENT MCore_rb_SopF_ProcessImage.Cat2[28].switches.applDisconnect "" SBYTE rb_SopF_ProcessImage.Cat2[28].switches.applDisconnect.CONVERSION 0 0 -128 127 ECU_ADDRESS 0x400E00A4 /end MEASUREMENT
/begin MEASUREMENT MCore_rb_SopF_ProcessImage.Cat2[28].switches.hardwareDisconnect "" SBYTE rb_SopF_ProcessImage.Cat2[28].switches.hardwareDisconnect.CONVERSION 0 0 -128 127 ECU_ADDRESS 0x400E00A5 /end MEASUREMENT
/begin MEASUREMENT MCore_rb_SopF_ProcessImage.Cat2[29].applValue "" UWORD NO_COMPU_METHOD 0 0 0 65535 ECU_ADDRESS 0x400E00A6 /end MEASUREMENT
/begin MEASUREMENT MCore_rb_SopF_ProcessImage.Cat2[29].processed "" UWORD NO_COMPU_METHOD 0 0 0 65535 ECU_ADDRESS 0x400E00A8 /end MEASUREMENT
/begin MEASUREMENT MCore_rb_SopF_ProcessImage.Cat2[29].switches "" UBYTE NO_COMPU_METHOD 0 0 0 255 ECU_ADDRESS 0x400E00AA /end MEASUREMENT
/begin MEASUREMENT MCore_rb_SopF_ProcessImage.Cat2[29].switches.applDisconnect "" SBYTE rb_SopF_ProcessImage.Cat2[29].switches.applDisconnect.CONVERSION 0 0 -128 127 ECU_ADDRESS 0x400E00AA /end MEASUREMENT
/begin MEASUREMENT MCore_rb_SopF_ProcessImage.Cat2[29].switches.hardwareDisconnect "" SBYTE rb_SopF_ProcessImage.Cat2[29].switches.hardwareDisconnect.CONVERSION 0 0 -128 127 ECU_ADDRESS 0x400E00AB /end MEASUREMENT
/begin MEASUREMENT MCore_rb_SopF_ProcessImage.Cat2[2].applValue "" UWORD NO_COMPU_METHOD 0 0 0 65535 ECU_ADDRESS 0x400E0004 /end MEASUREMENT
/begin MEASUREMENT MCore_rb_SopF_ProcessImage.Cat2[2].processed "" UWORD NO_COMPU_METHOD 0 0 0 65535 ECU_ADDRESS 0x400E0006 /end MEASUREMENT
/begin MEASUREMENT MCore_rb_SopF_ProcessImage.Cat2[2].switches "" UBYTE NO_COMPU_METHOD 0 0 0 255 ECU_ADDRESS 0x400E0008 /end MEASUREMENT
/begin MEASUREMENT MCore_rb_SopF_ProcessImage.Cat2[2].switches.applDisconnect "" SBYTE rb_SopF_ProcessImage.Cat2[2].switches.applDisconnect.CONVERSION 0 0 -128 127 ECU_ADDRESS 0x400E0008 /end MEASUREMENT
/begin MEASUREMENT MCore_rb_SopF_ProcessImage.Cat2[2].switches.hardwareDisconnect "" SBYTE rb_SopF_ProcessImage.Cat2[2].switches.hardwareDisconnect.CONVERSION 0 0 -128 127 ECU_ADDRESS 0x400E0009 /end MEASUREMENT
/begin MEASUREMENT MCore_rb_SopF_ProcessImage.Cat2[30].applValue "" UWORD NO_COMPU_METHOD 0 0 0 65535 ECU_ADDRESS 0x400E00AC /end MEASUREMENT
/begin MEASUREMENT MCore_rb_SopF_ProcessImage.Cat2[30].processed "" UWORD NO_COMPU_METHOD 0 0 0 65535 ECU_ADDRESS 0x400E00AE /end MEASUREMENT
/begin MEASUREMENT MCore_rb_SopF_ProcessImage.Cat2[30].switches "" UBYTE NO_COMPU_METHOD 0 0 0 255 ECU_ADDRESS 0x400E00B0 /end MEASUREMENT
/begin MEASUREMENT MCore_rb_SopF_ProcessImage.Cat2[30].switches.applDisconnect "" SBYTE rb_SopF_ProcessImage.Cat2[30].switches.applDisconnect.CONVERSION 0 0 -128 127 ECU_ADDRESS 0x400E00B0 /end MEASUREMENT
/begin MEASUREMENT MCore_rb_SopF_ProcessImage.Cat2[30].switches.hardwareDisconnect "" SBYTE rb_SopF_ProcessImage.Cat2[30].switches.hardwareDisconnect.CONVERSION 0 0 -128 127 ECU_ADDRESS 0x400E00B1 /end MEASUREMENT
/begin MEASUREMENT MCore_rb_SopF_ProcessImage.Cat2[31].applValue "" UWORD NO_COMPU_METHOD 0 0 0 65535 ECU_ADDRESS 0x400E00B2 /end MEASUREMENT
/begin MEASUREMENT MCore_rb_SopF_ProcessImage.Cat2[31].processed "" UWORD NO_COMPU_METHOD 0 0 0 65535 ECU_ADDRESS 0x400E00B4 /end MEASUREMENT
/begin MEASUREMENT MCore_rb_SopF_ProcessImage.Cat2[31].switches "" UBYTE NO_COMPU_METHOD 0 0 0 255 ECU_ADDRESS 0x400E00B6 /end MEASUREMENT
/begin MEASUREMENT MCore_rb_SopF_ProcessImage.Cat2[31].switches.applDisconnect "" SBYTE rb_SopF_ProcessImage.Cat2[31].switches.applDisconnect.CONVERSION 0 0 -128 127 ECU_ADDRESS 0x400E00B6 /end MEASUREMENT
/begin MEASUREMENT MCore_rb_SopF_ProcessImage.Cat2[31].switches.hardwareDisconnect "" SBYTE rb_SopF_ProcessImage.Cat2[31].switches.hardwareDisconnect.CONVERSION 0 0 -128 127 ECU_ADDRESS 0x400E00B7 /end MEASUREMENT
/begin MEASUREMENT MCore_rb_SopF_ProcessImage.Cat2[32].applValue "" UWORD NO_COMPU_METHOD 0 0 0 65535 ECU_ADDRESS 0x400E00B8 /end MEASUREMENT
/begin MEASUREMENT MCore_rb_SopF_ProcessImage.Cat2[32].processed "" UWORD NO_COMPU_METHOD 0 0 0 65535 ECU_ADDRESS 0x400E00BA /end MEASUREMENT
/begin MEASUREMENT MCore_rb_SopF_ProcessImage.Cat2[32].switches "" UBYTE NO_COMPU_METHOD 0 0 0 255 ECU_ADDRESS 0x400E00BC /end MEASUREMENT
/begin MEASUREMENT MCore_rb_SopF_ProcessImage.Cat2[32].switches.applDisconnect "" SBYTE rb_SopF_ProcessImage.Cat2[32].switches.applDisconnect.CONVERSION 0 0 -128 127 ECU_ADDRESS 0x400E00BC /end MEASUREMENT
/begin MEASUREMENT MCore_rb_SopF_ProcessImage.Cat2[32].switches.hardwareDisconnect "" SBYTE rb_SopF_ProcessImage.Cat2[32].switches.hardwareDisconnect.CONVERSION 0 0 -128 127 ECU_ADDRESS 0x400E00BD /end MEASUREMENT
/begin MEASUREMENT MCore_rb_SopF_ProcessImage.Cat2[33].applValue "" UWORD NO_COMPU_METHOD 0 0 0 65535 ECU_ADDRESS 0x400E00BE /end MEASUREMENT
/begin MEASUREMENT MCore_rb_SopF_ProcessImage.Cat2[33].processed "" UWORD NO_COMPU_METHOD 0 0 0 65535 ECU_ADDRESS 0x400E00C0 /end MEASUREMENT
/begin MEASUREMENT MCore_rb_SopF_ProcessImage.Cat2[33].switches "" UBYTE NO_COMPU_METHOD 0 0 0 255 ECU_ADDRESS 0x400E00C2 /end MEASUREMENT
/begin MEASUREMENT MCore_rb_SopF_ProcessImage.Cat2[33].switches.applDisconnect "" SBYTE rb_SopF_ProcessImage.Cat2[33].switches.applDisconnect.CONVERSION 0 0 -128 127 ECU_ADDRESS 0x400E00C2 /end MEASUREMENT
/begin MEASUREMENT MCore_rb_SopF_ProcessImage.Cat2[33].switches.hardwareDisconnect "" SBYTE rb_SopF_ProcessImage.Cat2[33].switches.hardwareDisconnect.CONVERSION 0 0 -128 127 ECU_ADDRESS 0x400E00C3 /end MEASUREMENT
/begin MEASUREMENT MCore_rb_SopF_ProcessImage.Cat2[34].applValue "" UWORD NO_COMPU_METHOD 0 0 0 65535 ECU_ADDRESS 0x400E00C4 /end MEASUREMENT
/begin MEASUREMENT MCore_rb_SopF_ProcessImage.Cat2[34].processed "" UWORD NO_COMPU_METHOD 0 0 0 65535 ECU_ADDRESS 0x400E00C6 /end MEASUREMENT
/begin MEASUREMENT MCore_rb_SopF_ProcessImage.Cat2[34].switches "" UBYTE NO_COMPU_METHOD 0 0 0 255 ECU_ADDRESS 0x400E00C8 /end MEASUREMENT
/begin MEASUREMENT MCore_rb_SopF_ProcessImage.Cat2[34].switches.applDisconnect "" SBYTE rb_SopF_ProcessImage.Cat2[34].switches.applDisconnect.CONVERSION 0 0 -128 127 ECU_ADDRESS 0x400E00C8 /end MEASUREMENT
/begin MEASUREMENT MCore_rb_SopF_ProcessImage.Cat2[34].switches.hardwareDisconnect "" SBYTE rb_SopF_ProcessImage.Cat2[34].switches.hardwareDisconnect.CONVERSION 0 0 -128 127 ECU_ADDRESS 0x400E00C9 /end MEASUREMENT
/begin MEASUREMENT MCore_rb_SopF_ProcessImage.Cat2[35].applValue "" UWORD NO_COMPU_METHOD 0 0 0 65535 ECU_ADDRESS 0x400E00CA /end MEASUREMENT
/begin MEASUREMENT MCore_rb_SopF_ProcessImage.Cat2[35].processed "" UWORD NO_COMPU_METHOD 0 0 0 65535 ECU_ADDRESS 0x400E00CC /end MEASUREMENT
/begin MEASUREMENT MCore_rb_SopF_ProcessImage.Cat2[35].switches "" UBYTE NO_COMPU_METHOD 0 0 0 255 ECU_ADDRESS 0x400E00CE /end MEASUREMENT
/begin MEASUREMENT MCore_rb_SopF_ProcessImage.Cat2[35].switches.applDisconnect "" SBYTE rb_SopF_ProcessImage.Cat2[35].switches.applDisconnect.CONVERSION 0 0 -128 127 ECU_ADDRESS 0x400E00CE /end MEASUREMENT
/begin MEASUREMENT MCore_rb_SopF_ProcessImage.Cat2[35].switches.hardwareDisconnect "" SBYTE rb_SopF_ProcessImage.Cat2[35].switches.hardwareDisconnect.CONVERSION 0 0 -128 127 ECU_ADDRESS 0x400E00CF /end MEASUREMENT
/begin MEASUREMENT MCore_rb_SopF_ProcessImage.Cat2[36].applValue "" UWORD NO_COMPU_METHOD 0 0 0 65535 ECU_ADDRESS 0x400E00D0 /end MEASUREMENT
/begin MEASUREMENT MCore_rb_SopF_ProcessImage.Cat2[36].processed "" UWORD NO_COMPU_METHOD 0 0 0 65535 ECU_ADDRESS 0x400E00D2 /end MEASUREMENT
/begin MEASUREMENT MCore_rb_SopF_ProcessImage.Cat2[36].switches "" UBYTE NO_COMPU_METHOD 0 0 0 255 ECU_ADDRESS 0x400E00D4 /end MEASUREMENT
/begin MEASUREMENT MCore_rb_SopF_ProcessImage.Cat2[36].switches.applDisconnect "" SBYTE rb_SopF_ProcessImage.Cat2[36].switches.applDisconnect.CONVERSION 0 0 -128 127 ECU_ADDRESS 0x400E00D4 /end MEASUREMENT
/begin MEASUREMENT MCore_rb_SopF_ProcessImage.Cat2[36].switches.hardwareDisconnect "" SBYTE rb_SopF_ProcessImage.Cat2[36].switches.hardwareDisconnect.CONVERSION 0 0 -128 127 ECU_ADDRESS 0x400E00D5 /end MEASUREMENT
/begin MEASUREMENT MCore_rb_SopF_ProcessImage.Cat2[37].applValue "" UWORD NO_COMPU_METHOD 0 0 0 65535 ECU_ADDRESS 0x400E00D6 /end MEASUREMENT
/begin MEASUREMENT MCore_rb_SopF_ProcessImage.Cat2[37].processed "" UWORD NO_COMPU_METHOD 0 0 0 65535 ECU_ADDRESS 0x400E00D8 /end MEASUREMENT
/begin MEASUREMENT MCore_rb_SopF_ProcessImage.Cat2[37].switches "" UBYTE NO_COMPU_METHOD 0 0 0 255 ECU_ADDRESS 0x400E00DA /end MEASUREMENT
/begin MEASUREMENT MCore_rb_SopF_ProcessImage.Cat2[37].switches.applDisconnect "" SBYTE rb_SopF_ProcessImage.Cat2[37].switches.applDisconnect.CONVERSION 0 0 -128 127 ECU_ADDRESS 0x400E00DA /end MEASUREMENT
/begin MEASUREMENT MCore_rb_SopF_ProcessImage.Cat2[37].switches.hardwareDisconnect "" SBYTE rb_SopF_ProcessImage.Cat2[37].switches.hardwareDisconnect.CONVERSION 0 0 -128 127 ECU_ADDRESS 0x400E00DB /end MEASUREMENT
/begin MEASUREMENT MCore_rb_SopF_ProcessImage.Cat2[38].applValue "" UWORD NO_COMPU_METHOD 0 0 0 65535 ECU_ADDRESS 0x400E00DC /end MEASUREMENT
/begin MEASUREMENT MCore_rb_SopF_ProcessImage.Cat2[38].processed "" UWORD NO_COMPU_METHOD 0 0 0 65535 ECU_ADDRESS 0x400E00DE /end MEASUREMENT
/begin MEASUREMENT MCore_rb_SopF_ProcessImage.Cat2[38].switches "" UBYTE NO_COMPU_METHOD 0 0 0 255 ECU_ADDRESS 0x400E00E0 /end MEASUREMENT
/begin MEASUREMENT MCore_rb_SopF_ProcessImage.Cat2[38].switches.applDisconnect "" SBYTE rb_SopF_ProcessImage.Cat2[38].switches.applDisconnect.CONVERSION 0 0 -128 127 ECU_ADDRESS 0x400E00E0 /end MEASUREMENT
/begin MEASUREMENT MCore_rb_SopF_ProcessImage.Cat2[38].switches.hardwareDisconnect "" SBYTE rb_SopF_ProcessImage.Cat2[38].switches.hardwareDisconnect.CONVERSION 0 0 -128 127 ECU_ADDRESS 0x400E00E1 /end MEASUREMENT
/begin MEASUREMENT MCore_rb_SopF_ProcessImage.Cat2[39].applValue "" UWORD NO_COMPU_METHOD 0 0 0 65535 ECU_ADDRESS 0x400E00E2 /end MEASUREMENT
/begin MEASUREMENT MCore_rb_SopF_ProcessImage.Cat2[39].processed "" UWORD NO_COMPU_METHOD 0 0 0 65535 ECU_ADDRESS 0x400E00E4 /end MEASUREMENT
/begin MEASUREMENT MCore_rb_SopF_ProcessImage.Cat2[39].switches "" UBYTE NO_COMPU_METHOD 0 0 0 255 ECU_ADDRESS 0x400E00E6 /end MEASUREMENT
/begin MEASUREMENT MCore_rb_SopF_ProcessImage.Cat2[39].switches.applDisconnect "" SBYTE rb_SopF_ProcessImage.Cat2[39].switches.applDisconnect.CONVERSION 0 0 -128 127 ECU_ADDRESS 0x400E00E6 /end MEASUREMENT
/begin MEASUREMENT MCore_rb_SopF_ProcessImage.Cat2[39].switches.hardwareDisconnect "" SBYTE rb_SopF_ProcessImage.Cat2[39].switches.hardwareDisconnect.CONVERSION 0 0 -128 127 ECU_ADDRESS 0x400E00E7 /end MEASUREMENT
/begin MEASUREMENT MCore_rb_SopF_ProcessImage.Cat2[3].applValue "" UWORD NO_COMPU_METHOD 0 0 0 65535 ECU_ADDRESS 0x400E000A /end MEASUREMENT
/begin MEASUREMENT MCore_rb_SopF_ProcessImage.Cat2[3].processed "" UWORD NO_COMPU_METHOD 0 0 0 65535 ECU_ADDRESS 0x400E000C /end MEASUREMENT
/begin MEASUREMENT MCore_rb_SopF_ProcessImage.Cat2[3].switches "" UBYTE NO_COMPU_METHOD 0 0 0 255 ECU_ADDRESS 0x400E000E /end MEASUREMENT
/begin MEASUREMENT MCore_rb_SopF_ProcessImage.Cat2[3].switches.applDisconnect "" SBYTE rb_SopF_ProcessImage.Cat2[3].switches.applDisconnect.CONVERSION 0 0 -128 127 ECU_ADDRESS 0x400E000E /end MEASUREMENT
/begin MEASUREMENT MCore_rb_SopF_ProcessImage.Cat2[3].switches.hardwareDisconnect "" SBYTE rb_SopF_ProcessImage.Cat2[3].switches.hardwareDisconnect.CONVERSION 0 0 -128 127 ECU_ADDRESS 0x400E000F /end MEASUREMENT
/begin MEASUREMENT MCore_rb_SopF_ProcessImage.Cat2[40].applValue "" UWORD NO_COMPU_METHOD 0 0 0 65535 ECU_ADDRESS 0x400E00E8 /end MEASUREMENT
/begin MEASUREMENT MCore_rb_SopF_ProcessImage.Cat2[40].processed "" UWORD NO_COMPU_METHOD 0 0 0 65535 ECU_ADDRESS 0x400E00EA /end MEASUREMENT
/begin MEASUREMENT MCore_rb_SopF_ProcessImage.Cat2[40].switches "" UBYTE NO_COMPU_METHOD 0 0 0 255 ECU_ADDRESS 0x400E00EC /end MEASUREMENT
/begin MEASUREMENT MCore_rb_SopF_ProcessImage.Cat2[40].switches.applDisconnect "" SBYTE rb_SopF_ProcessImage.Cat2[40].switches.applDisconnect.CONVERSION 0 0 -128 127 ECU_ADDRESS 0x400E00EC /end MEASUREMENT
/begin MEASUREMENT MCore_rb_SopF_ProcessImage.Cat2[40].switches.hardwareDisconnect "" SBYTE rb_SopF_ProcessImage.Cat2[40].switches.hardwareDisconnect.CONVERSION 0 0 -128 127 ECU_ADDRESS 0x400E00ED /end MEASUREMENT
/begin MEASUREMENT MCore_rb_SopF_ProcessImage.Cat2[41].applValue "" UWORD NO_COMPU_METHOD 0 0 0 65535 ECU_ADDRESS 0x400E00EE /end MEASUREMENT
/begin MEASUREMENT MCore_rb_SopF_ProcessImage.Cat2[41].processed "" UWORD NO_COMPU_METHOD 0 0 0 65535 ECU_ADDRESS 0x400E00F0 /end MEASUREMENT
/begin MEASUREMENT MCore_rb_SopF_ProcessImage.Cat2[41].switches "" UBYTE NO_COMPU_METHOD 0 0 0 255 ECU_ADDRESS 0x400E00F2 /end MEASUREMENT
/begin MEASUREMENT MCore_rb_SopF_ProcessImage.Cat2[41].switches.applDisconnect "" SBYTE rb_SopF_ProcessImage.Cat2[41].switches.applDisconnect.CONVERSION 0 0 -128 127 ECU_ADDRESS 0x400E00F2 /end MEASUREMENT
/begin MEASUREMENT MCore_rb_SopF_ProcessImage.Cat2[41].switches.hardwareDisconnect "" SBYTE rb_SopF_ProcessImage.Cat2[41].switches.hardwareDisconnect.CONVERSION 0 0 -128 127 ECU_ADDRESS 0x400E00F3 /end MEASUREMENT
/begin MEASUREMENT MCore_rb_SopF_ProcessImage.Cat2[42].applValue "" UWORD NO_COMPU_METHOD 0 0 0 65535 ECU_ADDRESS 0x400E00F4 /end MEASUREMENT
/begin MEASUREMENT MCore_rb_SopF_ProcessImage.Cat2[42].processed "" UWORD NO_COMPU_METHOD 0 0 0 65535 ECU_ADDRESS 0x400E00F6 /end MEASUREMENT
/begin MEASUREMENT MCore_rb_SopF_ProcessImage.Cat2[42].switches "" UBYTE NO_COMPU_METHOD 0 0 0 255 ECU_ADDRESS 0x400E00F8 /end MEASUREMENT
/begin MEASUREMENT MCore_rb_SopF_ProcessImage.Cat2[42].switches.applDisconnect "" SBYTE rb_SopF_ProcessImage.Cat2[42].switches.applDisconnect.CONVERSION 0 0 -128 127 ECU_ADDRESS 0x400E00F8 /end MEASUREMENT
/begin MEASUREMENT MCore_rb_SopF_ProcessImage.Cat2[42].switches.hardwareDisconnect "" SBYTE rb_SopF_ProcessImage.Cat2[42].switches.hardwareDisconnect.CONVERSION 0 0 -128 127 ECU_ADDRESS 0x400E00F9 /end MEASUREMENT
/begin MEASUREMENT MCore_rb_SopF_ProcessImage.Cat2[43].applValue "" UWORD NO_COMPU_METHOD 0 0 0 65535 ECU_ADDRESS 0x400E00FA /end MEASUREMENT
/begin MEASUREMENT MCore_rb_SopF_ProcessImage.Cat2[43].processed "" UWORD NO_COMPU_METHOD 0 0 0 65535 ECU_ADDRESS 0x400E00FC /end MEASUREMENT
/begin MEASUREMENT MCore_rb_SopF_ProcessImage.Cat2[43].switches "" UBYTE NO_COMPU_METHOD 0 0 0 255 ECU_ADDRESS 0x400E00FE /end MEASUREMENT
/begin MEASUREMENT MCore_rb_SopF_ProcessImage.Cat2[43].switches.applDisconnect "" SBYTE rb_SopF_ProcessImage.Cat2[43].switches.applDisconnect.CONVERSION 0 0 -128 127 ECU_ADDRESS 0x400E00FE /end MEASUREMENT
/begin MEASUREMENT MCore_rb_SopF_ProcessImage.Cat2[43].switches.hardwareDisconnect "" SBYTE rb_SopF_ProcessImage.Cat2[43].switches.hardwareDisconnect.CONVERSION 0 0 -128 127 ECU_ADDRESS 0x400E00FF /end MEASUREMENT
/begin MEASUREMENT MCore_rb_SopF_ProcessImage.Cat2[44].applValue "" UWORD NO_COMPU_METHOD 0 0 0 65535 ECU_ADDRESS 0x400E0100 /end MEASUREMENT
/begin MEASUREMENT MCore_rb_SopF_ProcessImage.Cat2[44].processed "" UWORD NO_COMPU_METHOD 0 0 0 65535 ECU_ADDRESS 0x400E0102 /end MEASUREMENT
/begin MEASUREMENT MCore_rb_SopF_ProcessImage.Cat2[44].switches "" UBYTE NO_COMPU_METHOD 0 0 0 255 ECU_ADDRESS 0x400E0104 /end MEASUREMENT
/begin MEASUREMENT MCore_rb_SopF_ProcessImage.Cat2[44].switches.applDisconnect "" SBYTE rb_SopF_ProcessImage.Cat2[44].switches.applDisconnect.CONVERSION 0 0 -128 127 ECU_ADDRESS 0x400E0104 /end MEASUREMENT
/begin MEASUREMENT MCore_rb_SopF_ProcessImage.Cat2[44].switches.hardwareDisconnect "" SBYTE rb_SopF_ProcessImage.Cat2[44].switches.hardwareDisconnect.CONVERSION 0 0 -128 127 ECU_ADDRESS 0x400E0105 /end MEASUREMENT
/begin MEASUREMENT MCore_rb_SopF_ProcessImage.Cat2[45].applValue "" UWORD NO_COMPU_METHOD 0 0 0 65535 ECU_ADDRESS 0x400E0106 /end MEASUREMENT
/begin MEASUREMENT MCore_rb_SopF_ProcessImage.Cat2[45].processed "" UWORD NO_COMPU_METHOD 0 0 0 65535 ECU_ADDRESS 0x400E0108 /end MEASUREMENT
/begin MEASUREMENT MCore_rb_SopF_ProcessImage.Cat2[45].switches "" UBYTE NO_COMPU_METHOD 0 0 0 255 ECU_ADDRESS 0x400E010A /end MEASUREMENT
/begin MEASUREMENT MCore_rb_SopF_ProcessImage.Cat2[45].switches.applDisconnect "" SBYTE rb_SopF_ProcessImage.Cat2[45].switches.applDisconnect.CONVERSION 0 0 -128 127 ECU_ADDRESS 0x400E010A /end MEASUREMENT
/begin MEASUREMENT MCore_rb_SopF_ProcessImage.Cat2[45].switches.hardwareDisconnect "" SBYTE rb_SopF_ProcessImage.Cat2[45].switches.hardwareDisconnect.CONVERSION 0 0 -128 127 ECU_ADDRESS 0x400E010B /end MEASUREMENT
/begin MEASUREMENT MCore_rb_SopF_ProcessImage.Cat2[46].applValue "" UWORD NO_COMPU_METHOD 0 0 0 65535 ECU_ADDRESS 0x400E010C /end MEASUREMENT
/begin MEASUREMENT MCore_rb_SopF_ProcessImage.Cat2[46].processed "" UWORD NO_COMPU_METHOD 0 0 0 65535 ECU_ADDRESS 0x400E010E /end MEASUREMENT
/begin MEASUREMENT MCore_rb_SopF_ProcessImage.Cat2[46].switches "" UBYTE NO_COMPU_METHOD 0 0 0 255 ECU_ADDRESS 0x400E0110 /end MEASUREMENT
/begin MEASUREMENT MCore_rb_SopF_ProcessImage.Cat2[46].switches.applDisconnect "" SBYTE rb_SopF_ProcessImage.Cat2[46].switches.applDisconnect.CONVERSION 0 0 -128 127 ECU_ADDRESS 0x400E0110 /end MEASUREMENT
/begin MEASUREMENT MCore_rb_SopF_ProcessImage.Cat2[46].switches.hardwareDisconnect "" SBYTE rb_SopF_ProcessImage.Cat2[46].switches.hardwareDisconnect.CONVERSION 0 0 -128 127 ECU_ADDRESS 0x400E0111 /end MEASUREMENT
/begin MEASUREMENT MCore_rb_SopF_ProcessImage.Cat2[47].applValue "" UWORD NO_COMPU_METHOD 0 0 0 65535 ECU_ADDRESS 0x400E0112 /end MEASUREMENT
/begin MEASUREMENT MCore_rb_SopF_ProcessImage.Cat2[47].processed "" UWORD NO_COMPU_METHOD 0 0 0 65535 ECU_ADDRESS 0x400E0114 /end MEASUREMENT
/begin MEASUREMENT MCore_rb_SopF_ProcessImage.Cat2[47].switches "" UBYTE NO_COMPU_METHOD 0 0 0 255 ECU_ADDRESS 0x400E0116 /end MEASUREMENT
/begin MEASUREMENT MCore_rb_SopF_ProcessImage.Cat2[47].switches.applDisconnect "" SBYTE rb_SopF_ProcessImage.Cat2[47].switches.applDisconnect.CONVERSION 0 0 -128 127 ECU_ADDRESS 0x400E0116 /end MEASUREMENT
/begin MEASUREMENT MCore_rb_SopF_ProcessImage.Cat2[47].switches.hardwareDisconnect "" SBYTE rb_SopF_ProcessImage.Cat2[47].switches.hardwareDisconnect.CONVERSION 0 0 -128 127 ECU_ADDRESS 0x400E0117 /end MEASUREMENT
/begin MEASUREMENT MCore_rb_SopF_ProcessImage.Cat2[48].applValue "" UWORD NO_COMPU_METHOD 0 0 0 65535 ECU_ADDRESS 0x400E0118 /end MEASUREMENT
/begin MEASUREMENT MCore_rb_SopF_ProcessImage.Cat2[48].processed "" UWORD NO_COMPU_METHOD 0 0 0 65535 ECU_ADDRESS 0x400E011A /end MEASUREMENT
/begin MEASUREMENT MCore_rb_SopF_ProcessImage.Cat2[48].switches "" UBYTE NO_COMPU_METHOD 0 0 0 255 ECU_ADDRESS 0x400E011C /end MEASUREMENT
/begin MEASUREMENT MCore_rb_SopF_ProcessImage.Cat2[48].switches.applDisconnect "" SBYTE rb_SopF_ProcessImage.Cat2[48].switches.applDisconnect.CONVERSION 0 0 -128 127 ECU_ADDRESS 0x400E011C /end MEASUREMENT
/begin MEASUREMENT MCore_rb_SopF_ProcessImage.Cat2[48].switches.hardwareDisconnect "" SBYTE rb_SopF_ProcessImage.Cat2[48].switches.hardwareDisconnect.CONVERSION 0 0 -128 127 ECU_ADDRESS 0x400E011D /end MEASUREMENT
/begin MEASUREMENT MCore_rb_SopF_ProcessImage.Cat2[49].applValue "" UWORD NO_COMPU_METHOD 0 0 0 65535 ECU_ADDRESS 0x400E011E /end MEASUREMENT
/begin MEASUREMENT MCore_rb_SopF_ProcessImage.Cat2[49].processed "" UWORD NO_COMPU_METHOD 0 0 0 65535 ECU_ADDRESS 0x400E0120 /end MEASUREMENT
/begin MEASUREMENT MCore_rb_SopF_ProcessImage.Cat2[49].switches "" UBYTE NO_COMPU_METHOD 0 0 0 255 ECU_ADDRESS 0x400E0122 /end MEASUREMENT
/begin MEASUREMENT MCore_rb_SopF_ProcessImage.Cat2[49].switches.applDisconnect "" SBYTE rb_SopF_ProcessImage.Cat2[49].switches.applDisconnect.CONVERSION 0 0 -128 127 ECU_ADDRESS 0x400E0122 /end MEASUREMENT
/begin MEASUREMENT MCore_rb_SopF_ProcessImage.Cat2[49].switches.hardwareDisconnect "" SBYTE rb_SopF_ProcessImage.Cat2[49].switches.hardwareDisconnect.CONVERSION 0 0 -128 127 ECU_ADDRESS 0x400E0123 /end MEASUREMENT
/begin MEASUREMENT MCore_rb_SopF_ProcessImage.Cat2[4].applValue "" UWORD NO_COMPU_METHOD 0 0 0 65535 ECU_ADDRESS 0x400E0010 /end MEASUREMENT
/begin MEASUREMENT MCore_rb_SopF_ProcessImage.Cat2[4].processed "" UWORD NO_COMPU_METHOD 0 0 0 65535 ECU_ADDRESS 0x400E0012 /end MEASUREMENT
/begin MEASUREMENT MCore_rb_SopF_ProcessImage.Cat2[4].switches "" UBYTE NO_COMPU_METHOD 0 0 0 255 ECU_ADDRESS 0x400E0014 /end MEASUREMENT
/begin MEASUREMENT MCore_rb_SopF_ProcessImage.Cat2[4].switches.applDisconnect "" SBYTE rb_SopF_ProcessImage.Cat2[4].switches.applDisconnect.CONVERSION 0 0 -128 127 ECU_ADDRESS 0x400E0014 /end MEASUREMENT
/begin MEASUREMENT MCore_rb_SopF_ProcessImage.Cat2[4].switches.hardwareDisconnect "" SBYTE rb_SopF_ProcessImage.Cat2[4].switches.hardwareDisconnect.CONVERSION 0 0 -128 127 ECU_ADDRESS 0x400E0015 /end MEASUREMENT
/begin MEASUREMENT MCore_rb_SopF_ProcessImage.Cat2[50].applValue "" UWORD NO_COMPU_METHOD 0 0 0 65535 ECU_ADDRESS 0x400E0124 /end MEASUREMENT
/begin MEASUREMENT MCore_rb_SopF_ProcessImage.Cat2[50].processed "" UWORD NO_COMPU_METHOD 0 0 0 65535 ECU_ADDRESS 0x400E0126 /end MEASUREMENT
/begin MEASUREMENT MCore_rb_SopF_ProcessImage.Cat2[50].switches "" UBYTE NO_COMPU_METHOD 0 0 0 255 ECU_ADDRESS 0x400E0128 /end MEASUREMENT
/begin MEASUREMENT MCore_rb_SopF_ProcessImage.Cat2[50].switches.applDisconnect "" SBYTE rb_SopF_ProcessImage.Cat2[50].switches.applDisconnect.CONVERSION 0 0 -128 127 ECU_ADDRESS 0x400E0128 /end MEASUREMENT
/begin MEASUREMENT MCore_rb_SopF_ProcessImage.Cat2[50].switches.hardwareDisconnect "" SBYTE rb_SopF_ProcessImage.Cat2[50].switches.hardwareDisconnect.CONVERSION 0 0 -128 127 ECU_ADDRESS 0x400E0129 /end MEASUREMENT
/begin MEASUREMENT MCore_rb_SopF_ProcessImage.Cat2[51].applValue "" UWORD NO_COMPU_METHOD 0 0 0 65535 ECU_ADDRESS 0x400E012A /end MEASUREMENT
/begin MEASUREMENT MCore_rb_SopF_ProcessImage.Cat2[51].processed "" UWORD NO_COMPU_METHOD 0 0 0 65535 ECU_ADDRESS 0x400E012C /end MEASUREMENT
/begin MEASUREMENT MCore_rb_SopF_ProcessImage.Cat2[51].switches "" UBYTE NO_COMPU_METHOD 0 0 0 255 ECU_ADDRESS 0x400E012E /end MEASUREMENT
/begin MEASUREMENT MCore_rb_SopF_ProcessImage.Cat2[51].switches.applDisconnect "" SBYTE rb_SopF_ProcessImage.Cat2[51].switches.applDisconnect.CONVERSION 0 0 -128 127 ECU_ADDRESS 0x400E012E /end MEASUREMENT
/begin MEASUREMENT MCore_rb_SopF_ProcessImage.Cat2[51].switches.hardwareDisconnect "" SBYTE rb_SopF_ProcessImage.Cat2[51].switches.hardwareDisconnect.CONVERSION 0 0 -128 127 ECU_ADDRESS 0x400E012F /end MEASUREMENT
/begin MEASUREMENT MCore_rb_SopF_ProcessImage.Cat2[52].applValue "" UWORD NO_COMPU_METHOD 0 0 0 65535 ECU_ADDRESS 0x400E0130 /end MEASUREMENT
/begin MEASUREMENT MCore_rb_SopF_ProcessImage.Cat2[52].processed "" UWORD NO_COMPU_METHOD 0 0 0 65535 ECU_ADDRESS 0x400E0132 /end MEASUREMENT
/begin MEASUREMENT MCore_rb_SopF_ProcessImage.Cat2[52].switches "" UBYTE NO_COMPU_METHOD 0 0 0 255 ECU_ADDRESS 0x400E0134 /end MEASUREMENT
/begin MEASUREMENT MCore_rb_SopF_ProcessImage.Cat2[52].switches.applDisconnect "" SBYTE rb_SopF_ProcessImage.Cat2[52].switches.applDisconnect.CONVERSION 0 0 -128 127 ECU_ADDRESS 0x400E0134 /end MEASUREMENT
/begin MEASUREMENT MCore_rb_SopF_ProcessImage.Cat2[52].switches.hardwareDisconnect "" SBYTE rb_SopF_ProcessImage.Cat2[52].switches.hardwareDisconnect.CONVERSION 0 0 -128 127 ECU_ADDRESS 0x400E0135 /end MEASUREMENT
/begin MEASUREMENT MCore_rb_SopF_ProcessImage.Cat2[53].applValue "" UWORD NO_COMPU_METHOD 0 0 0 65535 ECU_ADDRESS 0x400E0136 /end MEASUREMENT
/begin MEASUREMENT MCore_rb_SopF_ProcessImage.Cat2[53].processed "" UWORD NO_COMPU_METHOD 0 0 0 65535 ECU_ADDRESS 0x400E0138 /end MEASUREMENT
/begin MEASUREMENT MCore_rb_SopF_ProcessImage.Cat2[53].switches "" UBYTE NO_COMPU_METHOD 0 0 0 255 ECU_ADDRESS 0x400E013A /end MEASUREMENT
/begin MEASUREMENT MCore_rb_SopF_ProcessImage.Cat2[53].switches.applDisconnect "" SBYTE rb_SopF_ProcessImage.Cat2[53].switches.applDisconnect.CONVERSION 0 0 -128 127 ECU_ADDRESS 0x400E013A /end MEASUREMENT
/begin MEASUREMENT MCore_rb_SopF_ProcessImage.Cat2[53].switches.hardwareDisconnect "" SBYTE rb_SopF_ProcessImage.Cat2[53].switches.hardwareDisconnect.CONVERSION 0 0 -128 127 ECU_ADDRESS 0x400E013B /end MEASUREMENT
/begin MEASUREMENT MCore_rb_SopF_ProcessImage.Cat2[5].applValue "" UWORD NO_COMPU_METHOD 0 0 0 65535 ECU_ADDRESS 0x400E0016 /end MEASUREMENT
/begin MEASUREMENT MCore_rb_SopF_ProcessImage.Cat2[5].processed "" UWORD NO_COMPU_METHOD 0 0 0 65535 ECU_ADDRESS 0x400E0018 /end MEASUREMENT
/begin MEASUREMENT MCore_rb_SopF_ProcessImage.Cat2[5].switches "" UBYTE NO_COMPU_METHOD 0 0 0 255 ECU_ADDRESS 0x400E001A /end MEASUREMENT
/begin MEASUREMENT MCore_rb_SopF_ProcessImage.Cat2[5].switches.applDisconnect "" SBYTE rb_SopF_ProcessImage.Cat2[5].switches.applDisconnect.CONVERSION 0 0 -128 127 ECU_ADDRESS 0x400E001A /end MEASUREMENT
/begin MEASUREMENT MCore_rb_SopF_ProcessImage.Cat2[5].switches.hardwareDisconnect "" SBYTE rb_SopF_ProcessImage.Cat2[5].switches.hardwareDisconnect.CONVERSION 0 0 -128 127 ECU_ADDRESS 0x400E001B /end MEASUREMENT
/begin MEASUREMENT MCore_rb_SopF_ProcessImage.Cat2[6].applValue "" UWORD NO_COMPU_METHOD 0 0 0 65535 ECU_ADDRESS 0x400E001C /end MEASUREMENT
/begin MEASUREMENT MCore_rb_SopF_ProcessImage.Cat2[6].processed "" UWORD NO_COMPU_METHOD 0 0 0 65535 ECU_ADDRESS 0x400E001E /end MEASUREMENT
/begin MEASUREMENT MCore_rb_SopF_ProcessImage.Cat2[6].switches "" UBYTE NO_COMPU_METHOD 0 0 0 255 ECU_ADDRESS 0x400E0020 /end MEASUREMENT
/begin MEASUREMENT MCore_rb_SopF_ProcessImage.Cat2[6].switches.applDisconnect "" SBYTE rb_SopF_ProcessImage.Cat2[6].switches.applDisconnect.CONVERSION 0 0 -128 127 ECU_ADDRESS 0x400E0020 /end MEASUREMENT
/begin MEASUREMENT MCore_rb_SopF_ProcessImage.Cat2[6].switches.hardwareDisconnect "" SBYTE rb_SopF_ProcessImage.Cat2[6].switches.hardwareDisconnect.CONVERSION 0 0 -128 127 ECU_ADDRESS 0x400E0021 /end MEASUREMENT
/begin MEASUREMENT MCore_rb_SopF_ProcessImage.Cat2[7].applValue "" UWORD NO_COMPU_METHOD 0 0 0 65535 ECU_ADDRESS 0x400E0022 /end MEASUREMENT
/begin MEASUREMENT MCore_rb_SopF_ProcessImage.Cat2[7].processed "" UWORD NO_COMPU_METHOD 0 0 0 65535 ECU_ADDRESS 0x400E0024 /end MEASUREMENT
/begin MEASUREMENT MCore_rb_SopF_ProcessImage.Cat2[7].switches "" UBYTE NO_COMPU_METHOD 0 0 0 255 ECU_ADDRESS 0x400E0026 /end MEASUREMENT
/begin MEASUREMENT MCore_rb_SopF_ProcessImage.Cat2[7].switches.applDisconnect "" SBYTE rb_SopF_ProcessImage.Cat2[7].switches.applDisconnect.CONVERSION 0 0 -128 127 ECU_ADDRESS 0x400E0026 /end MEASUREMENT
/begin MEASUREMENT MCore_rb_SopF_ProcessImage.Cat2[7].switches.hardwareDisconnect "" SBYTE rb_SopF_ProcessImage.Cat2[7].switches.hardwareDisconnect.CONVERSION 0 0 -128 127 ECU_ADDRESS 0x400E0027 /end MEASUREMENT
/begin MEASUREMENT MCore_rb_SopF_ProcessImage.Cat2[8].applValue "" UWORD NO_COMPU_METHOD 0 0 0 65535 ECU_ADDRESS 0x400E0028 /end MEASUREMENT
/begin MEASUREMENT MCore_rb_SopF_ProcessImage.Cat2[8].processed "" UWORD NO_COMPU_METHOD 0 0 0 65535 ECU_ADDRESS 0x400E002A /end MEASUREMENT
/begin MEASUREMENT MCore_rb_SopF_ProcessImage.Cat2[8].switches "" UBYTE NO_COMPU_METHOD 0 0 0 255 ECU_ADDRESS 0x400E002C /end MEASUREMENT
/begin MEASUREMENT MCore_rb_SopF_ProcessImage.Cat2[8].switches.applDisconnect "" SBYTE rb_SopF_ProcessImage.Cat2[8].switches.applDisconnect.CONVERSION 0 0 -128 127 ECU_ADDRESS 0x400E002C /end MEASUREMENT
/begin MEASUREMENT MCore_rb_SopF_ProcessImage.Cat2[8].switches.hardwareDisconnect "" SBYTE rb_SopF_ProcessImage.Cat2[8].switches.hardwareDisconnect.CONVERSION 0 0 -128 127 ECU_ADDRESS 0x400E002D /end MEASUREMENT
/begin MEASUREMENT MCore_rb_SopF_ProcessImage.Cat2[9].applValue "" UWORD NO_COMPU_METHOD 0 0 0 65535 ECU_ADDRESS 0x400E002E /end MEASUREMENT
/begin MEASUREMENT MCore_rb_SopF_ProcessImage.Cat2[9].processed "" UWORD NO_COMPU_METHOD 0 0 0 65535 ECU_ADDRESS 0x400E0030 /end MEASUREMENT
/begin MEASUREMENT MCore_rb_SopF_ProcessImage.Cat2[9].switches "" UBYTE NO_COMPU_METHOD 0 0 0 255 ECU_ADDRESS 0x400E0032 /end MEASUREMENT
/begin MEASUREMENT MCore_rb_SopF_ProcessImage.Cat2[9].switches.applDisconnect "" SBYTE rb_SopF_ProcessImage.Cat2[9].switches.applDisconnect.CONVERSION 0 0 -128 127 ECU_ADDRESS 0x400E0032 /end MEASUREMENT
/begin MEASUREMENT MCore_rb_SopF_ProcessImage.Cat2[9].switches.hardwareDisconnect "" SBYTE rb_SopF_ProcessImage.Cat2[9].switches.hardwareDisconnect.CONVERSION 0 0 -128 127 ECU_ADDRESS 0x400E0033 /end MEASUREMENT
/begin MEASUREMENT MCore_rb_SopF_ProcessImage.Cat20 "" UBYTE NO_COMPU_METHOD 0 0 0 255 ECU_ADDRESS 0x400E01C6 /end MEASUREMENT
/begin MEASUREMENT MCore_rb_SopF_ProcessImage.Cat20[0].applValue "" UWORD NO_COMPU_METHOD 0 0 0 65535 ECU_ADDRESS 0x400E01C6 /end MEASUREMENT
/begin MEASUREMENT MCore_rb_SopF_ProcessImage.Cat20[0].processed "" UWORD NO_COMPU_METHOD 0 0 0 65535 ECU_ADDRESS 0x400E01C8 /end MEASUREMENT
/begin MEASUREMENT MCore_rb_SopF_ProcessImage.Cat20[0].switches "" UBYTE NO_COMPU_METHOD 0 0 0 255 ECU_ADDRESS 0x400E01CA /end MEASUREMENT
/begin MEASUREMENT MCore_rb_SopF_ProcessImage.Cat20[0].switches.applDisconnect "" SBYTE rb_SopF_ProcessImage.Cat20[0].switches.applDisconnect.CONVERSION 0 0 -128 127 ECU_ADDRESS 0x400E01CA /end MEASUREMENT
/begin MEASUREMENT MCore_rb_SopF_ProcessImage.Cat20[0].switches.hardwareDisconnect "" SBYTE rb_SopF_ProcessImage.Cat20[0].switches.hardwareDisconnect.CONVERSION 0 0 -128 127 ECU_ADDRESS 0x400E01CB /end MEASUREMENT
/begin MEASUREMENT MCore_rb_SopF_ProcessImage.Cat3 "" UBYTE NO_COMPU_METHOD 0 0 0 255 ECU_ADDRESS 0x400E013C /end MEASUREMENT
/begin MEASUREMENT MCore_rb_SopF_ProcessImage.Cat3[0].applValue "" UWORD NO_COMPU_METHOD 0 0 0 65535 ECU_ADDRESS 0x400E013C /end MEASUREMENT
/begin MEASUREMENT MCore_rb_SopF_ProcessImage.Cat3[0].processed "" UWORD NO_COMPU_METHOD 0 0 0 65535 ECU_ADDRESS 0x400E013E /end MEASUREMENT
/begin MEASUREMENT MCore_rb_SopF_ProcessImage.Cat3[0].switches "" UBYTE NO_COMPU_METHOD 0 0 0 255 ECU_ADDRESS 0x400E0140 /end MEASUREMENT
/begin MEASUREMENT MCore_rb_SopF_ProcessImage.Cat3[0].switches.applDisconnect "" SBYTE rb_SopF_ProcessImage.Cat3[0].switches.applDisconnect.CONVERSION 0 0 -128 127 ECU_ADDRESS 0x400E0140 /end MEASUREMENT
/begin MEASUREMENT MCore_rb_SopF_ProcessImage.Cat3[0].switches.hardwareDisconnect "" SBYTE rb_SopF_ProcessImage.Cat3[0].switches.hardwareDisconnect.CONVERSION 0 0 -128 127 ECU_ADDRESS 0x400E0141 /end MEASUREMENT
/begin MEASUREMENT MCore_rb_SopF_ProcessImage.Cat3[1].applValue "" UWORD NO_COMPU_METHOD 0 0 0 65535 ECU_ADDRESS 0x400E0142 /end MEASUREMENT
/begin MEASUREMENT MCore_rb_SopF_ProcessImage.Cat3[1].processed "" UWORD NO_COMPU_METHOD 0 0 0 65535 ECU_ADDRESS 0x400E0144 /end MEASUREMENT
/begin MEASUREMENT MCore_rb_SopF_ProcessImage.Cat3[1].switches "" UBYTE NO_COMPU_METHOD 0 0 0 255 ECU_ADDRESS 0x400E0146 /end MEASUREMENT
/begin MEASUREMENT MCore_rb_SopF_ProcessImage.Cat3[1].switches.applDisconnect "" SBYTE rb_SopF_ProcessImage.Cat3[1].switches.applDisconnect.CONVERSION 0 0 -128 127 ECU_ADDRESS 0x400E0146 /end MEASUREMENT
/begin MEASUREMENT MCore_rb_SopF_ProcessImage.Cat3[1].switches.hardwareDisconnect "" SBYTE rb_SopF_ProcessImage.Cat3[1].switches.hardwareDisconnect.CONVERSION 0 0 -128 127 ECU_ADDRESS 0x400E0147 /end MEASUREMENT
/begin UNIT FCA_SysDesc_BODYCAN_Pkg_Units_km_h "" "" EXTENDED_SI /end UNIT
/begin UNIT VW_BCM_Units_kmh "" "" EXTENDED_SI /end UNIT
/begin UNIT AUTOSAR_AISpecification_Units_Perc "Percent" "%" EXTENDED_SI /end UNIT
/begin UNIT DataType_DataTypeUnits_V "" "V" EXTENDED_SI SI_EXPONENTS 0 0 0 0 0 0 0 /end UNIT
/begin UNIT DataType_DataTypeUnits_U_d "" "°" EXTENDED_SI SI_EXPONENTS 0 0 0 0 0 0 0 /end UNIT
/end MODULE
/end PROJECT

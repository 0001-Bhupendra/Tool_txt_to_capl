ASAP2_VERSION 1 61
/begin PROJECT prjDemo ""
/begin HEADER "" PROJECT_NO prjDemo_1_0 VERSION "AR_A2L_1.0" /end HEADER
/begin MODULE modFinalDemo ""
/begin MOD_COMMON "" BYTE_ORDER MSB_FIRST ALIGNMENT_BYTE 1 ALIGNMENT_WORD 1 ALIGNMENT_LONG 1 ALIGNMENT_INT64 1 ALIGNMENT_FLOAT32_IEEE 1 ALIGNMENT_FLOAT64_IEEE 4 /end MOD_COMMON
/begin RECORD_LAYOUT __SBYTE_Z FNC_VALUES 1 SBYTE ROW_DIR DIRECT /end RECORD_LAYOUT
/begin RECORD_LAYOUT __SWORD_Z FNC_VALUES 1 SWORD ROW_DIR DIRECT /end RECORD_LAYOUT
/begin RECORD_LAYOUT __SLONG_Z FNC_VALUES 1 SLONG ROW_DIR DIRECT /end RECORD_LAYOUT
/begin RECORD_LAYOUT __FLOAT32_IEEE_Z FNC_VALUES 1 FLOAT32_IEEE ROW_DIR DIRECT /end RECORD_LAYOUT
/begin RECORD_LAYOUT __FLOAT64_IEEE_Z FNC_VALUES 1 FLOAT64_IEEE ROW_DIR DIRECT /end RECORD_LAYOUT
/begin RECORD_LAYOUT __UBYTE_S FNC_VALUES 1 UBYTE COLUMN_DIR DIRECT /end RECORD_LAYOUT
/begin RECORD_LAYOUT __UWORD_S FNC_VALUES 1 UWORD COLUMN_DIR DIRECT /end RECORD_LAYOUT
/begin RECORD_LAYOUT __ULONG_S FNC_VALUES 1 ULONG COLUMN_DIR DIRECT /end RECORD_LAYOUT
/begin RECORD_LAYOUT __SBYTE_S FNC_VALUES 1 SBYTE COLUMN_DIR DIRECT /end RECORD_LAYOUT
/begin RECORD_LAYOUT __SWORD_S FNC_VALUES 1 SWORD COLUMN_DIR DIRECT /end RECORD_LAYOUT
/begin RECORD_LAYOUT __SLONG_S FNC_VALUES 1 SLONG COLUMN_DIR DIRECT /end RECORD_LAYOUT
/begin RECORD_LAYOUT __FLOAT32_IEEE_S FNC_VALUES 1 FLOAT32_IEEE COLUMN_DIR DIRECT /end RECORD_LAYOUT
/begin RECORD_LAYOUT __FLOAT64_IEEE_S FNC_VALUES 1 FLOAT64_IEEE COLUMN_DIR DIRECT /end RECORD_LAYOUT
/begin RECORD_LAYOUT SSV__UBYTE_S AXIS_PTS_X 1 UBYTE INDEX_INCR DIRECT /end RECORD_LAYOUT
/begin RECORD_LAYOUT SSV__UWORD_S AXIS_PTS_X 1 UWORD INDEX_INCR DIRECT /end RECORD_LAYOUT
/begin RECORD_LAYOUT SSV__ULONG_S AXIS_PTS_X 1 ULONG INDEX_INCR DIRECT /end RECORD_LAYOUT
/begin MEASUREMENT MCore_rb_SipF_ProcessImage.Cat1[16].snapshot "" UWORD NO_COMPU_METHOD 0 0 0 65535 ECU_ADDRESS 0x400DF29C /end MEASUREMENT
/begin MEASUREMENT MCore_rb_SipF_ProcessImage.Cat1[16].switches "" UBYTE NO_COMPU_METHOD 0 0 0 255 ECU_ADDRESS 0x400DF2A8 /end MEASUREMENT
/begin MEASUREMENT MCore_rb_SipF_ProcessImage.Cat1[16].switches.mcalInputDisconnect "" SBYTE rb_SipF_ProcessImage.Cat1[16].switches.mcalInputDisconnect.CONVERSION 0 0 -128 127 ECU_ADDRESS 0x400DF2A8 /end MEASUREMENT
/begin MEASUREMENT MCore_rb_SipF_ProcessImage.Cat1[16].switches.sipfInputDisconnect "" SBYTE rb_SipF_ProcessImage.Cat1[16].switches.sipfInputDisconnect.CONVERSION 0 0 -128 127 ECU_ADDRESS 0x400DF2A9 /end MEASUREMENT
/begin MEASUREMENT MCore_rb_SipF_ProcessImage.Cat1[17].debCounter "" UWORD NO_COMPU_METHOD 0 0 0 65535 ECU_ADDRESS 0x400DF2B2 /end MEASUREMENT
/begin MEASUREMENT MCore_rb_SipF_ProcessImage.Cat1[17].debounced "" UWORD NO_COMPU_METHOD 0 0 0 65535 ECU_ADDRESS 0x400DF2B0 /end MEASUREMENT
/begin MEASUREMENT MCore_rb_SipF_ProcessImage.Cat1[17].discrete "" UWORD NO_COMPU_METHOD 0 0 0 65535 ECU_ADDRESS 0x400DF2AC /end MEASUREMENT
/begin MEASUREMENT MCore_rb_SipF_ProcessImage.Cat1[17].discreteOld "" UWORD NO_COMPU_METHOD 0 0 0 65535 ECU_ADDRESS 0x400DF2AE /end MEASUREMENT
/begin MEASUREMENT MCore_rb_SipF_ProcessImage.Cat1[17].processed "" UWORD NO_COMPU_METHOD 0 0 0 65535 ECU_ADDRESS 0x400DF2B4 /end MEASUREMENT
/begin MEASUREMENT MCore_rb_SipF_ProcessImage.Cat1[17].snapshot "" UWORD NO_COMPU_METHOD 0 0 0 65535 ECU_ADDRESS 0x400DF2AA /end MEASUREMENT
/begin MEASUREMENT MCore_rb_SipF_ProcessImage.Cat1[17].switches "" UBYTE NO_COMPU_METHOD 0 0 0 255 ECU_ADDRESS 0x400DF2B6 /end MEASUREMENT
/begin MEASUREMENT MCore_rb_SipF_ProcessImage.Cat1[17].switches.mcalInputDisconnect "" SBYTE rb_SipF_ProcessImage.Cat1[17].switches.mcalInputDisconnect.CONVERSION 0 0 -128 127 ECU_ADDRESS 0x400DF2B6 /end MEASUREMENT
/begin MEASUREMENT MCore_rb_SipF_ProcessImage.Cat1[17].switches.sipfInputDisconnect "" SBYTE rb_SipF_ProcessImage.Cat1[17].switches.sipfInputDisconnect.CONVERSION 0 0 -128 127 ECU_ADDRESS 0x400DF2B7 /end MEASUREMENT
/begin MEASUREMENT MCore_rb_SipF_ProcessImage.Cat1[18].debCounter "" UWORD NO_COMPU_METHOD 0 0 0 65535 ECU_ADDRESS 0x400DF2C0 /end MEASUREMENT
/begin MEASUREMENT MCore_rb_SipF_ProcessImage.Cat1[18].debounced "" UWORD NO_COMPU_METHOD 0 0 0 65535 ECU_ADDRESS 0x400DF2BE /end MEASUREMENT
/begin MEASUREMENT MCore_rb_SipF_ProcessImage.Cat1[18].discrete "" UWORD NO_COMPU_METHOD 0 0 0 65535 ECU_ADDRESS 0x400DF2BA /end MEASUREMENT
/begin MEASUREMENT MCore_rb_SipF_ProcessImage.Cat1[18].discreteOld "" UWORD NO_COMPU_METHOD 0 0 0 65535 ECU_ADDRESS 0x400DF2BC /end MEASUREMENT
/begin MEASUREMENT MCore_rb_SipF_ProcessImage.Cat1[18].processed "" UWORD NO_COMPU_METHOD 0 0 0 65535 ECU_ADDRESS 0x400DF2C2 /end MEASUREMENT
/begin MEASUREMENT MCore_rb_SipF_ProcessImage.Cat1[18].snapshot "" UWORD NO_COMPU_METHOD 0 0 0 65535 ECU_ADDRESS 0x400DF2B8 /end MEASUREMENT
/begin MEASUREMENT MCore_rb_SipF_ProcessImage.Cat1[18].switches "" UBYTE NO_COMPU_METHOD 0 0 0 255 ECU_ADDRESS 0x400DF2C4 /end MEASUREMENT
/begin MEASUREMENT MCore_rb_SipF_ProcessImage.Cat1[18].switches.mcalInputDisconnect "" SBYTE rb_SipF_ProcessImage.Cat1[18].switches.mcalInputDisconnect.CONVERSION 0 0 -128 127 ECU_ADDRESS 0x400DF2C4 /end MEASUREMENT
/begin MEASUREMENT MCore_rb_SipF_ProcessImage.Cat1[18].switches.sipfInputDisconnect "" SBYTE rb_SipF_ProcessImage.Cat1[18].switches.sipfInputDisconnect.CONVERSION 0 0 -128 127 ECU_ADDRESS 0x400DF2C5 /end MEASUREMENT
/begin MEASUREMENT MCore_rb_SipF_ProcessImage.Cat1[19].debCounter "" UWORD NO_COMPU_METHOD 0 0 0 65535 ECU_ADDRESS 0x400DF2CE /end MEASUREMENT
/begin MEASUREMENT MCore_rb_SipF_ProcessImage.Cat1[19].debounced "" UWORD NO_COMPU_METHOD 0 0 0 65535 ECU_ADDRESS 0x400DF2CC /end MEASUREMENT
/begin MEASUREMENT MCore_rb_SipF_ProcessImage.Cat1[19].discrete "" UWORD NO_COMPU_METHOD 0 0 0 65535 ECU_ADDRESS 0x400DF2C8 /end MEASUREMENT
/begin MEASUREMENT MCore_rb_SipF_ProcessImage.Cat1[19].discreteOld "" UWORD NO_COMPU_METHOD 0 0 0 65535 ECU_ADDRESS 0x400DF2CA /end MEASUREMENT
/begin MEASUREMENT MCore_rb_SipF_ProcessImage.Cat1[19].processed "" UWORD NO_COMPU_METHOD 0 0 0 65535 ECU_ADDRESS 0x400DF2D0 /end MEASUREMENT
/begin MEASUREMENT MCore_rb_SipF_ProcessImage.Cat1[19].snapshot "" UWORD NO_COMPU_METHOD 0 0 0 65535 ECU_ADDRESS 0x400DF2C6 /end MEASUREMENT
/begin MEASUREMENT MCore_rb_SipF_ProcessImage.Cat1[19].switches "" UBYTE NO_COMPU_METHOD 0 0 0 255 ECU_ADDRESS 0x400DF2D2 /end MEASUREMENT
/begin MEASUREMENT MCore_rb_SipF_ProcessImage.Cat1[19].switches.mcalInputDisconnect "" SBYTE rb_SipF_ProcessImage.Cat1[19].switches.mcalInputDisconnect.CONVERSION 0 0 -128 127 ECU_ADDRESS 0x400DF2D2 /end MEASUREMENT
/begin MEASUREMENT MCore_rb_SipF_ProcessImage.Cat1[19].switches.sipfInputDisconnect "" SBYTE rb_SipF_ProcessImage.Cat1[19].switches.sipfInputDisconnect.CONVERSION 0 0 -128 127 ECU_ADDRESS 0x400DF2D3 /end MEASUREMENT
/begin MEASUREMENT MCore_rb_SipF_ProcessImage.Cat1[1].debCounter "" UWORD NO_COMPU_METHOD 0 0 0 65535 ECU_ADDRESS 0x400DF1D2 /end MEASUREMENT
/begin MEASUREMENT MCore_rb_SipF_ProcessImage.Cat1[1].debounced "" UWORD NO_COMPU_METHOD 0 0 0 65535 ECU_ADDRESS 0x400DF1D0 /end MEASUREMENT
/begin MEASUREMENT MCore_rb_SipF_ProcessImage.Cat1[1].discrete "" UWORD NO_COMPU_METHOD 0 0 0 65535 ECU_ADDRESS 0x400DF1CC /end MEASUREMENT
/begin MEASUREMENT MCore_rb_SipF_ProcessImage.Cat1[1].discreteOld "" UWORD NO_COMPU_METHOD 0 0 0 65535 ECU_ADDRESS 0x400DF1CE /end MEASUREMENT
/begin MEASUREMENT MCore_rb_SipF_ProcessImage.Cat1[1].processed "" UWORD NO_COMPU_METHOD 0 0 0 65535 ECU_ADDRESS 0x400DF1D4 /end MEASUREMENT
/begin MEASUREMENT MCore_rb_SipF_ProcessImage.Cat1[1].snapshot "" UWORD NO_COMPU_METHOD 0 0 0 65535 ECU_ADDRESS 0x400DF1CA /end MEASUREMENT
/begin MEASUREMENT MCore_rb_SipF_ProcessImage.Cat1[1].switches "" UBYTE NO_COMPU_METHOD 0 0 0 255 ECU_ADDRESS 0x400DF1D6 /end MEASUREMENT
/begin MEASUREMENT MCore_rb_SipF_ProcessImage.Cat1[1].switches.mcalInputDisconnect "" SBYTE rb_SipF_ProcessImage.Cat1[1].switches.mcalInputDisconnect.CONVERSION 0 0 -128 127 ECU_ADDRESS 0x400DF1D6 /end MEASUREMENT
/begin MEASUREMENT MCore_rb_SipF_ProcessImage.Cat1[1].switches.sipfInputDisconnect "" SBYTE rb_SipF_ProcessImage.Cat1[1].switches.sipfInputDisconnect.CONVERSION 0 0 -128 127 ECU_ADDRESS 0x400DF1D7 /end MEASUREMENT
/begin MEASUREMENT MCore_rb_SipF_ProcessImage.Cat1[20].debCounter "" UWORD NO_COMPU_METHOD 0 0 0 65535 ECU_ADDRESS 0x400DF2DC /end MEASUREMENT
/begin MEASUREMENT MCore_rb_SipF_ProcessImage.Cat1[20].debounced "" UWORD NO_COMPU_METHOD 0 0 0 65535 ECU_ADDRESS 0x400DF2DA /end MEASUREMENT
/begin MEASUREMENT MCore_rb_SipF_ProcessImage.Cat1[20].discrete "" UWORD NO_COMPU_METHOD 0 0 0 65535 ECU_ADDRESS 0x400DF2D6 /end MEASUREMENT
/begin MEASUREMENT MCore_rb_SipF_ProcessImage.Cat1[20].discreteOld "" UWORD NO_COMPU_METHOD 0 0 0 65535 ECU_ADDRESS 0x400DF2D8 /end MEASUREMENT
/begin MEASUREMENT MCore_rb_SipF_ProcessImage.Cat1[20].processed "" UWORD NO_COMPU_METHOD 0 0 0 65535 ECU_ADDRESS 0x400DF2DE /end MEASUREMENT
/begin MEASUREMENT MCore_rb_SipF_ProcessImage.Cat1[20].snapshot "" UWORD NO_COMPU_METHOD 0 0 0 65535 ECU_ADDRESS 0x400DF2D4 /end MEASUREMENT
/begin MEASUREMENT MCore_rb_SipF_ProcessImage.Cat1[20].switches "" UBYTE NO_COMPU_METHOD 0 0 0 255 ECU_ADDRESS 0x400DF2E0 /end MEASUREMENT
/begin MEASUREMENT MCore_rb_SipF_ProcessImage.Cat1[20].switches.mcalInputDisconnect "" SBYTE rb_SipF_ProcessImage.Cat1[20].switches.mcalInputDisconnect.CONVERSION 0 0 -128 127 ECU_ADDRESS 0x400DF2E0 /end MEASUREMENT
/begin MEASUREMENT MCore_rb_SipF_ProcessImage.Cat1[20].switches.sipfInputDisconnect "" SBYTE rb_SipF_ProcessImage.Cat1[20].switches.sipfInputDisconnect.CONVERSION 0 0 -128 127 ECU_ADDRESS 0x400DF2E1 /end MEASUREMENT
/begin MEASUREMENT MCore_rb_SipF_ProcessImage.Cat1[21].debCounter "" UWORD NO_COMPU_METHOD 0 0 0 65535 ECU_ADDRESS 0x400DF2EA /end MEASUREMENT
/begin MEASUREMENT MCore_rb_SipF_ProcessImage.Cat1[21].debounced "" UWORD NO_COMPU_METHOD 0 0 0 65535 ECU_ADDRESS 0x400DF2E8 /end MEASUREMENT
/begin MEASUREMENT MCore_rb_SipF_ProcessImage.Cat1[21].discrete "" UWORD NO_COMPU_METHOD 0 0 0 65535 ECU_ADDRESS 0x400DF2E4 /end MEASUREMENT
/begin MEASUREMENT MCore_rb_SipF_ProcessImage.Cat1[21].discreteOld "" UWORD NO_COMPU_METHOD 0 0 0 65535 ECU_ADDRESS 0x400DF2E6 /end MEASUREMENT
/begin MEASUREMENT MCore_rb_SipF_ProcessImage.Cat1[21].processed "" UWORD NO_COMPU_METHOD 0 0 0 65535 ECU_ADDRESS 0x400DF2EC /end MEASUREMENT
/begin MEASUREMENT MCore_rb_SipF_ProcessImage.Cat1[21].snapshot "" UWORD NO_COMPU_METHOD 0 0 0 65535 ECU_ADDRESS 0x400DF2E2 /end MEASUREMENT
/begin MEASUREMENT MCore_rb_SipF_ProcessImage.Cat1[21].switches "" UBYTE NO_COMPU_METHOD 0 0 0 255 ECU_ADDRESS 0x400DF2EE /end MEASUREMENT
/begin MEASUREMENT MCore_rb_SipF_ProcessImage.Cat1[21].switches.mcalInputDisconnect "" SBYTE rb_SipF_ProcessImage.Cat1[21].switches.mcalInputDisconnect.CONVERSION 0 0 -128 127 ECU_ADDRESS 0x400DF2EE /end MEASUREMENT
/begin MEASUREMENT MCore_rb_SipF_ProcessImage.Cat1[21].switches.sipfInputDisconnect "" SBYTE rb_SipF_ProcessImage.Cat1[21].switches.sipfInputDisconnect.CONVERSION 0 0 -128 127 ECU_ADDRESS 0x400DF2EF /end MEASUREMENT
/begin MEASUREMENT MCore_rb_SipF_ProcessImage.Cat1[22].debCounter "" UWORD NO_COMPU_METHOD 0 0 0 65535 ECU_ADDRESS 0x400DF2F8 /end MEASUREMENT
/begin MEASUREMENT MCore_rb_SipF_ProcessImage.Cat1[22].debounced "" UWORD NO_COMPU_METHOD 0 0 0 65535 ECU_ADDRESS 0x400DF2F6 /end MEASUREMENT
/begin MEASUREMENT MCore_rb_SipF_ProcessImage.Cat1[22].discrete "" UWORD NO_COMPU_METHOD 0 0 0 65535 ECU_ADDRESS 0x400DF2F2 /end MEASUREMENT
/begin MEASUREMENT MCore_rb_SipF_ProcessImage.Cat1[22].discreteOld "" UWORD NO_COMPU_METHOD 0 0 0 65535 ECU_ADDRESS 0x400DF2F4 /end MEASUREMENT
/begin MEASUREMENT MCore_rb_SipF_ProcessImage.Cat1[22].processed "" UWORD NO_COMPU_METHOD 0 0 0 65535 ECU_ADDRESS 0x400DF2FA /end MEASUREMENT
/begin MEASUREMENT MCore_rb_SipF_ProcessImage.Cat1[22].snapshot "" UWORD NO_COMPU_METHOD 0 0 0 65535 ECU_ADDRESS 0x400DF2F0 /end MEASUREMENT
/begin MEASUREMENT MCore_rb_SipF_ProcessImage.Cat1[22].switches "" UBYTE NO_COMPU_METHOD 0 0 0 255 ECU_ADDRESS 0x400DF2FC /end MEASUREMENT
/begin MEASUREMENT MCore_rb_SipF_ProcessImage.Cat1[22].switches.mcalInputDisconnect "" SBYTE rb_SipF_ProcessImage.Cat1[22].switches.mcalInputDisconnect.CONVERSION 0 0 -128 127 ECU_ADDRESS 0x400DF2FC /end MEASUREMENT
/begin MEASUREMENT MCore_rb_SipF_ProcessImage.Cat1[22].switches.sipfInputDisconnect "" SBYTE rb_SipF_ProcessImage.Cat1[22].switches.sipfInputDisconnect.CONVERSION 0 0 -128 127 ECU_ADDRESS 0x400DF2FD /end MEASUREMENT
/begin MEASUREMENT MCore_rb_SipF_ProcessImage.Cat1[23].debCounter "" UWORD NO_COMPU_METHOD 0 0 0 65535 ECU_ADDRESS 0x400DF306 /end MEASUREMENT
/begin MEASUREMENT MCore_rb_SipF_ProcessImage.Cat1[23].debounced "" UWORD NO_COMPU_METHOD 0 0 0 65535 ECU_ADDRESS 0x400DF304 /end MEASUREMENT
/begin MEASUREMENT MCore_rb_SipF_ProcessImage.Cat1[23].discrete "" UWORD NO_COMPU_METHOD 0 0 0 65535 ECU_ADDRESS 0x400DF300 /end MEASUREMENT
/begin MEASUREMENT MCore_rb_SipF_ProcessImage.Cat1[23].discreteOld "" UWORD NO_COMPU_METHOD 0 0 0 65535 ECU_ADDRESS 0x400DF302 /end MEASUREMENT
/begin MEASUREMENT MCore_rb_SipF_ProcessImage.Cat1[23].processed "" UWORD NO_COMPU_METHOD 0 0 0 65535 ECU_ADDRESS 0x400DF308 /end MEASUREMENT
/begin MEASUREMENT MCore_rb_SipF_ProcessImage.Cat1[23].snapshot "" UWORD NO_COMPU_METHOD 0 0 0 65535 ECU_ADDRESS 0x400DF2FE /end MEASUREMENT
/begin MEASUREMENT MCore_rb_SipF_ProcessImage.Cat1[23].switches "" UBYTE NO_COMPU_METHOD 0 0 0 255 ECU_ADDRESS 0x400DF30A /end MEASUREMENT
/begin MEASUREMENT MCore_rb_SipF_ProcessImage.Cat1[23].switches.mcalInputDisconnect "" SBYTE rb_SipF_ProcessImage.Cat1[23].switches.mcalInputDisconnect.CONVERSION 0 0 -128 127 ECU_ADDRESS 0x400DF30A /end MEASUREMENT
/begin MEASUREMENT MCore_rb_SipF_ProcessImage.Cat1[23].switches.sipfInputDisconnect "" SBYTE rb_SipF_ProcessImage.Cat1[23].switches.sipfInputDisconnect.CONVERSION 0 0 -128 127 ECU_ADDRESS 0x400DF30B /end MEASUREMENT
/begin MEASUREMENT MCore_rb_SipF_ProcessImage.Cat1[24].debCounter "" UWORD NO_COMPU_METHOD 0 0 0 65535 ECU_ADDRESS 0x400DF314 /end MEASUREMENT
/begin MEASUREMENT MCore_rb_SipF_ProcessImage.Cat1[24].debounced "" UWORD NO_COMPU_METHOD 0 0 0 65535 ECU_ADDRESS 0x400DF312 /end MEASUREMENT
/begin MEASUREMENT MCore_rb_SipF_ProcessImage.Cat1[24].discrete "" UWORD NO_COMPU_METHOD 0 0 0 65535 ECU_ADDRESS 0x400DF30E /end MEASUREMENT
/begin MEASUREMENT MCore_rb_SipF_ProcessImage.Cat1[24].discreteOld "" UWORD NO_COMPU_METHOD 0 0 0 65535 ECU_ADDRESS 0x400DF310 /end MEASUREMENT
/begin MEASUREMENT MCore_rb_SipF_ProcessImage.Cat1[24].processed "" UWORD NO_COMPU_METHOD 0 0 0 65535 ECU_ADDRESS 0x400DF316 /end MEASUREMENT
/begin MEASUREMENT MCore_rb_SipF_ProcessImage.Cat1[24].snapshot "" UWORD NO_COMPU_METHOD 0 0 0 65535 ECU_ADDRESS 0x400DF30C /end MEASUREMENT
/begin MEASUREMENT MCore_rb_SipF_ProcessImage.Cat1[24].switches "" UBYTE NO_COMPU_METHOD 0 0 0 255 ECU_ADDRESS 0x400DF318 /end MEASUREMENT
/begin MEASUREMENT MCore_rb_SipF_ProcessImage.Cat1[24].switches.mcalInputDisconnect "" SBYTE rb_SipF_ProcessImage.Cat1[24].switches.mcalInputDisconnect.CONVERSION 0 0 -128 127 ECU_ADDRESS 0x400DF318 /end MEASUREMENT
/begin MEASUREMENT MCore_rb_SipF_ProcessImage.Cat1[24].switches.sipfInputDisconnect "" SBYTE rb_SipF_ProcessImage.Cat1[24].switches.sipfInputDisconnect.CONVERSION 0 0 -128 127 ECU_ADDRESS 0x400DF319 /end MEASUREMENT
/begin MEASUREMENT MCore_rb_SipF_ProcessImage.Cat1[25].debCounter "" UWORD NO_COMPU_METHOD 0 0 0 65535 ECU_ADDRESS 0x400DF322 /end MEASUREMENT
/begin MEASUREMENT MCore_rb_SipF_ProcessImage.Cat1[25].debounced "" UWORD NO_COMPU_METHOD 0 0 0 65535 ECU_ADDRESS 0x400DF320 /end MEASUREMENT
/begin MEASUREMENT MCore_rb_SipF_ProcessImage.Cat1[25].discrete "" UWORD NO_COMPU_METHOD 0 0 0 65535 ECU_ADDRESS 0x400DF31C /end MEASUREMENT
/begin MEASUREMENT MCore_rb_SipF_ProcessImage.Cat1[25].discreteOld "" UWORD NO_COMPU_METHOD 0 0 0 65535 ECU_ADDRESS 0x400DF31E /end MEASUREMENT
/begin MEASUREMENT MCore_rb_SipF_ProcessImage.Cat1[25].processed "" UWORD NO_COMPU_METHOD 0 0 0 65535 ECU_ADDRESS 0x400DF324 /end MEASUREMENT
/begin MEASUREMENT MCore_rb_SipF_ProcessImage.Cat1[25].snapshot "" UWORD NO_COMPU_METHOD 0 0 0 65535 ECU_ADDRESS 0x400DF31A /end MEASUREMENT
/begin MEASUREMENT MCore_rb_SipF_ProcessImage.Cat1[25].switches "" UBYTE NO_COMPU_METHOD 0 0 0 255 ECU_ADDRESS 0x400DF326 /end MEASUREMENT
/begin MEASUREMENT MCore_rb_SipF_ProcessImage.Cat1[25].switches.mcalInputDisconnect "" SBYTE rb_SipF_ProcessImage.Cat1[25].switches.mcalInputDisconnect.CONVERSION 0 0 -128 127 ECU_ADDRESS 0x400DF326 /end MEASUREMENT
/begin MEASUREMENT MCore_rb_SipF_ProcessImage.Cat1[25].switches.sipfInputDisconnect "" SBYTE rb_SipF_ProcessImage.Cat1[25].switches.sipfInputDisconnect.CONVERSION 0 0 -128 127 ECU_ADDRESS 0x400DF327 /end MEASUREMENT
/begin MEASUREMENT MCore_rb_SipF_ProcessImage.Cat1[26].debCounter "" UWORD NO_COMPU_METHOD 0 0 0 65535 ECU_ADDRESS 0x400DF330 /end MEASUREMENT
/begin MEASUREMENT MCore_rb_SipF_ProcessImage.Cat1[26].debounced "" UWORD NO_COMPU_METHOD 0 0 0 65535 ECU_ADDRESS 0x400DF32E /end MEASUREMENT
/begin MEASUREMENT MCore_rb_SipF_ProcessImage.Cat1[26].discrete "" UWORD NO_COMPU_METHOD 0 0 0 65535 ECU_ADDRESS 0x400DF32A /end MEASUREMENT
/begin MEASUREMENT MCore_rb_SipF_ProcessImage.Cat1[26].discreteOld "" UWORD NO_COMPU_METHOD 0 0 0 65535 ECU_ADDRESS 0x400DF32C /end MEASUREMENT
/begin MEASUREMENT MCore_rb_SipF_ProcessImage.Cat1[26].processed "" UWORD NO_COMPU_METHOD 0 0 0 65535 ECU_ADDRESS 0x400DF332 /end MEASUREMENT
/begin MEASUREMENT MCore_rb_SipF_ProcessImage.Cat1[26].snapshot "" UWORD NO_COMPU_METHOD 0 0 0 65535 ECU_ADDRESS 0x400DF328 /end MEASUREMENT
/begin MEASUREMENT MCore_rb_SipF_ProcessImage.Cat1[26].switches "" UBYTE NO_COMPU_METHOD 0 0 0 255 ECU_ADDRESS 0x400DF334 /end MEASUREMENT
/begin MEASUREMENT MCore_rb_SipF_ProcessImage.Cat1[26].switches.mcalInputDisconnect "" SBYTE rb_SipF_ProcessImage.Cat1[26].switches.mcalInputDisconnect.CONVERSION 0 0 -128 127 ECU_ADDRESS 0x400DF334 /end MEASUREMENT
/begin MEASUREMENT MCore_rb_SipF_ProcessImage.Cat1[26].switches.sipfInputDisconnect "" SBYTE rb_SipF_ProcessImage.Cat1[26].switches.sipfInputDisconnect.CONVERSION 0 0 -128 127 ECU_ADDRESS 0x400DF335 /end MEASUREMENT
/begin MEASUREMENT MCore_rb_SipF_ProcessImage.Cat1[27].debCounter "" UWORD NO_COMPU_METHOD 0 0 0 65535 ECU_ADDRESS 0x400DF33E /end MEASUREMENT
/begin MEASUREMENT MCore_rb_SipF_ProcessImage.Cat1[27].debounced "" UWORD NO_COMPU_METHOD 0 0 0 65535 ECU_ADDRESS 0x400DF33C /end MEASUREMENT
/begin MEASUREMENT MCore_rb_SipF_ProcessImage.Cat1[27].discrete "" UWORD NO_COMPU_METHOD 0 0 0 65535 ECU_ADDRESS 0x400DF338 /end MEASUREMENT
/begin MEASUREMENT MCore_rb_SipF_ProcessImage.Cat1[27].discreteOld "" UWORD NO_COMPU_METHOD 0 0 0 65535 ECU_ADDRESS 0x400DF33A /end MEASUREMENT
/begin MEASUREMENT MCore_rb_SipF_ProcessImage.Cat1[27].processed "" UWORD NO_COMPU_METHOD 0 0 0 65535 ECU_ADDRESS 0x400DF340 /end MEASUREMENT
/begin MEASUREMENT MCore_rb_SipF_ProcessImage.Cat1[27].snapshot "" UWORD NO_COMPU_METHOD 0 0 0 65535 ECU_ADDRESS 0x400DF336 /end MEASUREMENT
/begin MEASUREMENT MCore_rb_SipF_ProcessImage.Cat1[27].switches "" UBYTE NO_COMPU_METHOD 0 0 0 255 ECU_ADDRESS 0x400DF342 /end MEASUREMENT
/begin MEASUREMENT MCore_rb_SipF_ProcessImage.Cat1[27].switches.mcalInputDisconnect "" SBYTE rb_SipF_ProcessImage.Cat1[27].switches.mcalInputDisconnect.CONVERSION 0 0 -128 127 ECU_ADDRESS 0x400DF342 /end MEASUREMENT
/begin MEASUREMENT MCore_rb_SipF_ProcessImage.Cat1[27].switches.sipfInputDisconnect "" SBYTE rb_SipF_ProcessImage.Cat1[27].switches.sipfInputDisconnect.CONVERSION 0 0 -128 127 ECU_ADDRESS 0x400DF343 /end MEASUREMENT
/begin MEASUREMENT MCore_rb_SipF_ProcessImage.Cat1[28].debCounter "" UWORD NO_COMPU_METHOD 0 0 0 65535 ECU_ADDRESS 0x400DF34C /end MEASUREMENT
/begin MEASUREMENT MCore_rb_SipF_ProcessImage.Cat1[28].debounced "" UWORD NO_COMPU_METHOD 0 0 0 65535 ECU_ADDRESS 0x400DF34A /end MEASUREMENT
/begin MEASUREMENT MCore_rb_SipF_ProcessImage.Cat1[28].discrete "" UWORD NO_COMPU_METHOD 0 0 0 65535 ECU_ADDRESS 0x400DF346 /end MEASUREMENT
/begin MEASUREMENT MCore_rb_SipF_ProcessImage.Cat1[28].discreteOld "" UWORD NO_COMPU_METHOD 0 0 0 65535 ECU_ADDRESS 0x400DF348 /end MEASUREMENT
/begin MEASUREMENT MCore_rb_SipF_ProcessImage.Cat1[28].processed "" UWORD NO_COMPU_METHOD 0 0 0 65535 ECU_ADDRESS 0x400DF34E /end MEASUREMENT
/begin MEASUREMENT MCore_rb_SipF_ProcessImage.Cat1[28].snapshot "" UWORD NO_COMPU_METHOD 0 0 0 65535 ECU_ADDRESS 0x400DF344 /end MEASUREMENT
/begin MEASUREMENT MCore_rb_SipF_ProcessImage.Cat1[28].switches "" UBYTE NO_COMPU_METHOD 0 0 0 255 ECU_ADDRESS 0x400DF350 /end MEASUREMENT
/begin MEASUREMENT MCore_rb_SipF_ProcessImage.Cat1[28].switches.mcalInputDisconnect "" SBYTE rb_SipF_ProcessImage.Cat1[28].switches.mcalInputDisconnect.CONVERSION 0 0 -128 127 ECU_ADDRESS 0x400DF350 /end MEASUREMENT
/begin MEASUREMENT MCore_rb_SipF_ProcessImage.Cat1[28].switches.sipfInputDisconnect "" SBYTE rb_SipF_ProcessImage.Cat1[28].switches.sipfInputDisconnect.CONVERSION 0 0 -128 127 ECU_ADDRESS 0x400DF351 /end MEASUREMENT
/begin MEASUREMENT MCore_rb_SipF_ProcessImage.Cat1[29].debCounter "" UWORD NO_COMPU_METHOD 0 0 0 65535 ECU_ADDRESS 0x400DF35A /end MEASUREMENT
/begin MEASUREMENT MCore_rb_SipF_ProcessImage.Cat1[29].debounced "" UWORD NO_COMPU_METHOD 0 0 0 65535 ECU_ADDRESS 0x400DF358 /end MEASUREMENT
/begin MEASUREMENT MCore_rb_SipF_ProcessImage.Cat1[29].discrete "" UWORD NO_COMPU_METHOD 0 0 0 65535 ECU_ADDRESS 0x400DF354 /end MEASUREMENT
/begin MEASUREMENT MCore_rb_SipF_ProcessImage.Cat1[29].discreteOld "" UWORD NO_COMPU_METHOD 0 0 0 65535 ECU_ADDRESS 0x400DF356 /end MEASUREMENT
/begin MEASUREMENT MCore_rb_SipF_ProcessImage.Cat1[29].processed "" UWORD NO_COMPU_METHOD 0 0 0 65535 ECU_ADDRESS 0x400DF35C /end MEASUREMENT
/begin MEASUREMENT MCore_rb_SipF_ProcessImage.Cat1[29].snapshot "" UWORD NO_COMPU_METHOD 0 0 0 65535 ECU_ADDRESS 0x400DF352 /end MEASUREMENT
/begin MEASUREMENT MCore_rb_SipF_ProcessImage.Cat1[29].switches "" UBYTE NO_COMPU_METHOD 0 0 0 255 ECU_ADDRESS 0x400DF35E /end MEASUREMENT
/begin MEASUREMENT MCore_rb_SipF_ProcessImage.Cat1[29].switches.mcalInputDisconnect "" SBYTE rb_SipF_ProcessImage.Cat1[29].switches.mcalInputDisconnect.CONVERSION 0 0 -128 127 ECU_ADDRESS 0x400DF35E /end MEASUREMENT
/begin MEASUREMENT MCore_rb_SipF_ProcessImage.Cat1[29].switches.sipfInputDisconnect "" SBYTE rb_SipF_ProcessImage.Cat1[29].switches.sipfInputDisconnect.CONVERSION 0 0 -128 127 ECU_ADDRESS 0x400DF35F /end MEASUREMENT
/begin MEASUREMENT MCore_rb_SipF_ProcessImage.Cat1[2].debCounter "" UWORD NO_COMPU_METHOD 0 0 0 65535 ECU_ADDRESS 0x400DF1E0 /end MEASUREMENT
/begin MEASUREMENT MCore_rb_SipF_ProcessImage.Cat1[2].debounced "" UWORD NO_COMPU_METHOD 0 0 0 65535 ECU_ADDRESS 0x400DF1DE /end MEASUREMENT
/begin MEASUREMENT MCore_rb_SipF_ProcessImage.Cat1[2].discrete "" UWORD NO_COMPU_METHOD 0 0 0 65535 ECU_ADDRESS 0x400DF1DA /end MEASUREMENT
/begin MEASUREMENT MCore_rb_SipF_ProcessImage.Cat1[2].discreteOld "" UWORD NO_COMPU_METHOD 0 0 0 65535 ECU_ADDRESS 0x400DF1DC /end MEASUREMENT
/begin MEASUREMENT MCore_rb_SipF_ProcessImage.Cat1[2].processed "" UWORD NO_COMPU_METHOD 0 0 0 65535 ECU_ADDRESS 0x400DF1E2 /end MEASUREMENT
/begin MEASUREMENT MCore_rb_SipF_ProcessImage.Cat1[2].snapshot "" UWORD NO_COMPU_METHOD 0 0 0 65535 ECU_ADDRESS 0x400DF1D8 /end MEASUREMENT
/begin MEASUREMENT MCore_rb_SipF_ProcessImage.Cat1[2].switches "" UBYTE NO_COMPU_METHOD 0 0 0 255 ECU_ADDRESS 0x400DF1E4 /end MEASUREMENT
/begin MEASUREMENT MCore_rb_SipF_ProcessImage.Cat1[2].switches.mcalInputDisconnect "" SBYTE rb_SipF_ProcessImage.Cat1[2].switches.mcalInputDisconnect.CONVERSION 0 0 -128 127 ECU_ADDRESS 0x400DF1E4 /end MEASUREMENT
/begin MEASUREMENT MCore_rb_SipF_ProcessImage.Cat1[2].switches.sipfInputDisconnect "" SBYTE rb_SipF_ProcessImage.Cat1[2].switches.sipfInputDisconnect.CONVERSION 0 0 -128 127 ECU_ADDRESS 0x400DF1E5 /end MEASUREMENT
/begin MEASUREMENT MCore_rb_SipF_ProcessImage.Cat1[30].debCounter "" UWORD NO_COMPU_METHOD 0 0 0 65535 ECU_ADDRESS 0x400DF368 /end MEASUREMENT
/begin MEASUREMENT MCore_rb_SipF_ProcessImage.Cat1[30].debounced "" UWORD NO_COMPU_METHOD 0 0 0 65535 ECU_ADDRESS 0x400DF366 /end MEASUREMENT
/begin MEASUREMENT MCore_rb_SipF_ProcessImage.Cat1[30].discrete "" UWORD NO_COMPU_METHOD 0 0 0 65535 ECU_ADDRESS 0x400DF362 /end MEASUREMENT
/begin MEASUREMENT MCore_rb_SipF_ProcessImage.Cat1[30].discreteOld "" UWORD NO_COMPU_METHOD 0 0 0 65535 ECU_ADDRESS 0x400DF364 /end MEASUREMENT
/begin MEASUREMENT MCore_rb_SipF_ProcessImage.Cat1[30].processed "" UWORD NO_COMPU_METHOD 0 0 0 65535 ECU_ADDRESS 0x400DF36A /end MEASUREMENT
/begin MEASUREMENT MCore_rb_SipF_ProcessImage.Cat1[30].snapshot "" UWORD NO_COMPU_METHOD 0 0 0 65535 ECU_ADDRESS 0x400DF360 /end MEASUREMENT
/begin MEASUREMENT MCore_rb_SipF_ProcessImage.Cat1[30].switches "" UBYTE NO_COMPU_METHOD 0 0 0 255 ECU_ADDRESS 0x400DF36C /end MEASUREMENT
/begin MEASUREMENT MCore_rb_SipF_ProcessImage.Cat1[30].switches.mcalInputDisconnect "" SBYTE rb_SipF_ProcessImage.Cat1[30].switches.mcalInputDisconnect.CONVERSION 0 0 -128 127 ECU_ADDRESS 0x400DF36C /end MEASUREMENT
/begin MEASUREMENT MCore_rb_SipF_ProcessImage.Cat1[30].switches.sipfInputDisconnect "" SBYTE rb_SipF_ProcessImage.Cat1[30].switches.sipfInputDisconnect.CONVERSION 0 0 -128 127 ECU_ADDRESS 0x400DF36D /end MEASUREMENT
/begin MEASUREMENT MCore_rb_SipF_ProcessImage.Cat1[31].debCounter "" UWORD NO_COMPU_METHOD 0 0 0 65535 ECU_ADDRESS 0x400DF376 /end MEASUREMENT
/begin MEASUREMENT MCore_rb_SipF_ProcessImage.Cat1[31].debounced "" UWORD NO_COMPU_METHOD 0 0 0 65535 ECU_ADDRESS 0x400DF374 /end MEASUREMENT
/begin MEASUREMENT MCore_rb_SipF_ProcessImage.Cat1[31].discrete "" UWORD NO_COMPU_METHOD 0 0 0 65535 ECU_ADDRESS 0x400DF370 /end MEASUREMENT
/begin MEASUREMENT MCore_rb_SipF_ProcessImage.Cat1[31].discreteOld "" UWORD NO_COMPU_METHOD 0 0 0 65535 ECU_ADDRESS 0x400DF372 /end MEASUREMENT
/begin MEASUREMENT MCore_rb_SipF_ProcessImage.Cat1[31].processed "" UWORD NO_COMPU_METHOD 0 0 0 65535 ECU_ADDRESS 0x400DF378 /end MEASUREMENT
/begin MEASUREMENT MCore_rb_SipF_ProcessImage.Cat1[31].snapshot "" UWORD NO_COMPU_METHOD 0 0 0 65535 ECU_ADDRESS 0x400DF36E /end MEASUREMENT
/begin MEASUREMENT MCore_rb_SipF_ProcessImage.Cat1[31].switches "" UBYTE NO_COMPU_METHOD 0 0 0 255 ECU_ADDRESS 0x400DF37A /end MEASUREMENT
/begin MEASUREMENT MCore_rb_SipF_ProcessImage.Cat1[31].switches.mcalInputDisconnect "" SBYTE rb_SipF_ProcessImage.Cat1[31].switches.mcalInputDisconnect.CONVERSION 0 0 -128 127 ECU_ADDRESS 0x400DF37A /end MEASUREMENT
/begin MEASUREMENT MCore_rb_SipF_ProcessImage.Cat1[31].switches.sipfInputDisconnect "" SBYTE rb_SipF_ProcessImage.Cat1[31].switches.sipfInputDisconnect.CONVERSION 0 0 -128 127 ECU_ADDRESS 0x400DF37B /end MEASUREMENT
/begin MEASUREMENT MCore_rb_SipF_ProcessImage.Cat1[32].debCounter "" UWORD NO_COMPU_METHOD 0 0 0 65535 ECU_ADDRESS 0x400DF384 /end MEASUREMENT
/begin MEASUREMENT MCore_rb_SipF_ProcessImage.Cat1[32].debounced "" UWORD NO_COMPU_METHOD 0 0 0 65535 ECU_ADDRESS 0x400DF382 /end MEASUREMENT
/begin MEASUREMENT MCore_rb_SipF_ProcessImage.Cat1[32].discrete "" UWORD NO_COMPU_METHOD 0 0 0 65535 ECU_ADDRESS 0x400DF37E /end MEASUREMENT
/begin MEASUREMENT MCore_rb_SipF_ProcessImage.Cat1[32].discreteOld "" UWORD NO_COMPU_METHOD 0 0 0 65535 ECU_ADDRESS 0x400DF380 /end MEASUREMENT
/begin MEASUREMENT MCore_rb_SipF_ProcessImage.Cat1[32].processed "" UWORD NO_COMPU_METHOD 0 0 0 65535 ECU_ADDRESS 0x400DF386 /end MEASUREMENT
/begin MEASUREMENT MCore_rb_SipF_ProcessImage.Cat1[32].snapshot "" UWORD NO_COMPU_METHOD 0 0 0 65535 ECU_ADDRESS 0x400DF37C /end MEASUREMENT
/begin MEASUREMENT MCore_rb_SipF_ProcessImage.Cat1[32].switches "" UBYTE NO_COMPU_METHOD 0 0 0 255 ECU_ADDRESS 0x400DF388 /end MEASUREMENT
/begin MEASUREMENT MCore_rb_SipF_ProcessImage.Cat1[32].switches.mcalInputDisconnect "" SBYTE rb_SipF_ProcessImage.Cat1[32].switches.mcalInputDisconnect.CONVERSION 0 0 -128 127 ECU_ADDRESS 0x400DF388 /end MEASUREMENT
/begin MEASUREMENT MCore_rb_SipF_ProcessImage.Cat1[32].switches.sipfInputDisconnect "" SBYTE rb_SipF_ProcessImage.Cat1[32].switches.sipfInputDisconnect.CONVERSION 0 0 -128 127 ECU_ADDRESS 0x400DF389 /end MEASUREMENT
/begin MEASUREMENT MCore_rb_SipF_ProcessImage.Cat1[33].debCounter "" UWORD NO_COMPU_METHOD 0 0 0 65535 ECU_ADDRESS 0x400DF392 /end MEASUREMENT
/begin MEASUREMENT MCore_rb_SipF_ProcessImage.Cat1[33].debounced "" UWORD NO_COMPU_METHOD 0 0 0 65535 ECU_ADDRESS 0x400DF390 /end MEASUREMENT
/begin MEASUREMENT MCore_rb_SipF_ProcessImage.Cat1[33].discrete "" UWORD NO_COMPU_METHOD 0 0 0 65535 ECU_ADDRESS 0x400DF38C /end MEASUREMENT
/begin MEASUREMENT MCore_rb_SipF_ProcessImage.Cat1[33].discreteOld "" UWORD NO_COMPU_METHOD 0 0 0 65535 ECU_ADDRESS 0x400DF38E /end MEASUREMENT
/begin MEASUREMENT MCore_rb_SipF_ProcessImage.Cat1[33].processed "" UWORD NO_COMPU_METHOD 0 0 0 65535 ECU_ADDRESS 0x400DF394 /end MEASUREMENT
/begin MEASUREMENT MCore_rb_SipF_ProcessImage.Cat1[33].snapshot "" UWORD NO_COMPU_METHOD 0 0 0 65535 ECU_ADDRESS 0x400DF38A /end MEASUREMENT
/begin MEASUREMENT MCore_rb_SipF_ProcessImage.Cat1[33].switches "" UBYTE NO_COMPU_METHOD 0 0 0 255 ECU_ADDRESS 0x400DF396 /end MEASUREMENT
/begin MEASUREMENT MCore_rb_SipF_ProcessImage.Cat1[33].switches.mcalInputDisconnect "" SBYTE rb_SipF_ProcessImage.Cat1[33].switches.mcalInputDisconnect.CONVERSION 0 0 -128 127 ECU_ADDRESS 0x400DF396 /end MEASUREMENT
/begin MEASUREMENT MCore_rb_SipF_ProcessImage.Cat1[33].switches.sipfInputDisconnect "" SBYTE rb_SipF_ProcessImage.Cat1[33].switches.sipfInputDisconnect.CONVERSION 0 0 -128 127 ECU_ADDRESS 0x400DF397 /end MEASUREMENT
/begin MEASUREMENT MCore_rb_SipF_ProcessImage.Cat1[34].debCounter "" UWORD NO_COMPU_METHOD 0 0 0 65535 ECU_ADDRESS 0x400DF3A0 /end MEASUREMENT
/begin MEASUREMENT MCore_rb_SipF_ProcessImage.Cat1[34].debounced "" UWORD NO_COMPU_METHOD 0 0 0 65535 ECU_ADDRESS 0x400DF39E /end MEASUREMENT
/begin MEASUREMENT MCore_rb_SipF_ProcessImage.Cat1[34].discrete "" UWORD NO_COMPU_METHOD 0 0 0 65535 ECU_ADDRESS 0x400DF39A /end MEASUREMENT
/begin MEASUREMENT MCore_rb_SipF_ProcessImage.Cat1[34].discreteOld "" UWORD NO_COMPU_METHOD 0 0 0 65535 ECU_ADDRESS 0x400DF39C /end MEASUREMENT
/begin MEASUREMENT MCore_rb_SipF_ProcessImage.Cat1[34].processed "" UWORD NO_COMPU_METHOD 0 0 0 65535 ECU_ADDRESS 0x400DF3A2 /end MEASUREMENT
/begin MEASUREMENT MCore_rb_SipF_ProcessImage.Cat1[34].snapshot "" UWORD NO_COMPU_METHOD 0 0 0 65535 ECU_ADDRESS 0x400DF398 /end MEASUREMENT
/begin MEASUREMENT MCore_rb_SipF_ProcessImage.Cat1[34].switches "" UBYTE NO_COMPU_METHOD 0 0 0 255 ECU_ADDRESS 0x400DF3A4 /end MEASUREMENT
/begin MEASUREMENT MCore_rb_SipF_ProcessImage.Cat1[34].switches.mcalInputDisconnect "" SBYTE rb_SipF_ProcessImage.Cat1[34].switches.mcalInputDisconnect.CONVERSION 0 0 -128 127 ECU_ADDRESS 0x400DF3A4 /end MEASUREMENT
/begin MEASUREMENT MCore_rb_SipF_ProcessImage.Cat1[34].switches.sipfInputDisconnect "" SBYTE rb_SipF_ProcessImage.Cat1[34].switches.sipfInputDisconnect.CONVERSION 0 0 -128 127 ECU_ADDRESS 0x400DF3A5 /end MEASUREMENT
/begin MEASUREMENT MCore_rb_SipF_ProcessImage.Cat1[35].debCounter "" UWORD NO_COMPU_METHOD 0 0 0 65535 ECU_ADDRESS 0x400DF3AE /end MEASUREMENT
/begin MEASUREMENT MCore_rb_SipF_ProcessImage.Cat1[35].debounced "" UWORD NO_COMPU_METHOD 0 0 0 65535 ECU_ADDRESS 0x400DF3AC /end MEASUREMENT
/begin MEASUREMENT MCore_rb_SipF_ProcessImage.Cat1[35].discrete "" UWORD NO_COMPU_METHOD 0 0 0 65535 ECU_ADDRESS 0x400DF3A8 /end MEASUREMENT
/begin MEASUREMENT MCore_rb_SipF_ProcessImage.Cat1[35].discreteOld "" UWORD NO_COMPU_METHOD 0 0 0 65535 ECU_ADDRESS 0x400DF3AA /end MEASUREMENT
/begin MEASUREMENT MCore_rb_SipF_ProcessImage.Cat1[35].processed "" UWORD NO_COMPU_METHOD 0 0 0 65535 ECU_ADDRESS 0x400DF3B0 /end MEASUREMENT
/begin MEASUREMENT MCore_rb_SipF_ProcessImage.Cat1[35].snapshot "" UWORD NO_COMPU_METHOD 0 0 0 65535 ECU_ADDRESS 0x400DF3A6 /end MEASUREMENT
/begin MEASUREMENT MCore_rb_SipF_ProcessImage.Cat1[35].switches "" UBYTE NO_COMPU_METHOD 0 0 0 255 ECU_ADDRESS 0x400DF3B2 /end MEASUREMENT
/begin MEASUREMENT MCore_rb_SipF_ProcessImage.Cat1[35].switches.mcalInputDisconnect "" SBYTE rb_SipF_ProcessImage.Cat1[35].switches.mcalInputDisconnect.CONVERSION 0 0 -128 127 ECU_ADDRESS 0x400DF3B2 /end MEASUREMENT
/begin MEASUREMENT MCore_rb_SipF_ProcessImage.Cat1[35].switches.sipfInputDisconnect "" SBYTE rb_SipF_ProcessImage.Cat1[35].switches.sipfInputDisconnect.CONVERSION 0 0 -128 127 ECU_ADDRESS 0x400DF3B3 /end MEASUREMENT
/begin MEASUREMENT MCore_rb_SipF_ProcessImage.Cat1[36].debCounter "" UWORD NO_COMPU_METHOD 0 0 0 65535 ECU_ADDRESS 0x400DF3BC /end MEASUREMENT
/begin MEASUREMENT MCore_rb_SipF_ProcessImage.Cat1[36].debounced "" UWORD NO_COMPU_METHOD 0 0 0 65535 ECU_ADDRESS 0x400DF3BA /end MEASUREMENT
/begin MEASUREMENT MCore_rb_SipF_ProcessImage.Cat1[36].discrete "" UWORD NO_COMPU_METHOD 0 0 0 65535 ECU_ADDRESS 0x400DF3B6 /end MEASUREMENT
/begin MEASUREMENT MCore_rb_SipF_ProcessImage.Cat1[36].discreteOld "" UWORD NO_COMPU_METHOD 0 0 0 65535 ECU_ADDRESS 0x400DF3B8 /end MEASUREMENT
/begin MEASUREMENT MCore_rb_SipF_ProcessImage.Cat1[36].processed "" UWORD NO_COMPU_METHOD 0 0 0 65535 ECU_ADDRESS 0x400DF3BE /end MEASUREMENT
/begin MEASUREMENT MCore_rb_SipF_ProcessImage.Cat1[36].snapshot "" UWORD NO_COMPU_METHOD 0 0 0 65535 ECU_ADDRESS 0x400DF3B4 /end MEASUREMENT
/begin MEASUREMENT MCore_rb_SipF_ProcessImage.Cat1[36].switches "" UBYTE NO_COMPU_METHOD 0 0 0 255 ECU_ADDRESS 0x400DF3C0 /end MEASUREMENT
/begin MEASUREMENT MCore_rb_SipF_ProcessImage.Cat1[36].switches.mcalInputDisconnect "" SBYTE rb_SipF_ProcessImage.Cat1[36].switches.mcalInputDisconnect.CONVERSION 0 0 -128 127 ECU_ADDRESS 0x400DF3C0 /end MEASUREMENT
/begin MEASUREMENT MCore_rb_SipF_ProcessImage.Cat1[36].switches.sipfInputDisconnect "" SBYTE rb_SipF_ProcessImage.Cat1[36].switches.sipfInputDisconnect.CONVERSION 0 0 -128 127 ECU_ADDRESS 0x400DF3C1 /end MEASUREMENT
/begin MEASUREMENT MCore_rb_SipF_ProcessImage.Cat1[37].debCounter "" UWORD NO_COMPU_METHOD 0 0 0 65535 ECU_ADDRESS 0x400DF3CA /end MEASUREMENT
/begin MEASUREMENT MCore_rb_SipF_ProcessImage.Cat1[37].debounced "" UWORD NO_COMPU_METHOD 0 0 0 65535 ECU_ADDRESS 0x400DF3C8 /end MEASUREMENT
/begin MEASUREMENT MCore_rb_SipF_ProcessImage.Cat1[37].discrete "" UWORD NO_COMPU_METHOD 0 0 0 65535 ECU_ADDRESS 0x400DF3C4 /end MEASUREMENT
/begin MEASUREMENT MCore_rb_SipF_ProcessImage.Cat1[37].discreteOld "" UWORD NO_COMPU_METHOD 0 0 0 65535 ECU_ADDRESS 0x400DF3C6 /end MEASUREMENT
/begin MEASUREMENT MCore_rb_SipF_ProcessImage.Cat1[37].processed "" UWORD NO_COMPU_METHOD 0 0 0 65535 ECU_ADDRESS 0x400DF3CC /end MEASUREMENT
/begin MEASUREMENT MCore_rb_SipF_ProcessImage.Cat1[37].snapshot "" UWORD NO_COMPU_METHOD 0 0 0 65535 ECU_ADDRESS 0x400DF3C2 /end MEASUREMENT
/begin MEASUREMENT MCore_rb_SipF_ProcessImage.Cat1[37].switches "" UBYTE NO_COMPU_METHOD 0 0 0 255 ECU_ADDRESS 0x400DF3CE /end MEASUREMENT
/begin MEASUREMENT MCore_rb_SipF_ProcessImage.Cat1[37].switches.mcalInputDisconnect "" SBYTE rb_SipF_ProcessImage.Cat1[37].switches.mcalInputDisconnect.CONVERSION 0 0 -128 127 ECU_ADDRESS 0x400DF3CE /end MEASUREMENT
/begin MEASUREMENT MCore_rb_SipF_ProcessImage.Cat1[37].switches.sipfInputDisconnect "" SBYTE rb_SipF_ProcessImage.Cat1[37].switches.sipfInputDisconnect.CONVERSION 0 0 -128 127 ECU_ADDRESS 0x400DF3CF /end MEASUREMENT
/begin MEASUREMENT MCore_rb_SipF_ProcessImage.Cat1[38].debCounter "" UWORD NO_COMPU_METHOD 0 0 0 65535 ECU_ADDRESS 0x400DF3D8 /end MEASUREMENT
/begin MEASUREMENT MCore_rb_SipF_ProcessImage.Cat1[38].debounced "" UWORD NO_COMPU_METHOD 0 0 0 65535 ECU_ADDRESS 0x400DF3D6 /end MEASUREMENT
/begin MEASUREMENT MCore_rb_SipF_ProcessImage.Cat1[38].discrete "" UWORD NO_COMPU_METHOD 0 0 0 65535 ECU_ADDRESS 0x400DF3D2 /end MEASUREMENT
/begin MEASUREMENT MCore_rb_SipF_ProcessImage.Cat1[38].discreteOld "" UWORD NO_COMPU_METHOD 0 0 0 65535 ECU_ADDRESS 0x400DF3D4 /end MEASUREMENT
/begin MEASUREMENT MCore_rb_SipF_ProcessImage.Cat1[38].processed "" UWORD NO_COMPU_METHOD 0 0 0 65535 ECU_ADDRESS 0x400DF3DA /end MEASUREMENT
/begin MEASUREMENT MCore_rb_SipF_ProcessImage.Cat1[38].snapshot "" UWORD NO_COMPU_METHOD 0 0 0 65535 ECU_ADDRESS 0x400DF3D0 /end MEASUREMENT
/begin MEASUREMENT MCore_rb_SipF_ProcessImage.Cat1[38].switches "" UBYTE NO_COMPU_METHOD 0 0 0 255 ECU_ADDRESS 0x400DF3DC /end MEASUREMENT
/begin MEASUREMENT MCore_rb_SipF_ProcessImage.Cat1[38].switches.mcalInputDisconnect "" SBYTE rb_SipF_ProcessImage.Cat1[38].switches.mcalInputDisconnect.CONVERSION 0 0 -128 127 ECU_ADDRESS 0x400DF3DC /end MEASUREMENT
/begin MEASUREMENT MCore_rb_SipF_ProcessImage.Cat1[38].switches.sipfInputDisconnect "" SBYTE rb_SipF_ProcessImage.Cat1[38].switches.sipfInputDisconnect.CONVERSION 0 0 -128 127 ECU_ADDRESS 0x400DF3DD /end MEASUREMENT
/begin MEASUREMENT MCore_rb_SipF_ProcessImage.Cat1[3].debCounter "" UWORD NO_COMPU_METHOD 0 0 0 65535 ECU_ADDRESS 0x400DF1EE /end MEASUREMENT
/begin MEASUREMENT MCore_rb_SipF_ProcessImage.Cat1[3].debounced "" UWORD NO_COMPU_METHOD 0 0 0 65535 ECU_ADDRESS 0x400DF1EC /end MEASUREMENT
/begin MEASUREMENT MCore_rb_SipF_ProcessImage.Cat1[3].discrete "" UWORD NO_COMPU_METHOD 0 0 0 65535 ECU_ADDRESS 0x400DF1E8 /end MEASUREMENT
/begin MEASUREMENT MCore_rb_SipF_ProcessImage.Cat1[3].discreteOld "" UWORD NO_COMPU_METHOD 0 0 0 65535 ECU_ADDRESS 0x400DF1EA /end MEASUREMENT
/begin MEASUREMENT MCore_rb_SipF_ProcessImage.Cat1[3].processed "" UWORD NO_COMPU_METHOD 0 0 0 65535 ECU_ADDRESS 0x400DF1F0 /end MEASUREMENT
/begin MEASUREMENT MCore_rb_SipF_ProcessImage.Cat1[3].snapshot "" UWORD NO_COMPU_METHOD 0 0 0 65535 ECU_ADDRESS 0x400DF1E6 /end MEASUREMENT
/begin MEASUREMENT MCore_rb_SipF_ProcessImage.Cat1[3].switches "" UBYTE NO_COMPU_METHOD 0 0 0 255 ECU_ADDRESS 0x400DF1F2 /end MEASUREMENT
/begin MEASUREMENT MCore_rb_SipF_ProcessImage.Cat1[3].switches.mcalInputDisconnect "" SBYTE rb_SipF_ProcessImage.Cat1[3].switches.mcalInputDisconnect.CONVERSION 0 0 -128 127 ECU_ADDRESS 0x400DF1F2 /end MEASUREMENT
/begin MEASUREMENT MCore_rb_SipF_ProcessImage.Cat1[3].switches.sipfInputDisconnect "" SBYTE rb_SipF_ProcessImage.Cat1[3].switches.sipfInputDisconnect.CONVERSION 0 0 -128 127 ECU_ADDRESS 0x400DF1F3 /end MEASUREMENT
/begin MEASUREMENT MCore_rb_SipF_ProcessImage.Cat1[4].debCounter "" UWORD NO_COMPU_METHOD 0 0 0 65535 ECU_ADDRESS 0x400DF1FC /end MEASUREMENT
/begin MEASUREMENT MCore_rb_SipF_ProcessImage.Cat1[4].debounced "" UWORD NO_COMPU_METHOD 0 0 0 65535 ECU_ADDRESS 0x400DF1FA /end MEASUREMENT
/begin MEASUREMENT MCore_rb_SipF_ProcessImage.Cat1[4].discrete "" UWORD NO_COMPU_METHOD 0 0 0 65535 ECU_ADDRESS 0x400DF1F6 /end MEASUREMENT
/begin MEASUREMENT MCore_rb_SipF_ProcessImage.Cat1[4].discreteOld "" UWORD NO_COMPU_METHOD 0 0 0 65535 ECU_ADDRESS 0x400DF1F8 /end MEASUREMENT
/begin MEASUREMENT MCore_rb_SipF_ProcessImage.Cat1[4].processed "" UWORD NO_COMPU_METHOD 0 0 0 65535 ECU_ADDRESS 0x400DF1FE /end MEASUREMENT
/begin MEASUREMENT MCore_rb_SipF_ProcessImage.Cat1[4].snapshot "" UWORD NO_COMPU_METHOD 0 0 0 65535 ECU_ADDRESS 0x400DF1F4 /end MEASUREMENT
/begin MEASUREMENT MCore_rb_SipF_ProcessImage.Cat1[4].switches "" UBYTE NO_COMPU_METHOD 0 0 0 255 ECU_ADDRESS 0x400DF200 /end MEASUREMENT
/begin MEASUREMENT MCore_rb_SipF_ProcessImage.Cat1[4].switches.mcalInputDisconnect "" SBYTE rb_SipF_ProcessImage.Cat1[4].switches.mcalInputDisconnect.CONVERSION 0 0 -128 127 ECU_ADDRESS 0x400DF200 /end MEASUREMENT
/begin MEASUREMENT MCore_rb_SipF_ProcessImage.Cat1[4].switches.sipfInputDisconnect "" SBYTE rb_SipF_ProcessImage.Cat1[4].switches.sipfInputDisconnect.CONVERSION 0 0 -128 127 ECU_ADDRESS 0x400DF201 /end MEASUREMENT
/begin MEASUREMENT MCore_rb_SipF_ProcessImage.Cat1[5].debCounter "" UWORD NO_COMPU_METHOD 0 0 0 65535 ECU_ADDRESS 0x400DF20A /end MEASUREMENT
/begin MEASUREMENT MCore_rb_SipF_ProcessImage.Cat1[5].debounced "" UWORD NO_COMPU_METHOD 0 0 0 65535 ECU_ADDRESS 0x400DF208 /end MEASUREMENT
/begin MEASUREMENT MCore_rb_SipF_ProcessImage.Cat1[5].discrete "" UWORD NO_COMPU_METHOD 0 0 0 65535 ECU_ADDRESS 0x400DF204 /end MEASUREMENT
/begin MEASUREMENT MCore_rb_SipF_ProcessImage.Cat1[5].discreteOld "" UWORD NO_COMPU_METHOD 0 0 0 65535 ECU_ADDRESS 0x400DF206 /end MEASUREMENT
/begin MEASUREMENT MCore_rb_SipF_ProcessImage.Cat1[5].processed "" UWORD NO_COMPU_METHOD 0 0 0 65535 ECU_ADDRESS 0x400DF20C /end MEASUREMENT
/begin MEASUREMENT MCore_rb_SipF_ProcessImage.Cat1[5].snapshot "" UWORD NO_COMPU_METHOD 0 0 0 65535 ECU_ADDRESS 0x400DF202 /end MEASUREMENT
/begin MEASUREMENT MCore_rb_SipF_ProcessImage.Cat1[5].switches "" UBYTE NO_COMPU_METHOD 0 0 0 255 ECU_ADDRESS 0x400DF20E /end MEASUREMENT
/begin MEASUREMENT MCore_rb_SipF_ProcessImage.Cat1[5].switches.mcalInputDisconnect "" SBYTE rb_SipF_ProcessImage.Cat1[5].switches.mcalInputDisconnect.CONVERSION 0 0 -128 127 ECU_ADDRESS 0x400DF20E /end MEASUREMENT
/begin MEASUREMENT MCore_rb_SipF_ProcessImage.Cat1[5].switches.sipfInputDisconnect "" SBYTE rb_SipF_ProcessImage.Cat1[5].switches.sipfInputDisconnect.CONVERSION 0 0 -128 127 ECU_ADDRESS 0x400DF20F /end MEASUREMENT
/begin MEASUREMENT MCore_rb_SipF_ProcessImage.Cat1[6].debCounter "" UWORD NO_COMPU_METHOD 0 0 0 65535 ECU_ADDRESS 0x400DF218 /end MEASUREMENT
/begin MEASUREMENT MCore_rb_SipF_ProcessImage.Cat1[6].debounced "" UWORD NO_COMPU_METHOD 0 0 0 65535 ECU_ADDRESS 0x400DF216 /end MEASUREMENT
/begin MEASUREMENT MCore_rb_SipF_ProcessImage.Cat1[6].discrete "" UWORD NO_COMPU_METHOD 0 0 0 65535 ECU_ADDRESS 0x400DF212 /end MEASUREMENT
/begin MEASUREMENT MCore_rb_SipF_ProcessImage.Cat1[6].discreteOld "" UWORD NO_COMPU_METHOD 0 0 0 65535 ECU_ADDRESS 0x400DF214 /end MEASUREMENT
/begin MEASUREMENT MCore_rb_SipF_ProcessImage.Cat1[6].processed "" UWORD NO_COMPU_METHOD 0 0 0 65535 ECU_ADDRESS 0x400DF21A /end MEASUREMENT
/begin MEASUREMENT MCore_rb_SipF_ProcessImage.Cat1[6].snapshot "" UWORD NO_COMPU_METHOD 0 0 0 65535 ECU_ADDRESS 0x400DF210 /end MEASUREMENT
/begin MEASUREMENT MCore_rb_SipF_ProcessImage.Cat1[6].switches "" UBYTE NO_COMPU_METHOD 0 0 0 255 ECU_ADDRESS 0x400DF21C /end MEASUREMENT
/begin MEASUREMENT MCore_rb_SipF_ProcessImage.Cat1[6].switches.mcalInputDisconnect "" SBYTE rb_SipF_ProcessImage.Cat1[6].switches.mcalInputDisconnect.CONVERSION 0 0 -128 127 ECU_ADDRESS 0x400DF21C /end MEASUREMENT
/begin MEASUREMENT MCore_rb_SipF_ProcessImage.Cat1[6].switches.sipfInputDisconnect "" SBYTE rb_SipF_ProcessImage.Cat1[6].switches.sipfInputDisconnect.CONVERSION 0 0 -128 127 ECU_ADDRESS 0x400DF21D /end MEASUREMENT
/begin MEASUREMENT MCore_rb_SipF_ProcessImage.Cat1[7].debCounter "" UWORD NO_COMPU_METHOD 0 0 0 65535 ECU_ADDRESS 0x400DF226 /end MEASUREMENT
/begin MEASUREMENT MCore_rb_SipF_ProcessImage.Cat1[7].debounced "" UWORD NO_COMPU_METHOD 0 0 0 65535 ECU_ADDRESS 0x400DF224 /end MEASUREMENT
/begin MEASUREMENT MCore_rb_SipF_ProcessImage.Cat1[7].discrete "" UWORD NO_COMPU_METHOD 0 0 0 65535 ECU_ADDRESS 0x400DF220 /end MEASUREMENT
/begin MEASUREMENT MCore_rb_SipF_ProcessImage.Cat1[7].discreteOld "" UWORD NO_COMPU_METHOD 0 0 0 65535 ECU_ADDRESS 0x400DF222 /end MEASUREMENT
/begin MEASUREMENT MCore_rb_SipF_ProcessImage.Cat1[7].processed "" UWORD NO_COMPU_METHOD 0 0 0 65535 ECU_ADDRESS 0x400DF228 /end MEASUREMENT
/begin MEASUREMENT MCore_rb_SipF_ProcessImage.Cat1[7].snapshot "" UWORD NO_COMPU_METHOD 0 0 0 65535 ECU_ADDRESS 0x400DF21E /end MEASUREMENT
/begin MEASUREMENT MCore_rb_SipF_ProcessImage.Cat1[7].switches "" UBYTE NO_COMPU_METHOD 0 0 0 255 ECU_ADDRESS 0x400DF22A /end MEASUREMENT
/begin MEASUREMENT MCore_rb_SipF_ProcessImage.Cat1[7].switches.mcalInputDisconnect "" SBYTE rb_SipF_ProcessImage.Cat1[7].switches.mcalInputDisconnect.CONVERSION 0 0 -128 127 ECU_ADDRESS 0x400DF22A /end MEASUREMENT
/begin MEASUREMENT MCore_rb_SipF_ProcessImage.Cat1[7].switches.sipfInputDisconnect "" SBYTE rb_SipF_ProcessImage.Cat1[7].switches.sipfInputDisconnect.CONVERSION 0 0 -128 127 ECU_ADDRESS 0x400DF22B /end MEASUREMENT
/begin MEASUREMENT MCore_rb_SipF_ProcessImage.Cat1[8].debCounter "" UWORD NO_COMPU_METHOD 0 0 0 65535 ECU_ADDRESS 0x400DF234 /end MEASUREMENT
/begin MEASUREMENT MCore_rb_SipF_ProcessImage.Cat1[8].debounced "" UWORD NO_COMPU_METHOD 0 0 0 65535 ECU_ADDRESS 0x400DF232 /end MEASUREMENT
/begin MEASUREMENT MCore_rb_SipF_ProcessImage.Cat1[8].discrete "" UWORD NO_COMPU_METHOD 0 0 0 65535 ECU_ADDRESS 0x400DF22E /end MEASUREMENT
/begin MEASUREMENT MCore_rb_SipF_ProcessImage.Cat1[8].discreteOld "" UWORD NO_COMPU_METHOD 0 0 0 65535 ECU_ADDRESS 0x400DF230 /end MEASUREMENT
/begin MEASUREMENT MCore_rb_SipF_ProcessImage.Cat1[8].processed "" UWORD NO_COMPU_METHOD 0 0 0 65535 ECU_ADDRESS 0x400DF236 /end MEASUREMENT
/begin MEASUREMENT MCore_rb_SipF_ProcessImage.Cat1[8].snapshot "" UWORD NO_COMPU_METHOD 0 0 0 65535 ECU_ADDRESS 0x400DF22C /end MEASUREMENT
/begin MEASUREMENT MCore_rb_SipF_ProcessImage.Cat1[8].switches "" UBYTE NO_COMPU_METHOD 0 0 0 255 ECU_ADDRESS 0x400DF238 /end MEASUREMENT
/begin MEASUREMENT MCore_rb_SipF_ProcessImage.Cat1[8].switches.mcalInputDisconnect "" SBYTE rb_SipF_ProcessImage.Cat1[8].switches.mcalInputDisconnect.CONVERSION 0 0 -128 127 ECU_ADDRESS 0x400DF238 /end MEASUREMENT
/begin MEASUREMENT MCore_rb_SipF_ProcessImage.Cat1[8].switches.sipfInputDisconnect "" SBYTE rb_SipF_ProcessImage.Cat1[8].switches.sipfInputDisconnect.CONVERSION 0 0 -128 127 ECU_ADDRESS 0x400DF239 /end MEASUREMENT
/begin MEASUREMENT MCore_rb_SipF_ProcessImage.Cat1[9].debCounter "" UWORD NO_COMPU_METHOD 0 0 0 65535 ECU_ADDRESS 0x400DF242 /end MEASUREMENT
/begin MEASUREMENT MCore_rb_SipF_ProcessImage.Cat1[9].debounced "" UWORD NO_COMPU_METHOD 0 0 0 65535 ECU_ADDRESS 0x400DF240 /end MEASUREMENT
/begin MEASUREMENT MCore_rb_SipF_ProcessImage.Cat1[9].discrete "" UWORD NO_COMPU_METHOD 0 0 0 65535 ECU_ADDRESS 0x400DF23C /end MEASUREMENT
/begin MEASUREMENT MCore_rb_SipF_ProcessImage.Cat1[9].discreteOld "" UWORD NO_COMPU_METHOD 0 0 0 65535 ECU_ADDRESS 0x400DF23E /end MEASUREMENT
/begin MEASUREMENT MCore_rb_SipF_ProcessImage.Cat1[9].processed "" UWORD NO_COMPU_METHOD 0 0 0 65535 ECU_ADDRESS 0x400DF244 /end MEASUREMENT
/begin MEASUREMENT MCore_rb_SipF_ProcessImage.Cat1[9].snapshot "" UWORD NO_COMPU_METHOD 0 0 0 65535 ECU_ADDRESS 0x400DF23A /end MEASUREMENT
/begin MEASUREMENT MCore_rb_SipF_ProcessImage.Cat1[9].switches "" UBYTE NO_COMPU_METHOD 0 0 0 255 ECU_ADDRESS 0x400DF246 /end MEASUREMENT
/begin MEASUREMENT MCore_rb_SipF_ProcessImage.Cat1[9].switches.mcalInputDisconnect "" SBYTE rb_SipF_ProcessImage.Cat1[9].switches.mcalInputDisconnect.CONVERSION 0 0 -128 127 ECU_ADDRESS 0x400DF246 /end MEASUREMENT
/begin MEASUREMENT MCore_rb_SipF_ProcessImage.Cat1[9].switches.sipfInputDisconnect "" SBYTE rb_SipF_ProcessImage.Cat1[9].switches.sipfInputDisconnect.CONVERSION 0 0 -128 127 ECU_ADDRESS 0x400DF247 /end MEASUREMENT
/begin MEASUREMENT MCore_rb_SipF_ProcessImage.Cat10 "" UBYTE NO_COMPU_METHOD 0 0 0 255 ECU_ADDRESS 0x400DF3DE /end MEASUREMENT
/begin MEASUREMENT MCore_rb_SipF_ProcessImage.Cat10[0].processed "" UWORD NO_COMPU_METHOD 0 0 0 65535 ECU_ADDRESS 0x400DF3E2 /end MEASUREMENT
/begin MEASUREMENT MCore_rb_SipF_ProcessImage.Cat10[0].ratio "" UWORD NO_COMPU_METHOD 0 0 0 65535 ECU_ADDRESS 0x400DF3E0 /end MEASUREMENT
/begin MEASUREMENT MCore_rb_SipF_ProcessImage.Cat10[0].snapshot "" UWORD NO_COMPU_METHOD 0 0 0 65535 ECU_ADDRESS 0x400DF3DE /end MEASUREMENT
/begin MEASUREMENT MCore_rb_SipF_ProcessImage.Cat10[0].switches "" UBYTE NO_COMPU_METHOD 0 0 0 255 ECU_ADDRESS 0x400DF3E4 /end MEASUREMENT
/begin MEASUREMENT MCore_rb_SipF_ProcessImage.Cat10[0].switches.mcalInputDisconnect "" SBYTE rb_SipF_ProcessImage.Cat10[0].switches.mcalInputDisconnect.CONVERSION 0 0 -128 127 ECU_ADDRESS 0x400DF3E4 /end MEASUREMENT
/begin MEASUREMENT MCore_rb_SipF_ProcessImage.Cat10[0].switches.sipfInputDisconnect "" SBYTE rb_SipF_ProcessImage.Cat10[0].switches.sipfInputDisconnect.CONVERSION 0 0 -128 127 ECU_ADDRESS 0x400DF3E5 /end MEASUREMENT
/begin MEASUREMENT MCore_rb_SipF_ProcessImage.Cat10[10].processed "" UWORD NO_COMPU_METHOD 0 0 0 65535 ECU_ADDRESS 0x400DF432 /end MEASUREMENT
/begin MEASUREMENT MCore_rb_SipF_ProcessImage.Cat10[10].ratio "" UWORD NO_COMPU_METHOD 0 0 0 65535 ECU_ADDRESS 0x400DF430 /end MEASUREMENT
/begin MEASUREMENT MCore_rb_SipF_ProcessImage.Cat10[10].snapshot "" UWORD NO_COMPU_METHOD 0 0 0 65535 ECU_ADDRESS 0x400DF42E /end MEASUREMENT
/begin MEASUREMENT MCore_rb_SipF_ProcessImage.Cat10[10].switches "" UBYTE NO_COMPU_METHOD 0 0 0 255 ECU_ADDRESS 0x400DF434 /end MEASUREMENT
/begin MEASUREMENT MCore_rb_SipF_ProcessImage.Cat10[10].switches.mcalInputDisconnect "" SBYTE rb_SipF_ProcessImage.Cat10[10].switches.mcalInputDisconnect.CONVERSION 0 0 -128 127 ECU_ADDRESS 0x400DF434 /end MEASUREMENT
/begin MEASUREMENT MCore_rb_SipF_ProcessImage.Cat10[10].switches.sipfInputDisconnect "" SBYTE rb_SipF_ProcessImage.Cat10[10].switches.sipfInputDisconnect.CONVERSION 0 0 -128 127 ECU_ADDRESS 0x400DF435 /end MEASUREMENT
/begin MEASUREMENT MCore_rb_SipF_ProcessImage.Cat10[11].processed "" UWORD NO_COMPU_METHOD 0 0 0 65535 ECU_ADDRESS 0x400DF43A /end MEASUREMENT
/begin MEASUREMENT MCore_rb_SipF_ProcessImage.Cat10[11].ratio "" UWORD NO_COMPU_METHOD 0 0 0 65535 ECU_ADDRESS 0x400DF438 /end MEASUREMENT
/begin MEASUREMENT MCore_rb_SipF_ProcessImage.Cat10[11].snapshot "" UWORD NO_COMPU_METHOD 0 0 0 65535 ECU_ADDRESS 0x400DF436 /end MEASUREMENT
/begin MEASUREMENT MCore_rb_SipF_ProcessImage.Cat10[11].switches "" UBYTE NO_COMPU_METHOD 0 0 0 255 ECU_ADDRESS 0x400DF43C /end MEASUREMENT
/begin MEASUREMENT MCore_rb_SipF_ProcessImage.Cat10[11].switches.mcalInputDisconnect "" SBYTE rb_SipF_ProcessImage.Cat10[11].switches.mcalInputDisconnect.CONVERSION 0 0 -128 127 ECU_ADDRESS 0x400DF43C /end MEASUREMENT
/begin MEASUREMENT MCore_rb_SipF_ProcessImage.Cat10[11].switches.sipfInputDisconnect "" SBYTE rb_SipF_ProcessImage.Cat10[11].switches.sipfInputDisconnect.CONVERSION 0 0 -128 127 ECU_ADDRESS 0x400DF43D /end MEASUREMENT
/begin MEASUREMENT MCore_rb_SipF_ProcessImage.Cat10[12].processed "" UWORD NO_COMPU_METHOD 0 0 0 65535 ECU_ADDRESS 0x400DF442 /end MEASUREMENT
/begin MEASUREMENT MCore_rb_SipF_ProcessImage.Cat10[12].ratio "" UWORD NO_COMPU_METHOD 0 0 0 65535 ECU_ADDRESS 0x400DF440 /end MEASUREMENT
/begin MEASUREMENT MCore_rb_SipF_ProcessImage.Cat10[12].snapshot "" UWORD NO_COMPU_METHOD 0 0 0 65535 ECU_ADDRESS 0x400DF43E /end MEASUREMENT
/begin MEASUREMENT MCore_rb_SipF_ProcessImage.Cat10[12].switches "" UBYTE NO_COMPU_METHOD 0 0 0 255 ECU_ADDRESS 0x400DF444 /end MEASUREMENT
/begin MEASUREMENT MCore_rb_SipF_ProcessImage.Cat10[12].switches.mcalInputDisconnect "" SBYTE rb_SipF_ProcessImage.Cat10[12].switches.mcalInputDisconnect.CONVERSION 0 0 -128 127 ECU_ADDRESS 0x400DF444 /end MEASUREMENT
/begin MEASUREMENT MCore_rb_SipF_ProcessImage.Cat10[12].switches.sipfInputDisconnect "" SBYTE rb_SipF_ProcessImage.Cat10[12].switches.sipfInputDisconnect.CONVERSION 0 0 -128 127 ECU_ADDRESS 0x400DF445 /end MEASUREMENT
/begin MEASUREMENT MCore_rb_SipF_ProcessImage.Cat10[13].processed "" UWORD NO_COMPU_METHOD 0 0 0 65535 ECU_ADDRESS 0x400DF44A /end MEASUREMENT
/begin MEASUREMENT MCore_rb_SipF_ProcessImage.Cat10[13].ratio "" UWORD NO_COMPU_METHOD 0 0 0 65535 ECU_ADDRESS 0x400DF448 /end MEASUREMENT
/begin MEASUREMENT MCore_rb_SipF_ProcessImage.Cat10[13].snapshot "" UWORD NO_COMPU_METHOD 0 0 0 65535 ECU_ADDRESS 0x400DF446 /end MEASUREMENT
/begin MEASUREMENT MCore_rb_SipF_ProcessImage.Cat10[13].switches "" UBYTE NO_COMPU_METHOD 0 0 0 255 ECU_ADDRESS 0x400DF44C /end MEASUREMENT
/begin MEASUREMENT MCore_rb_SipF_ProcessImage.Cat10[13].switches.mcalInputDisconnect "" SBYTE rb_SipF_ProcessImage.Cat10[13].switches.mcalInputDisconnect.CONVERSION 0 0 -128 127 ECU_ADDRESS 0x400DF44C /end MEASUREMENT
/begin MEASUREMENT MCore_rb_SipF_ProcessImage.Cat10[13].switches.sipfInputDisconnect "" SBYTE rb_SipF_ProcessImage.Cat10[13].switches.sipfInputDisconnect.CONVERSION 0 0 -128 127 ECU_ADDRESS 0x400DF44D /end MEASUREMENT
/begin MEASUREMENT MCore_rb_SipF_ProcessImage.Cat10[14].processed "" UWORD NO_COMPU_METHOD 0 0 0 65535 ECU_ADDRESS 0x400DF452 /end MEASUREMENT
/begin MEASUREMENT MCore_rb_SipF_ProcessImage.Cat10[14].ratio "" UWORD NO_COMPU_METHOD 0 0 0 65535 ECU_ADDRESS 0x400DF450 /end MEASUREMENT
/begin MEASUREMENT MCore_rb_SipF_ProcessImage.Cat10[14].snapshot "" UWORD NO_COMPU_METHOD 0 0 0 65535 ECU_ADDRESS 0x400DF44E /end MEASUREMENT
/begin MEASUREMENT MCore_rb_SipF_ProcessImage.Cat10[14].switches "" UBYTE NO_COMPU_METHOD 0 0 0 255 ECU_ADDRESS 0x400DF454 /end MEASUREMENT
/begin MEASUREMENT MCore_rb_SipF_ProcessImage.Cat10[14].switches.mcalInputDisconnect "" SBYTE rb_SipF_ProcessImage.Cat10[14].switches.mcalInputDisconnect.CONVERSION 0 0 -128 127 ECU_ADDRESS 0x400DF454 /end MEASUREMENT
/begin MEASUREMENT MCore_rb_SipF_ProcessImage.Cat10[14].switches.sipfInputDisconnect "" SBYTE rb_SipF_ProcessImage.Cat10[14].switches.sipfInputDisconnect.CONVERSION 0 0 -128 127 ECU_ADDRESS 0x400DF455 /end MEASUREMENT
/begin MEASUREMENT MCore_rb_SipF_ProcessImage.Cat10[1].processed "" UWORD NO_COMPU_METHOD 0 0 0 65535 ECU_ADDRESS 0x400DF3EA /end MEASUREMENT
/begin MEASUREMENT MCore_rb_SipF_ProcessImage.Cat10[1].ratio "" UWORD NO_COMPU_METHOD 0 0 0 65535 ECU_ADDRESS 0x400DF3E8 /end MEASUREMENT
/begin MEASUREMENT MCore_rb_SipF_ProcessImage.Cat10[1].snapshot "" UWORD NO_COMPU_METHOD 0 0 0 65535 ECU_ADDRESS 0x400DF3E6 /end MEASUREMENT
/begin MEASUREMENT MCore_rb_SipF_ProcessImage.Cat10[1].switches "" UBYTE NO_COMPU_METHOD 0 0 0 255 ECU_ADDRESS 0x400DF3EC /end MEASUREMENT
/begin MEASUREMENT MCore_rb_SipF_ProcessImage.Cat10[1].switches.mcalInputDisconnect "" SBYTE rb_SipF_ProcessImage.Cat10[1].switches.mcalInputDisconnect.CONVERSION 0 0 -128 127 ECU_ADDRESS 0x400DF3EC /end MEASUREMENT
/begin MEASUREMENT MCore_rb_SipF_ProcessImage.Cat10[1].switches.sipfInputDisconnect "" SBYTE rb_SipF_ProcessImage.Cat10[1].switches.sipfInputDisconnect.CONVERSION 0 0 -128 127 ECU_ADDRESS 0x400DF3ED /end MEASUREMENT
/begin MEASUREMENT MCore_rb_SipF_ProcessImage.Cat10[2].processed "" UWORD NO_COMPU_METHOD 0 0 0 65535 ECU_ADDRESS 0x400DF3F2 /end MEASUREMENT
/begin MEASUREMENT MCore_rb_SipF_ProcessImage.Cat10[2].ratio "" UWORD NO_COMPU_METHOD 0 0 0 65535 ECU_ADDRESS 0x400DF3F0 /end MEASUREMENT
/begin MEASUREMENT MCore_rb_SipF_ProcessImage.Cat10[2].snapshot "" UWORD NO_COMPU_METHOD 0 0 0 65535 ECU_ADDRESS 0x400DF3EE /end MEASUREMENT
/begin MEASUREMENT MCore_rb_SipF_ProcessImage.Cat10[2].switches "" UBYTE NO_COMPU_METHOD 0 0 0 255 ECU_ADDRESS 0x400DF3F4 /end MEASUREMENT
/begin MEASUREMENT MCore_rb_SipF_ProcessImage.Cat10[2].switches.mcalInputDisconnect "" SBYTE rb_SipF_ProcessImage.Cat10[2].switches.mcalInputDisconnect.CONVERSION 0 0 -128 127 ECU_ADDRESS 0x400DF3F4 /end MEASUREMENT
/begin MEASUREMENT MCore_rb_SipF_ProcessImage.Cat10[2].switches.sipfInputDisconnect "" SBYTE rb_SipF_ProcessImage.Cat10[2].switches.sipfInputDisconnect.CONVERSION 0 0 -128 127 ECU_ADDRESS 0x400DF3F5 /end MEASUREMENT
/begin MEASUREMENT MCore_rb_SipF_ProcessImage.Cat10[3].processed "" UWORD NO_COMPU_METHOD 0 0 0 65535 ECU_ADDRESS 0x400DF3FA /end MEASUREMENT
/begin MEASUREMENT MCore_rb_SipF_ProcessImage.Cat10[3].ratio "" UWORD NO_COMPU_METHOD 0 0 0 65535 ECU_ADDRESS 0x400DF3F8 /end MEASUREMENT
/begin MEASUREMENT MCore_rb_SipF_ProcessImage.Cat10[3].snapshot "" UWORD NO_COMPU_METHOD 0 0 0 65535 ECU_ADDRESS 0x400DF3F6 /end MEASUREMENT
/begin MEASUREMENT MCore_rb_SipF_ProcessImage.Cat10[3].switches "" UBYTE NO_COMPU_METHOD 0 0 0 255 ECU_ADDRESS 0x400DF3FC /end MEASUREMENT
/begin MEASUREMENT MCore_rb_SipF_ProcessImage.Cat10[3].switches.mcalInputDisconnect "" SBYTE rb_SipF_ProcessImage.Cat10[3].switches.mcalInputDisconnect.CONVERSION 0 0 -128 127 ECU_ADDRESS 0x400DF3FC /end MEASUREMENT
/begin MEASUREMENT MCore_rb_SipF_ProcessImage.Cat10[3].switches.sipfInputDisconnect "" SBYTE rb_SipF_ProcessImage.Cat10[3].switches.sipfInputDisconnect.CONVERSION 0 0 -128 127 ECU_ADDRESS 0x400DF3FD /end MEASUREMENT
/begin MEASUREMENT MCore_rb_SipF_ProcessImage.Cat10[4].processed "" UWORD NO_COMPU_METHOD 0 0 0 65535 ECU_ADDRESS 0x400DF402 /end MEASUREMENT
/begin MEASUREMENT MCore_rb_SipF_ProcessImage.Cat10[4].ratio "" UWORD NO_COMPU_METHOD 0 0 0 65535 ECU_ADDRESS 0x400DF400 /end MEASUREMENT
/begin MEASUREMENT MCore_rb_SipF_ProcessImage.Cat10[4].snapshot "" UWORD NO_COMPU_METHOD 0 0 0 65535 ECU_ADDRESS 0x400DF3FE /end MEASUREMENT
/begin MEASUREMENT MCore_rb_SipF_ProcessImage.Cat10[4].switches "" UBYTE NO_COMPU_METHOD 0 0 0 255 ECU_ADDRESS 0x400DF404 /end MEASUREMENT
/begin MEASUREMENT MCore_rb_SipF_ProcessImage.Cat10[4].switches.mcalInputDisconnect "" SBYTE rb_SipF_ProcessImage.Cat10[4].switches.mcalInputDisconnect.CONVERSION 0 0 -128 127 ECU_ADDRESS 0x400DF404 /end MEASUREMENT
/begin MEASUREMENT MCore_rb_SipF_ProcessImage.Cat10[4].switches.sipfInputDisconnect "" SBYTE rb_SipF_ProcessImage.Cat10[4].switches.sipfInputDisconnect.CONVERSION 0 0 -128 127 ECU_ADDRESS 0x400DF405 /end MEASUREMENT
/begin MEASUREMENT MCore_rb_SipF_ProcessImage.Cat10[5].processed "" UWORD NO_COMPU_METHOD 0 0 0 65535 ECU_ADDRESS 0x400DF40A /end MEASUREMENT
/begin MEASUREMENT MCore_rb_SipF_ProcessImage.Cat10[5].ratio "" UWORD NO_COMPU_METHOD 0 0 0 65535 ECU_ADDRESS 0x400DF408 /end MEASUREMENT
/begin MEASUREMENT MCore_rb_SipF_ProcessImage.Cat10[5].snapshot "" UWORD NO_COMPU_METHOD 0 0 0 65535 ECU_ADDRESS 0x400DF406 /end MEASUREMENT
/begin MEASUREMENT MCore_rb_SipF_ProcessImage.Cat10[5].switches "" UBYTE NO_COMPU_METHOD 0 0 0 255 ECU_ADDRESS 0x400DF40C /end MEASUREMENT
/begin MEASUREMENT MCore_rb_SipF_ProcessImage.Cat10[5].switches.mcalInputDisconnect "" SBYTE rb_SipF_ProcessImage.Cat10[5].switches.mcalInputDisconnect.CONVERSION 0 0 -128 127 ECU_ADDRESS 0x400DF40C /end MEASUREMENT
/begin MEASUREMENT MCore_rb_SipF_ProcessImage.Cat10[5].switches.sipfInputDisconnect "" SBYTE rb_SipF_ProcessImage.Cat10[5].switches.sipfInputDisconnect.CONVERSION 0 0 -128 127 ECU_ADDRESS 0x400DF40D /end MEASUREMENT
/begin MEASUREMENT MCore_rb_SipF_ProcessImage.Cat10[6].processed "" UWORD NO_COMPU_METHOD 0 0 0 65535 ECU_ADDRESS 0x400DF412 /end MEASUREMENT
/begin MEASUREMENT MCore_rb_SipF_ProcessImage.Cat10[6].ratio "" UWORD NO_COMPU_METHOD 0 0 0 65535 ECU_ADDRESS 0x400DF410 /end MEASUREMENT
/begin MEASUREMENT MCore_rb_SipF_ProcessImage.Cat10[6].snapshot "" UWORD NO_COMPU_METHOD 0 0 0 65535 ECU_ADDRESS 0x400DF40E /end MEASUREMENT
/begin MEASUREMENT MCore_rb_SipF_ProcessImage.Cat10[6].switches "" UBYTE NO_COMPU_METHOD 0 0 0 255 ECU_ADDRESS 0x400DF414 /end MEASUREMENT
/begin MEASUREMENT MCore_rb_SipF_ProcessImage.Cat10[6].switches.mcalInputDisconnect "" SBYTE rb_SipF_ProcessImage.Cat10[6].switches.mcalInputDisconnect.CONVERSION 0 0 -128 127 ECU_ADDRESS 0x400DF414 /end MEASUREMENT
/begin MEASUREMENT MCore_rb_SipF_ProcessImage.Cat10[6].switches.sipfInputDisconnect "" SBYTE rb_SipF_ProcessImage.Cat10[6].switches.sipfInputDisconnect.CONVERSION 0 0 -128 127 ECU_ADDRESS 0x400DF415 /end MEASUREMENT
/begin MEASUREMENT MCore_rb_SipF_ProcessImage.Cat10[7].processed "" UWORD NO_COMPU_METHOD 0 0 0 65535 ECU_ADDRESS 0x400DF41A /end MEASUREMENT
/begin MEASUREMENT MCore_rb_SipF_ProcessImage.Cat10[7].ratio "" UWORD NO_COMPU_METHOD 0 0 0 65535 ECU_ADDRESS 0x400DF418 /end MEASUREMENT
/begin MEASUREMENT MCore_rb_SipF_ProcessImage.Cat10[7].snapshot "" UWORD NO_COMPU_METHOD 0 0 0 65535 ECU_ADDRESS 0x400DF416 /end MEASUREMENT
/begin MEASUREMENT MCore_rb_SipF_ProcessImage.Cat10[7].switches "" UBYTE NO_COMPU_METHOD 0 0 0 255 ECU_ADDRESS 0x400DF41C /end MEASUREMENT
/begin MEASUREMENT MCore_rb_SipF_ProcessImage.Cat10[7].switches.mcalInputDisconnect "" SBYTE rb_SipF_ProcessImage.Cat10[7].switches.mcalInputDisconnect.CONVERSION 0 0 -128 127 ECU_ADDRESS 0x400DF41C /end MEASUREMENT
/begin MEASUREMENT MCore_rb_SipF_ProcessImage.Cat10[7].switches.sipfInputDisconnect "" SBYTE rb_SipF_ProcessImage.Cat10[7].switches.sipfInputDisconnect.CONVERSION 0 0 -128 127 ECU_ADDRESS 0x400DF41D /end MEASUREMENT
/begin MEASUREMENT MCore_rb_SipF_ProcessImage.Cat10[8].processed "" UWORD NO_COMPU_METHOD 0 0 0 65535 ECU_ADDRESS 0x400DF422 /end MEASUREMENT
/begin MEASUREMENT MCore_rb_SipF_ProcessImage.Cat10[8].ratio "" UWORD NO_COMPU_METHOD 0 0 0 65535 ECU_ADDRESS 0x400DF420 /end MEASUREMENT
/begin MEASUREMENT MCore_rb_SipF_ProcessImage.Cat10[8].snapshot "" UWORD NO_COMPU_METHOD 0 0 0 65535 ECU_ADDRESS 0x400DF41E /end MEASUREMENT
/begin MEASUREMENT MCore_rb_SipF_ProcessImage.Cat10[8].switches "" UBYTE NO_COMPU_METHOD 0 0 0 255 ECU_ADDRESS 0x400DF424 /end MEASUREMENT
/begin MEASUREMENT MCore_rb_SipF_ProcessImage.Cat10[8].switches.mcalInputDisconnect "" SBYTE rb_SipF_ProcessImage.Cat10[8].switches.mcalInputDisconnect.CONVERSION 0 0 -128 127 ECU_ADDRESS 0x400DF424 /end MEASUREMENT
/begin MEASUREMENT MCore_rb_SipF_ProcessImage.Cat10[8].switches.sipfInputDisconnect "" SBYTE rb_SipF_ProcessImage.Cat10[8].switches.sipfInputDisconnect.CONVERSION 0 0 -128 127 ECU_ADDRESS 0x400DF425 /end MEASUREMENT
/begin MEASUREMENT MCore_rb_SipF_ProcessImage.Cat10[9].processed "" UWORD NO_COMPU_METHOD 0 0 0 65535 ECU_ADDRESS 0x400DF42A /end MEASUREMENT
/begin MEASUREMENT MCore_rb_SipF_ProcessImage.Cat10[9].ratio "" UWORD NO_COMPU_METHOD 0 0 0 65535 ECU_ADDRESS 0x400DF428 /end MEASUREMENT
/begin MEASUREMENT MCore_rb_SipF_ProcessImage.Cat10[9].snapshot "" UWORD NO_COMPU_METHOD 0 0 0 65535 ECU_ADDRESS 0x400DF426 /end MEASUREMENT
/begin MEASUREMENT MCore_rb_SipF_ProcessImage.Cat10[9].switches "" UBYTE NO_COMPU_METHOD 0 0 0 255 ECU_ADDRESS 0x400DF42C /end MEASUREMENT
/begin MEASUREMENT MCore_rb_SipF_ProcessImage.Cat10[9].switches.mcalInputDisconnect "" SBYTE rb_SipF_ProcessImage.Cat10[9].switches.mcalInputDisconnect.CONVERSION 0 0 -128 127 ECU_ADDRESS 0x400DF42C /end MEASUREMENT
/begin MEASUREMENT MCore_rb_SipF_ProcessImage.Cat10[9].switches.sipfInputDisconnect "" SBYTE rb_SipF_ProcessImage.Cat10[9].switches.sipfInputDisconnect.CONVERSION 0 0 -128 127 ECU_ADDRESS 0x400DF42D /end MEASUREMENT
/begin MEASUREMENT MCore_rb_SipF_ProcessImage.Cat20a "" UBYTE NO_COMPU_METHOD 0 0 0 255 ECU_ADDRESS 0x400DF456 /end MEASUREMENT
/begin MEASUREMENT MCore_rb_SipF_ProcessImage.Cat20a[0].averaged "" UWORD NO_COMPU_METHOD 0 0 0 65535 ECU_ADDRESS 0x400DF458 /end MEASUREMENT
/begin MEASUREMENT MCore_rb_SipF_ProcessImage.Cat20a[0].processed "" UWORD NO_COMPU_METHOD 0 0 0 65535 ECU_ADDRESS 0x400DF456 /end MEASUREMENT
/begin MEASUREMENT MCore_rb_SipF_ProcessImage.Cat20a[0].switches "" UBYTE NO_COMPU_METHOD 0 0 0 255 ECU_ADDRESS 0x400DF45A /end MEASUREMENT
/begin MEASUREMENT MCore_rb_SipF_ProcessImage.Cat20a[0].switches.mcalInputDisconnect "" SBYTE rb_SipF_ProcessImage.Cat20a[0].switches.mcalInputDisconnect.CONVERSION 0 0 -128 127 ECU_ADDRESS 0x400DF45A /end MEASUREMENT
/begin MEASUREMENT MCore_rb_SipF_ProcessImage.Cat20a[0].switches.sipfInputDisconnect "" SBYTE rb_SipF_ProcessImage.Cat20a[0].switches.sipfInputDisconnect.CONVERSION 0 0 -128 127 ECU_ADDRESS 0x400DF45B /end MEASUREMENT
/begin MEASUREMENT MCore_rb_SipF_ProcessImage.Cat20a[1].averaged "" UWORD NO_COMPU_METHOD 0 0 0 65535 ECU_ADDRESS 0x400DF45E /end MEASUREMENT
/begin MEASUREMENT MCore_rb_SipF_ProcessImage.Cat20a[1].processed "" UWORD NO_COMPU_METHOD 0 0 0 65535 ECU_ADDRESS 0x400DF45C /end MEASUREMENT
/begin MEASUREMENT MCore_rb_SipF_ProcessImage.Cat20a[1].switches "" UBYTE NO_COMPU_METHOD 0 0 0 255 ECU_ADDRESS 0x400DF460 /end MEASUREMENT
/begin MEASUREMENT MCore_rb_SipF_ProcessImage.Cat20a[1].switches.mcalInputDisconnect "" SBYTE rb_SipF_ProcessImage.Cat20a[1].switches.mcalInputDisconnect.CONVERSION 0 0 -128 127 ECU_ADDRESS 0x400DF460 /end MEASUREMENT
/begin MEASUREMENT MCore_rb_SipF_ProcessImage.Cat20a[1].switches.sipfInputDisconnect "" SBYTE rb_SipF_ProcessImage.Cat20a[1].switches.sipfInputDisconnect.CONVERSION 0 0 -128 127 ECU_ADDRESS 0x400DF461 /end MEASUREMENT
/begin MEASUREMENT MCore_rb_SipF_ProcessImage.Cat20a[2].averaged "" UWORD NO_COMPU_METHOD 0 0 0 65535 ECU_ADDRESS 0x400DF464 /end MEASUREMENT
/begin MEASUREMENT MCore_rb_SipF_ProcessImage.Cat20a[2].processed "" UWORD NO_COMPU_METHOD 0 0 0 65535 ECU_ADDRESS 0x400DF462 /end MEASUREMENT
/begin MEASUREMENT MCore_rb_SipF_ProcessImage.Cat20a[2].switches "" UBYTE NO_COMPU_METHOD 0 0 0 255 ECU_ADDRESS 0x400DF466 /end MEASUREMENT
/begin MEASUREMENT MCore_rb_SipF_ProcessImage.Cat20a[2].switches.mcalInputDisconnect "" SBYTE rb_SipF_ProcessImage.Cat20a[2].switches.mcalInputDisconnect.CONVERSION 0 0 -128 127 ECU_ADDRESS 0x400DF466 /end MEASUREMENT
/begin MEASUREMENT MCore_rb_SipF_ProcessImage.Cat20a[2].switches.sipfInputDisconnect "" SBYTE rb_SipF_ProcessImage.Cat20a[2].switches.sipfInputDisconnect.CONVERSION 0 0 -128 127 ECU_ADDRESS 0x400DF467 /end MEASUREMENT
/begin MEASUREMENT MCore_rb_SipF_ProcessImage.Cat20a[3].averaged "" UWORD NO_COMPU_METHOD 0 0 0 65535 ECU_ADDRESS 0x400DF46A /end MEASUREMENT
/begin MEASUREMENT MCore_rb_SipF_ProcessImage.Cat20a[3].processed "" UWORD NO_COMPU_METHOD 0 0 0 65535 ECU_ADDRESS 0x400DF468 /end MEASUREMENT
/begin MEASUREMENT MCore_rb_SipF_ProcessImage.Cat20a[3].switches "" UBYTE NO_COMPU_METHOD 0 0 0 255 ECU_ADDRESS 0x400DF46C /end MEASUREMENT
/begin MEASUREMENT MCore_rb_SipF_ProcessImage.Cat20a[3].switches.mcalInputDisconnect "" SBYTE rb_SipF_ProcessImage.Cat20a[3].switches.mcalInputDisconnect.CONVERSION 0 0 -128 127 ECU_ADDRESS 0x400DF46C /end MEASUREMENT
/begin MEASUREMENT MCore_rb_SipF_ProcessImage.Cat20a[3].switches.sipfInputDisconnect "" SBYTE rb_SipF_ProcessImage.Cat20a[3].switches.sipfInputDisconnect.CONVERSION 0 0 -128 127 ECU_ADDRESS 0x400DF46D /end MEASUREMENT
/begin MEASUREMENT MCore_rb_SipF_ProcessImage.Cat20b "" UBYTE NO_COMPU_METHOD 0 0 0 255 ECU_ADDRESS 0x400DF46E /end MEASUREMENT
/begin MEASUREMENT MCore_rb_SipF_ProcessImage.Cat20b[0].averaged "" UWORD NO_COMPU_METHOD 0 0 0 65535 ECU_ADDRESS 0x400DF470 /end MEASUREMENT
/begin MEASUREMENT MCore_rb_SipF_ProcessImage.Cat20b[0].processed "" UWORD NO_COMPU_METHOD 0 0 0 65535 ECU_ADDRESS 0x400DF46E /end MEASUREMENT
/begin MEASUREMENT MCore_rb_SipF_ProcessImage.Cat20b[0].switches "" UBYTE NO_COMPU_METHOD 0 0 0 255 ECU_ADDRESS 0x400DF472 /end MEASUREMENT
/begin MEASUREMENT MCore_rb_SipF_ProcessImage.Cat20b[0].switches.mcalInputDisconnect "" SBYTE rb_SipF_ProcessImage.Cat20b[0].switches.mcalInputDisconnect.CONVERSION 0 0 -128 127 ECU_ADDRESS 0x400DF472 /end MEASUREMENT
/begin MEASUREMENT MCore_rb_SipF_ProcessImage.Cat20b[0].switches.sipfInputDisconnect "" SBYTE rb_SipF_ProcessImage.Cat20b[0].switches.sipfInputDisconnect.CONVERSION 0 0 -128 127 ECU_ADDRESS 0x400DF473 /end MEASUREMENT
/begin MEASUREMENT MCore_rb_SipF_ProcessImage.Cat20b[1].averaged "" UWORD NO_COMPU_METHOD 0 0 0 65535 ECU_ADDRESS 0x400DF476 /end MEASUREMENT
/begin MEASUREMENT MCore_rb_SipF_ProcessImage.Cat20b[1].processed "" UWORD NO_COMPU_METHOD 0 0 0 65535 ECU_ADDRESS 0x400DF474 /end MEASUREMENT
/begin MEASUREMENT MCore_rb_SipF_ProcessImage.Cat20b[1].switches "" UBYTE NO_COMPU_METHOD 0 0 0 255 ECU_ADDRESS 0x400DF478 /end MEASUREMENT
/begin MEASUREMENT MCore_rb_SipF_ProcessImage.Cat20b[1].switches.mcalInputDisconnect "" SBYTE rb_SipF_ProcessImage.Cat20b[1].switches.mcalInputDisconnect.CONVERSION 0 0 -128 127 ECU_ADDRESS 0x400DF478 /end MEASUREMENT
/begin MEASUREMENT MCore_rb_SipF_ProcessImage.Cat20b[1].switches.sipfInputDisconnect "" SBYTE rb_SipF_ProcessImage.Cat20b[1].switches.sipfInputDisconnect.CONVERSION 0 0 -128 127 ECU_ADDRESS 0x400DF479 /end MEASUREMENT
/begin MEASUREMENT MCore_rb_SipF_ProcessImage.Cat20b[2].averaged "" UWORD NO_COMPU_METHOD 0 0 0 65535 ECU_ADDRESS 0x400DF47C /end MEASUREMENT
/begin MEASUREMENT MCore_rb_SipF_ProcessImage.Cat20b[2].processed "" UWORD NO_COMPU_METHOD 0 0 0 65535 ECU_ADDRESS 0x400DF47A /end MEASUREMENT
/begin MEASUREMENT MCore_rb_SipF_ProcessImage.Cat20b[2].switches "" UBYTE NO_COMPU_METHOD 0 0 0 255 ECU_ADDRESS 0x400DF47E /end MEASUREMENT
/begin MEASUREMENT MCore_rb_SipF_ProcessImage.Cat20b[2].switches.mcalInputDisconnect "" SBYTE rb_SipF_ProcessImage.Cat20b[2].switches.mcalInputDisconnect.CONVERSION 0 0 -128 127 ECU_ADDRESS 0x400DF47E /end MEASUREMENT
/begin MEASUREMENT MCore_rb_SipF_ProcessImage.Cat20b[2].switches.sipfInputDisconnect "" SBYTE rb_SipF_ProcessImage.Cat20b[2].switches.sipfInputDisconnect.CONVERSION 0 0 -128 127 ECU_ADDRESS 0x400DF47F /end MEASUREMENT
/begin MEASUREMENT MCore_rb_SipF_ProcessImage.Cat20b[3].averaged "" UWORD NO_COMPU_METHOD 0 0 0 65535 ECU_ADDRESS 0x400DF482 /end MEASUREMENT
/begin MEASUREMENT MCore_rb_SipF_ProcessImage.Cat20b[3].processed "" UWORD NO_COMPU_METHOD 0 0 0 65535 ECU_ADDRESS 0x400DF480 /end MEASUREMENT
/begin MEASUREMENT MCore_rb_SipF_ProcessImage.Cat20b[3].switches "" UBYTE NO_COMPU_METHOD 0 0 0 255 ECU_ADDRESS 0x400DF484 /end MEASUREMENT
/begin MEASUREMENT MCore_rb_SipF_ProcessImage.Cat20b[3].switches.mcalInputDisconnect "" SBYTE rb_SipF_ProcessImage.Cat20b[3].switches.mcalInputDisconnect.CONVERSION 0 0 -128 127 ECU_ADDRESS 0x400DF484 /end MEASUREMENT
/begin MEASUREMENT MCore_rb_SipF_ProcessImage.Cat20b[3].switches.sipfInputDisconnect "" SBYTE rb_SipF_ProcessImage.Cat20b[3].switches.sipfInputDisconnect.CONVERSION 0 0 -128 127 ECU_ADDRESS 0x400DF485 /end MEASUREMENT
/begin MEASUREMENT MCore_rb_SipF_ProcessImage.Cat21 "" UBYTE NO_COMPU_METHOD 0 0 0 255 ECU_ADDRESS 0x400DF486 /end MEASUREMENT
/begin MEASUREMENT MCore_rb_SipF_ProcessImage.Cat21[0].debCounter "" UWORD NO_COMPU_METHOD 0 0 0 65535 ECU_ADDRESS 0x400DF48C /end MEASUREMENT
/begin MEASUREMENT MCore_rb_SipF_ProcessImage.Cat21[0].debounced "" UWORD NO_COMPU_METHOD 0 0 0 65535 ECU_ADDRESS 0x400DF48A /end MEASUREMENT
/begin MEASUREMENT MCore_rb_SipF_ProcessImage.Cat21[0].discrete "" UWORD NO_COMPU_METHOD 0 0 0 65535 ECU_ADDRESS 0x400DF486 /end MEASUREMENT
/begin MEASUREMENT MCore_rb_SipF_ProcessImage.Cat21[0].discreteOld "" UWORD NO_COMPU_METHOD 0 0 0 65535 ECU_ADDRESS 0x400DF488 /end MEASUREMENT
/begin MEASUREMENT MCore_rb_SipF_ProcessImage.Cat21[0].lastProcessedIndex "" UWORD NO_COMPU_METHOD 0 0 0 65535 ECU_ADDRESS 0x400DF48E /end MEASUREMENT
/begin MEASUREMENT MCore_rb_SipF_ProcessImage.Cat21[0].processed "" UWORD NO_COMPU_METHOD 0 0 0 65535 ECU_ADDRESS 0x400DF490 /end MEASUREMENT
/begin MEASUREMENT MCore_rb_SipF_ProcessImage.Cat21[0].switches "" UBYTE NO_COMPU_METHOD 0 0 0 255 ECU_ADDRESS 0x400DF492 /end MEASUREMENT
/begin MEASUREMENT MCore_rb_SipF_ProcessImage.Cat21[0].switches.mcalInputDisconnect "" SBYTE rb_SipF_ProcessImage.Cat21[0].switches.mcalInputDisconnect.CONVERSION 0 0 -128 127 ECU_ADDRESS 0x400DF492 /end MEASUREMENT
/begin MEASUREMENT MCore_rb_SipF_ProcessImage.Cat21[0].switches.sipfInputDisconnect "" SBYTE rb_SipF_ProcessImage.Cat21[0].switches.sipfInputDisconnect.CONVERSION 0 0 -128 127 ECU_ADDRESS 0x400DF493 /end MEASUREMENT
/begin MEASUREMENT MCore_rb_SipF_ProcessImage.Cat21[1].debCounter "" UWORD NO_COMPU_METHOD 0 0 0 65535 ECU_ADDRESS 0x400DF49A /end MEASUREMENT
/begin MEASUREMENT MCore_rb_SipF_ProcessImage.Cat21[1].debounced "" UWORD NO_COMPU_METHOD 0 0 0 65535 ECU_ADDRESS 0x400DF498 /end MEASUREMENT
/begin MEASUREMENT MCore_rb_SipF_ProcessImage.Cat21[1].discrete "" UWORD NO_COMPU_METHOD 0 0 0 65535 ECU_ADDRESS 0x400DF494 /end MEASUREMENT
/begin MEASUREMENT MCore_rb_SipF_ProcessImage.Cat21[1].discreteOld "" UWORD NO_COMPU_METHOD 0 0 0 65535 ECU_ADDRESS 0x400DF496 /end MEASUREMENT
/begin MEASUREMENT MCore_rb_SipF_ProcessImage.Cat21[1].lastProcessedIndex "" UWORD NO_COMPU_METHOD 0 0 0 65535 ECU_ADDRESS 0x400DF49C /end MEASUREMENT
/begin MEASUREMENT MCore_rb_SipF_ProcessImage.Cat21[1].processed "" UWORD NO_COMPU_METHOD 0 0 0 65535 ECU_ADDRESS 0x400DF49E /end MEASUREMENT
/begin MEASUREMENT MCore_rb_SipF_ProcessImage.Cat21[1].switches "" UBYTE NO_COMPU_METHOD 0 0 0 255 ECU_ADDRESS 0x400DF4A0 /end MEASUREMENT
/begin MEASUREMENT MCore_rb_SipF_ProcessImage.Cat21[1].switches.mcalInputDisconnect "" SBYTE rb_SipF_ProcessImage.Cat21[1].switches.mcalInputDisconnect.CONVERSION 0 0 -128 127 ECU_ADDRESS 0x400DF4A0 /end MEASUREMENT
/begin MEASUREMENT MCore_rb_SipF_ProcessImage.Cat21[1].switches.sipfInputDisconnect "" SBYTE rb_SipF_ProcessImage.Cat21[1].switches.sipfInputDisconnect.CONVERSION 0 0 -128 127 ECU_ADDRESS 0x400DF4A1 /end MEASUREMENT
/begin MEASUREMENT MCore_rb_SipF_ProcessImage.Cat25 "" UBYTE NO_COMPU_METHOD 0 0 0 255 ECU_ADDRESS 0x400DF4A2 /end MEASUREMENT
/begin MEASUREMENT MCore_rb_SipF_ProcessImage.Cat25[0].processedRawChnl1 "" UBYTE NO_COMPU_METHOD 0 0 0 255 ECU_ADDRESS 0x400DF4A2 /end MEASUREMENT
/begin MEASUREMENT MCore_rb_SipF_ProcessImage.Cat25[0].processedRawChnl2 "" UBYTE NO_COMPU_METHOD 0 0 0 255 ECU_ADDRESS 0x400DF4B6 /end MEASUREMENT
/begin MEASUREMENT MCore_rb_SipF_ProcessImage.Cat25[0].processedValidFlag "" UBYTE NO_COMPU_METHOD 0 0 0 255 ECU_ADDRESS 0x400DF4CA /end MEASUREMENT
/begin MEASUREMENT MCore_rb_SipF_ProcessImage.Cat25[0].switches "" UBYTE NO_COMPU_METHOD 0 0 0 255 ECU_ADDRESS 0x400DF4DE /end MEASUREMENT
/begin MEASUREMENT MCore_rb_SipF_ProcessImage.Cat25[0].switches.mcalInputDisconnect "" SBYTE rb_SipF_ProcessImage.Cat25[0].switches.mcalInputDisconnect.CONVERSION 0 0 -128 127 ECU_ADDRESS 0x400DF4DE /end MEASUREMENT
/begin MEASUREMENT MCore_rb_SipF_ProcessImage.Cat25[0].switches.sipfInputDisconnect "" SBYTE rb_SipF_ProcessImage.Cat25[0].switches.sipfInputDisconnect.CONVERSION 0 0 -128 127 ECU_ADDRESS 0x400DF4DF /end MEASUREMENT
/begin MEASUREMENT MCore_rb_SipF_ProcessImage.Cat30 "" UBYTE NO_COMPU_METHOD 0 0 0 255 ECU_ADDRESS 0x400DF4E0 /end MEASUREMENT
/begin MEASUREMENT MCore_rb_SipF_ProcessImage.Cat30[0].debCounter "" UWORD NO_COMPU_METHOD 0 0 0 65535 ECU_ADDRESS 0x400DF4E6 /end MEASUREMENT
/begin MEASUREMENT MCore_rb_SipF_ProcessImage.Cat30[0].debounced "" UWORD NO_COMPU_METHOD 0 0 0 65535 ECU_ADDRESS 0x400DF4E4 /end MEASUREMENT
/begin MEASUREMENT MCore_rb_SipF_ProcessImage.Cat30[0].processed "" UWORD NO_COMPU_METHOD 0 0 0 65535 ECU_ADDRESS 0x400DF4E8 /end MEASUREMENT
/begin MEASUREMENT MCore_rb_SipF_ProcessImage.Cat30[0].snapshot "" UWORD NO_COMPU_METHOD 0 0 0 65535 ECU_ADDRESS 0x400DF4E0 /end MEASUREMENT
/begin MEASUREMENT MCore_rb_SipF_ProcessImage.Cat30[0].switches "" UBYTE NO_COMPU_METHOD 0 0 0 255 ECU_ADDRESS 0x400DF4EA /end MEASUREMENT
/begin MEASUREMENT MCore_rb_SipF_ProcessImage.Cat30[0].switches.mcalInputDisconnect "" SBYTE rb_SipF_ProcessImage.Cat30[0].switches.mcalInputDisconnect.CONVERSION 0 0 -128 127 ECU_ADDRESS 0x400DF4EA /end MEASUREMENT
/begin MEASUREMENT MCore_rb_SipF_ProcessImage.Cat30[0].switches.sipfInputDisconnect "" SBYTE rb_SipF_ProcessImage.Cat30[0].switches.sipfInputDisconnect.CONVERSION 0 0 -128 127 ECU_ADDRESS 0x400DF4EB /end MEASUREMENT
/begin MEASUREMENT MCore_rb_SipF_ProcessImage.Cat30[1].debCounter "" UWORD NO_COMPU_METHOD 0 0 0 65535 ECU_ADDRESS 0x400DF4F2 /end MEASUREMENT
/begin MEASUREMENT MCore_rb_SipF_ProcessImage.Cat30[1].debounced "" UWORD NO_COMPU_METHOD 0 0 0 65535 ECU_ADDRESS 0x400DF4F0 /end MEASUREMENT
/begin MEASUREMENT MCore_rb_SipF_ProcessImage.Cat30[1].processed "" UWORD NO_COMPU_METHOD 0 0 0 65535 ECU_ADDRESS 0x400DF4F4 /end MEASUREMENT
/begin MEASUREMENT MCore_rb_SipF_ProcessImage.Cat30[1].snapshot "" UWORD NO_COMPU_METHOD 0 0 0 65535 ECU_ADDRESS 0x400DF4EC /end MEASUREMENT
/begin MEASUREMENT MCore_rb_SipF_ProcessImage.Cat30[1].switches "" UBYTE NO_COMPU_METHOD 0 0 0 255 ECU_ADDRESS 0x400DF4F6 /end MEASUREMENT
/begin MEASUREMENT MCore_rb_SipF_ProcessImage.Cat30[1].switches.mcalInputDisconnect "" SBYTE rb_SipF_ProcessImage.Cat30[1].switches.mcalInputDisconnect.CONVERSION 0 0 -128 127 ECU_ADDRESS 0x400DF4F6 /end MEASUREMENT
/begin MEASUREMENT MCore_rb_SipF_ProcessImage.Cat30[1].switches.sipfInputDisconnect "" SBYTE rb_SipF_ProcessImage.Cat30[1].switches.sipfInputDisconnect.CONVERSION 0 0 -128 127 ECU_ADDRESS 0x400DF4F7 /end MEASUREMENT
/begin MEASUREMENT MCore_rb_SipF_ProcessImage.Cat40 "" UBYTE NO_COMPU_METHOD 0 0 0 255 ECU_ADDRESS 0x400DF4F8 /end MEASUREMENT
/begin MEASUREMENT MCore_rb_SipF_ProcessImage.Cat40[0].processed "" UWORD NO_COMPU_METHOD 0 0 0 65535 ECU_ADDRESS 0x400DF4FA /end MEASUREMENT
/begin MEASUREMENT MCore_rb_SipF_ProcessImage.Cat40[0].snapshot "" UWORD NO_COMPU_METHOD 0 0 0 65535 ECU_ADDRESS 0x400DF4F8 /end MEASUREMENT
/begin MEASUREMENT MCore_rb_SipF_ProcessImage.Cat40[0].switches "" UBYTE NO_COMPU_METHOD 0 0 0 255 ECU_ADDRESS 0x400DF4FC /end MEASUREMENT
/begin MEASUREMENT MCore_rb_SipF_ProcessImage.Cat40[0].switches.mcalInputDisconnect "" SBYTE rb_SipF_ProcessImage.Cat40[0].switches.mcalInputDisconnect.CONVERSION 0 0 -128 127 ECU_ADDRESS 0x400DF4FC /end MEASUREMENT
/begin MEASUREMENT MCore_rb_SipF_ProcessImage.Cat40[0].switches.sipfInputDisconnect "" SBYTE rb_SipF_ProcessImage.Cat40[0].switches.sipfInputDisconnect.CONVERSION 0 0 -128 127 ECU_ADDRESS 0x400DF4FD /end MEASUREMENT
/begin MEASUREMENT MCore_rb_SipF_ProcessImage.Cat40[1].processed "" UWORD NO_COMPU_METHOD 0 0 0 65535 ECU_ADDRESS 0x400DF500 /end MEASUREMENT
/begin MEASUREMENT MCore_rb_SipF_ProcessImage.Cat40[1].snapshot "" UWORD NO_COMPU_METHOD 0 0 0 65535 ECU_ADDRESS 0x400DF4FE /end MEASUREMENT
/begin MEASUREMENT MCore_rb_SipF_ProcessImage.Cat40[1].switches "" UBYTE NO_COMPU_METHOD 0 0 0 255 ECU_ADDRESS 0x400DF502 /end MEASUREMENT
/begin MEASUREMENT MCore_rb_SipF_ProcessImage.Cat40[1].switches.mcalInputDisconnect "" SBYTE rb_SipF_ProcessImage.Cat40[1].switches.mcalInputDisconnect.CONVERSION 0 0 -128 127 ECU_ADDRESS 0x400DF502 /end MEASUREMENT
/begin MEASUREMENT MCore_rb_SipF_ProcessImage.Cat40[1].switches.sipfInputDisconnect "" SBYTE rb_SipF_ProcessImage.Cat40[1].switches.sipfInputDisconnect.CONVERSION 0 0 -128 127 ECU_ADDRESS 0x400DF503 /end MEASUREMENT
/begin MEASUREMENT MCore_rb_SipF_ProcessImage.Cat50 "" UBYTE NO_COMPU_METHOD 0 0 0 255 ECU_ADDRESS 0x400DF504 /end MEASUREMENT
/begin MEASUREMENT MCore_rb_SipF_ProcessImage.Cat50[0].highRes "" UBYTE NO_COMPU_METHOD 0 0 0 255 ECU_ADDRESS 0x400DF50C /end MEASUREMENT
/begin MEASUREMENT MCore_rb_SipF_ProcessImage.Cat50[0].highRes.IrmsSq "" UWORD NO_COMPU_METHOD 0 0 0 65535 ECU_ADDRESS 0x400DF510 /end MEASUREMENT
/begin MEASUREMENT MCore_rb_SipF_ProcessImage.Cat50[0].highRes.IrmsSqFiltered "" UBYTE NO_COMPU_METHOD 0 0 0 255 ECU_ADDRESS 0x400DF50C /end MEASUREMENT
/begin MEASUREMENT MCore_rb_SipF_ProcessImage.Cat50[0].highRes.IrmsSqFiltered.B "" UBYTE NO_COMPU_METHOD 0 0 0 255 ECU_ADDRESS 0x400DF50C /end MEASUREMENT
/begin MEASUREMENT MCore_rb_SipF_ProcessImage.Cat50[0].highRes.IrmsSqFiltered.B.high_16 "" UWORD NO_COMPU_METHOD 0 0 0 65535 ECU_ADDRESS 0x400DF50C /end MEASUREMENT
/begin MEASUREMENT MCore_rb_SipF_ProcessImage.Cat50[0].highRes.IrmsSqFiltered.B.low_16 "" UWORD NO_COMPU_METHOD 0 0 0 65535 ECU_ADDRESS 0x400DF50E /end MEASUREMENT
/begin MEASUREMENT MCore_rb_SipF_ProcessImage.Cat50[0].highRes.IrmsSqFiltered.data_32 "" ULONG NO_COMPU_METHOD 0 0 0 4294967295 ECU_ADDRESS 0x400DF50C /end MEASUREMENT
/begin MEASUREMENT MCore_rb_SipF_ProcessImage.Cat50[0].processed "" UWORD NO_COMPU_METHOD 0 0 0 65535 ECU_ADDRESS 0x400DF514 /end MEASUREMENT
/begin MEASUREMENT MCore_rb_SipF_ProcessImage.Cat50[0].snapshot "" UWORD NO_COMPU_METHOD 0 0 0 65535 ECU_ADDRESS 0x400DF504 /end MEASUREMENT
/begin MEASUREMENT MCore_rb_SipF_ProcessImage.Cat50[0].snapshotDuty "" UWORD NO_COMPU_METHOD 0 0 0 65535 ECU_ADDRESS 0x400DF506 /end MEASUREMENT
/begin MEASUREMENT MCore_rb_SipF_ProcessImage.Cat50[0].snapshotErrorValue "" UBYTE NO_COMPU_METHOD 0 0 0 1 BIT_MASK 0x1 ECU_ADDRESS 0x400DF508 /end MEASUREMENT
/begin MEASUREMENT MCore_rb_SipF_ProcessImage.Cat50[0].snapshotPeriod "" UWORD NO_COMPU_METHOD 0 0 0 65535 ECU_ADDRESS 0x400DF508 /end MEASUREMENT
/begin MEASUREMENT MCore_rb_SipF_ProcessImage.Cat50[0].snapshotReserved "" UBYTE NO_COMPU_METHOD 0 0 0 63 BIT_MASK 0xfc ECU_ADDRESS 0x400DF508 /end MEASUREMENT
/begin MEASUREMENT MCore_rb_SipF_ProcessImage.Cat50[0].snapshotSbmValue "" UBYTE NO_COMPU_METHOD 0 0 0 1 BIT_MASK 0x2 ECU_ADDRESS 0x400DF508 /end MEASUREMENT
/begin MEASUREMENT MCore_rb_SipF_ProcessImage.Cat50[0].switches "" UBYTE NO_COMPU_METHOD 0 0 0 255 ECU_ADDRESS 0x400DF518 /end MEASUREMENT
/begin MEASUREMENT MCore_rb_SipF_ProcessImage.Cat50[0].switches.mcalInputDisconnect "" SBYTE rb_SipF_ProcessImage.Cat50[0].switches.mcalInputDisconnect.CONVERSION 0 0 -128 127 ECU_ADDRESS 0x400DF518 /end MEASUREMENT
/begin MEASUREMENT MCore_rb_SipF_ProcessImage.Cat50[0].switches.sipfInputDisconnect "" SBYTE rb_SipF_ProcessImage.Cat50[0].switches.sipfInputDisconnect.CONVERSION 0 0 -128 127 ECU_ADDRESS 0x400DF519 /end MEASUREMENT
/begin MEASUREMENT MCore_rb_SipF_ProcessImage.Cat50[10].highRes "" UBYTE NO_COMPU_METHOD 0 0 0 255 ECU_ADDRESS 0x400DF5FC /end MEASUREMENT
/begin MEASUREMENT MCore_rb_SipF_ProcessImage.Cat50[10].highRes.IrmsSq "" UWORD NO_COMPU_METHOD 0 0 0 65535 ECU_ADDRESS 0x400DF600 /end MEASUREMENT
/begin MEASUREMENT MCore_rb_SipF_ProcessImage.Cat50[10].highRes.IrmsSqFiltered "" UBYTE NO_COMPU_METHOD 0 0 0 255 ECU_ADDRESS 0x400DF5FC /end MEASUREMENT
/begin MEASUREMENT MCore_rb_SipF_ProcessImage.Cat50[10].highRes.IrmsSqFiltered.B "" UBYTE NO_COMPU_METHOD 0 0 0 255 ECU_ADDRESS 0x400DF5FC /end MEASUREMENT
/begin MEASUREMENT MCore_rb_SipF_ProcessImage.Cat50[10].highRes.IrmsSqFiltered.B.high_16 "" UWORD NO_COMPU_METHOD 0 0 0 65535 ECU_ADDRESS 0x400DF5FC /end MEASUREMENT
/begin MEASUREMENT MCore_rb_SipF_ProcessImage.Cat50[10].highRes.IrmsSqFiltered.B.low_16 "" UWORD NO_COMPU_METHOD 0 0 0 65535 ECU_ADDRESS 0x400DF5FE /end MEASUREMENT
/begin MEASUREMENT MCore_rb_SipF_ProcessImage.Cat50[10].highRes.IrmsSqFiltered.data_32 "" ULONG NO_COMPU_METHOD 0 0 0 4294967295 ECU_ADDRESS 0x400DF5FC /end MEASUREMENT
/begin MEASUREMENT MCore_rb_SipF_ProcessImage.Cat50[10].processed "" UWORD NO_COMPU_METHOD 0 0 0 65535 ECU_ADDRESS 0x400DF604 /end MEASUREMENT
/begin MEASUREMENT MCore_rb_SipF_ProcessImage.Cat50[10].snapshot "" UWORD NO_COMPU_METHOD 0 0 0 65535 ECU_ADDRESS 0x400DF5F4 /end MEASUREMENT
/begin MEASUREMENT MCore_rb_SipF_ProcessImage.Cat50[10].snapshotDuty "" UWORD NO_COMPU_METHOD 0 0 0 65535 ECU_ADDRESS 0x400DF5F6 /end MEASUREMENT
/begin MEASUREMENT MCore_rb_SipF_ProcessImage.Cat50[10].snapshotErrorValue "" UBYTE NO_COMPU_METHOD 0 0 0 1 BIT_MASK 0x1 ECU_ADDRESS 0x400DF5F8 /end MEASUREMENT
/begin MEASUREMENT MCore_rb_SipF_ProcessImage.Cat50[10].snapshotPeriod "" UWORD NO_COMPU_METHOD 0 0 0 65535 ECU_ADDRESS 0x400DF5F8 /end MEASUREMENT
/begin MEASUREMENT MCore_rb_SipF_ProcessImage.Cat50[10].snapshotReserved "" UBYTE NO_COMPU_METHOD 0 0 0 63 BIT_MASK 0xfc ECU_ADDRESS 0x400DF5F8 /end MEASUREMENT
/begin MEASUREMENT MCore_rb_SipF_ProcessImage.Cat50[10].snapshotSbmValue "" UBYTE NO_COMPU_METHOD 0 0 0 1 BIT_MASK 0x2 ECU_ADDRESS 0x400DF5F8 /end MEASUREMENT
/begin MEASUREMENT MCore_rb_SipF_ProcessImage.Cat50[10].switches "" UBYTE NO_COMPU_METHOD 0 0 0 255 ECU_ADDRESS 0x400DF608 /end MEASUREMENT
/begin MEASUREMENT MCore_rb_SipF_ProcessImage.Cat50[10].switches.mcalInputDisconnect "" SBYTE rb_SipF_ProcessImage.Cat50[10].switches.mcalInputDisconnect.CONVERSION 0 0 -128 127 ECU_ADDRESS 0x400DF608 /end MEASUREMENT
/begin MEASUREMENT MCore_rb_SipF_ProcessImage.Cat50[10].switches.sipfInputDisconnect "" SBYTE rb_SipF_ProcessImage.Cat50[10].switches.sipfInputDisconnect.CONVERSION 0 0 -128 127 ECU_ADDRESS 0x400DF609 /end MEASUREMENT
/begin MEASUREMENT MCore_rb_SipF_ProcessImage.Cat50[11].highRes "" UBYTE NO_COMPU_METHOD 0 0 0 255 ECU_ADDRESS 0x400DF614 /end MEASUREMENT
/begin MEASUREMENT MCore_rb_SipF_ProcessImage.Cat50[11].highRes.IrmsSq "" UWORD NO_COMPU_METHOD 0 0 0 65535 ECU_ADDRESS 0x400DF618 /end MEASUREMENT
/begin MEASUREMENT MCore_rb_SipF_ProcessImage.Cat50[11].highRes.IrmsSqFiltered "" UBYTE NO_COMPU_METHOD 0 0 0 255 ECU_ADDRESS 0x400DF614 /end MEASUREMENT
/begin MEASUREMENT MCore_rb_SipF_ProcessImage.Cat50[11].highRes.IrmsSqFiltered.B "" UBYTE NO_COMPU_METHOD 0 0 0 255 ECU_ADDRESS 0x400DF614 /end MEASUREMENT
/begin MEASUREMENT MCore_rb_SipF_ProcessImage.Cat50[11].highRes.IrmsSqFiltered.B.high_16 "" UWORD NO_COMPU_METHOD 0 0 0 65535 ECU_ADDRESS 0x400DF614 /end MEASUREMENT
/begin MEASUREMENT MCore_rb_SipF_ProcessImage.Cat50[11].highRes.IrmsSqFiltered.B.low_16 "" UWORD NO_COMPU_METHOD 0 0 0 65535 ECU_ADDRESS 0x400DF616 /end MEASUREMENT
/begin MEASUREMENT MCore_rb_SipF_ProcessImage.Cat50[11].highRes.IrmsSqFiltered.data_32 "" ULONG NO_COMPU_METHOD 0 0 0 4294967295 ECU_ADDRESS 0x400DF614 /end MEASUREMENT
/begin MEASUREMENT MCore_rb_SipF_ProcessImage.Cat50[11].processed "" UWORD NO_COMPU_METHOD 0 0 0 65535 ECU_ADDRESS 0x400DF61C /end MEASUREMENT
/begin MEASUREMENT MCore_rb_SipF_ProcessImage.Cat50[11].snapshot "" UWORD NO_COMPU_METHOD 0 0 0 65535 ECU_ADDRESS 0x400DF60C /end MEASUREMENT
/begin MEASUREMENT MCore_rb_SipF_ProcessImage.Cat50[11].snapshotDuty "" UWORD NO_COMPU_METHOD 0 0 0 65535 ECU_ADDRESS 0x400DF60E /end MEASUREMENT
/begin MEASUREMENT MCore_rb_SipF_ProcessImage.Cat50[11].snapshotErrorValue "" UBYTE NO_COMPU_METHOD 0 0 0 1 BIT_MASK 0x1 ECU_ADDRESS 0x400DF610 /end MEASUREMENT
/begin MEASUREMENT MCore_rb_SipF_ProcessImage.Cat50[11].snapshotPeriod "" UWORD NO_COMPU_METHOD 0 0 0 65535 ECU_ADDRESS 0x400DF610 /end MEASUREMENT
/begin MEASUREMENT MCore_rb_SipF_ProcessImage.Cat50[11].snapshotReserved "" UBYTE NO_COMPU_METHOD 0 0 0 63 BIT_MASK 0xfc ECU_ADDRESS 0x400DF610 /end MEASUREMENT
/begin MEASUREMENT MCore_rb_SipF_ProcessImage.Cat50[11].snapshotSbmValue "" UBYTE NO_COMPU_METHOD 0 0 0 1 BIT_MASK 0x2 ECU_ADDRESS 0x400DF610 /end MEASUREMENT
/begin MEASUREMENT MCore_rb_SipF_ProcessImage.Cat50[11].switches "" UBYTE NO_COMPU_METHOD 0 0 0 255 ECU_ADDRESS 0x400DF620 /end MEASUREMENT
/begin MEASUREMENT MCore_rb_SipF_ProcessImage.Cat50[11].switches.mcalInputDisconnect "" SBYTE rb_SipF_ProcessImage.Cat50[11].switches.mcalInputDisconnect.CONVERSION 0 0 -128 127 ECU_ADDRESS 0x400DF620 /end MEASUREMENT
/begin MEASUREMENT MCore_rb_SipF_ProcessImage.Cat50[11].switches.sipfInputDisconnect "" SBYTE rb_SipF_ProcessImage.Cat50[11].switches.sipfInputDisconnect.CONVERSION 0 0 -128 127 ECU_ADDRESS 0x400DF621 /end MEASUREMENT
/begin MEASUREMENT MCore_rb_SipF_ProcessImage.Cat50[12].highRes "" UBYTE NO_COMPU_METHOD 0 0 0 255 ECU_ADDRESS 0x400DF62C /end MEASUREMENT
/begin MEASUREMENT MCore_rb_SipF_ProcessImage.Cat50[12].highRes.IrmsSq "" UWORD NO_COMPU_METHOD 0 0 0 65535 ECU_ADDRESS 0x400DF630 /end MEASUREMENT
/begin MEASUREMENT MCore_rb_SipF_ProcessImage.Cat50[12].highRes.IrmsSqFiltered "" UBYTE NO_COMPU_METHOD 0 0 0 255 ECU_ADDRESS 0x400DF62C /end MEASUREMENT
/begin MEASUREMENT MCore_rb_SipF_ProcessImage.Cat50[12].highRes.IrmsSqFiltered.B "" UBYTE NO_COMPU_METHOD 0 0 0 255 ECU_ADDRESS 0x400DF62C /end MEASUREMENT
/begin MEASUREMENT MCore_rb_SipF_ProcessImage.Cat50[12].highRes.IrmsSqFiltered.B.high_16 "" UWORD NO_COMPU_METHOD 0 0 0 65535 ECU_ADDRESS 0x400DF62C /end MEASUREMENT
/begin MEASUREMENT MCore_rb_SipF_ProcessImage.Cat50[12].highRes.IrmsSqFiltered.B.low_16 "" UWORD NO_COMPU_METHOD 0 0 0 65535 ECU_ADDRESS 0x400DF62E /end MEASUREMENT
/begin MEASUREMENT MCore_rb_SipF_ProcessImage.Cat50[12].highRes.IrmsSqFiltered.data_32 "" ULONG NO_COMPU_METHOD 0 0 0 4294967295 ECU_ADDRESS 0x400DF62C /end MEASUREMENT
/begin MEASUREMENT MCore_rb_SipF_ProcessImage.Cat50[12].processed "" UWORD NO_COMPU_METHOD 0 0 0 65535 ECU_ADDRESS 0x400DF634 /end MEASUREMENT
/begin MEASUREMENT MCore_rb_SipF_ProcessImage.Cat50[12].snapshot "" UWORD NO_COMPU_METHOD 0 0 0 65535 ECU_ADDRESS 0x400DF624 /end MEASUREMENT
/begin MEASUREMENT MCore_rb_SipF_ProcessImage.Cat50[12].snapshotDuty "" UWORD NO_COMPU_METHOD 0 0 0 65535 ECU_ADDRESS 0x400DF626 /end MEASUREMENT
/begin MEASUREMENT MCore_rb_SipF_ProcessImage.Cat50[12].snapshotErrorValue "" UBYTE NO_COMPU_METHOD 0 0 0 1 BIT_MASK 0x1 ECU_ADDRESS 0x400DF628 /end MEASUREMENT
/begin MEASUREMENT MCore_rb_SipF_ProcessImage.Cat50[12].snapshotPeriod "" UWORD NO_COMPU_METHOD 0 0 0 65535 ECU_ADDRESS 0x400DF628 /end MEASUREMENT
/begin MEASUREMENT MCore_rb_SipF_ProcessImage.Cat50[12].snapshotReserved "" UBYTE NO_COMPU_METHOD 0 0 0 63 BIT_MASK 0xfc ECU_ADDRESS 0x400DF628 /end MEASUREMENT
/begin MEASUREMENT MCore_rb_SipF_ProcessImage.Cat50[12].snapshotSbmValue "" UBYTE NO_COMPU_METHOD 0 0 0 1 BIT_MASK 0x2 ECU_ADDRESS 0x400DF628 /end MEASUREMENT
/begin MEASUREMENT MCore_rb_SipF_ProcessImage.Cat50[12].switches "" UBYTE NO_COMPU_METHOD 0 0 0 255 ECU_ADDRESS 0x400DF638 /end MEASUREMENT
/begin MEASUREMENT MCore_rb_SipF_ProcessImage.Cat50[12].switches.mcalInputDisconnect "" SBYTE rb_SipF_ProcessImage.Cat50[12].switches.mcalInputDisconnect.CONVERSION 0 0 -128 127 ECU_ADDRESS 0x400DF638 /end MEASUREMENT
/begin MEASUREMENT MCore_rb_SipF_ProcessImage.Cat50[12].switches.sipfInputDisconnect "" SBYTE rb_SipF_ProcessImage.Cat50[12].switches.sipfInputDisconnect.CONVERSION 0 0 -128 127 ECU_ADDRESS 0x400DF639 /end MEASUREMENT
/begin MEASUREMENT MCore_rb_SipF_ProcessImage.Cat50[13].highRes "" UBYTE NO_COMPU_METHOD 0 0 0 255 ECU_ADDRESS 0x400DF644 /end MEASUREMENT
/begin MEASUREMENT MCore_rb_SipF_ProcessImage.Cat50[13].highRes.IrmsSq "" UWORD NO_COMPU_METHOD 0 0 0 65535 ECU_ADDRESS 0x400DF648 /end MEASUREMENT
/begin MEASUREMENT MCore_rb_SipF_ProcessImage.Cat50[13].highRes.IrmsSqFiltered "" UBYTE NO_COMPU_METHOD 0 0 0 255 ECU_ADDRESS 0x400DF644 /end MEASUREMENT
/begin MEASUREMENT MCore_rb_SipF_ProcessImage.Cat50[13].highRes.IrmsSqFiltered.B "" UBYTE NO_COMPU_METHOD 0 0 0 255 ECU_ADDRESS 0x400DF644 /end MEASUREMENT
/begin MEASUREMENT MCore_rb_SipF_ProcessImage.Cat50[13].highRes.IrmsSqFiltered.B.high_16 "" UWORD NO_COMPU_METHOD 0 0 0 65535 ECU_ADDRESS 0x400DF644 /end MEASUREMENT
/begin MEASUREMENT MCore_rb_SipF_ProcessImage.Cat50[13].highRes.IrmsSqFiltered.B.low_16 "" UWORD NO_COMPU_METHOD 0 0 0 65535 ECU_ADDRESS 0x400DF646 /end MEASUREMENT
/begin MEASUREMENT MCore_rb_SipF_ProcessImage.Cat50[13].highRes.IrmsSqFiltered.data_32 "" ULONG NO_COMPU_METHOD 0 0 0 4294967295 ECU_ADDRESS 0x400DF644 /end MEASUREMENT
/begin MEASUREMENT MCore_rb_SipF_ProcessImage.Cat50[13].processed "" UWORD NO_COMPU_METHOD 0 0 0 65535 ECU_ADDRESS 0x400DF64C /end MEASUREMENT
/begin MEASUREMENT MCore_rb_SipF_ProcessImage.Cat50[13].snapshot "" UWORD NO_COMPU_METHOD 0 0 0 65535 ECU_ADDRESS 0x400DF63C /end MEASUREMENT
/begin MEASUREMENT MCore_rb_SipF_ProcessImage.Cat50[13].snapshotDuty "" UWORD NO_COMPU_METHOD 0 0 0 65535 ECU_ADDRESS 0x400DF63E /end MEASUREMENT
/begin MEASUREMENT MCore_rb_SipF_ProcessImage.Cat50[13].snapshotErrorValue "" UBYTE NO_COMPU_METHOD 0 0 0 1 BIT_MASK 0x1 ECU_ADDRESS 0x400DF640 /end MEASUREMENT
/begin MEASUREMENT MCore_rb_SipF_ProcessImage.Cat50[13].snapshotPeriod "" UWORD NO_COMPU_METHOD 0 0 0 65535 ECU_ADDRESS 0x400DF640 /end MEASUREMENT
/begin MEASUREMENT MCore_rb_SipF_ProcessImage.Cat50[13].snapshotReserved "" UBYTE NO_COMPU_METHOD 0 0 0 63 BIT_MASK 0xfc ECU_ADDRESS 0x400DF640 /end MEASUREMENT
/begin MEASUREMENT MCore_rb_SipF_ProcessImage.Cat50[13].snapshotSbmValue "" UBYTE NO_COMPU_METHOD 0 0 0 1 BIT_MASK 0x2 ECU_ADDRESS 0x400DF640 /end MEASUREMENT
/begin MEASUREMENT MCore_rb_SipF_ProcessImage.Cat50[13].switches "" UBYTE NO_COMPU_METHOD 0 0 0 255 ECU_ADDRESS 0x400DF650 /end MEASUREMENT
/begin MEASUREMENT MCore_rb_SipF_ProcessImage.Cat50[13].switches.mcalInputDisconnect "" SBYTE rb_SipF_ProcessImage.Cat50[13].switches.mcalInputDisconnect.CONVERSION 0 0 -128 127 ECU_ADDRESS 0x400DF650 /end MEASUREMENT
/begin MEASUREMENT MCore_rb_SipF_ProcessImage.Cat50[13].switches.sipfInputDisconnect "" SBYTE rb_SipF_ProcessImage.Cat50[13].switches.sipfInputDisconnect.CONVERSION 0 0 -128 127 ECU_ADDRESS 0x400DF651 /end MEASUREMENT
/begin MEASUREMENT MCore_rb_SipF_ProcessImage.Cat50[14].highRes "" UBYTE NO_COMPU_METHOD 0 0 0 255 ECU_ADDRESS 0x400DF65C /end MEASUREMENT
/begin MEASUREMENT MCore_rb_SipF_ProcessImage.Cat50[14].highRes.IrmsSq "" UWORD NO_COMPU_METHOD 0 0 0 65535 ECU_ADDRESS 0x400DF660 /end MEASUREMENT
/begin MEASUREMENT MCore_rb_SipF_ProcessImage.Cat50[14].highRes.IrmsSqFiltered "" UBYTE NO_COMPU_METHOD 0 0 0 255 ECU_ADDRESS 0x400DF65C /end MEASUREMENT
/begin MEASUREMENT MCore_rb_SipF_ProcessImage.Cat50[14].highRes.IrmsSqFiltered.B "" UBYTE NO_COMPU_METHOD 0 0 0 255 ECU_ADDRESS 0x400DF65C /end MEASUREMENT
/begin MEASUREMENT MCore_rb_SipF_ProcessImage.Cat50[14].highRes.IrmsSqFiltered.B.high_16 "" UWORD NO_COMPU_METHOD 0 0 0 65535 ECU_ADDRESS 0x400DF65C /end MEASUREMENT
/begin MEASUREMENT MCore_rb_SipF_ProcessImage.Cat50[14].highRes.IrmsSqFiltered.B.low_16 "" UWORD NO_COMPU_METHOD 0 0 0 65535 ECU_ADDRESS 0x400DF65E /end MEASUREMENT
/begin MEASUREMENT MCore_rb_SipF_ProcessImage.Cat50[14].highRes.IrmsSqFiltered.data_32 "" ULONG NO_COMPU_METHOD 0 0 0 4294967295 ECU_ADDRESS 0x400DF65C /end MEASUREMENT
/begin MEASUREMENT MCore_rb_SipF_ProcessImage.Cat50[14].processed "" UWORD NO_COMPU_METHOD 0 0 0 65535 ECU_ADDRESS 0x400DF664 /end MEASUREMENT
/begin MEASUREMENT MCore_rb_SipF_ProcessImage.Cat50[14].snapshot "" UWORD NO_COMPU_METHOD 0 0 0 65535 ECU_ADDRESS 0x400DF654 /end MEASUREMENT
/begin MEASUREMENT MCore_rb_SipF_ProcessImage.Cat50[14].snapshotDuty "" UWORD NO_COMPU_METHOD 0 0 0 65535 ECU_ADDRESS 0x400DF656 /end MEASUREMENT
/begin MEASUREMENT MCore_rb_SipF_ProcessImage.Cat50[14].snapshotErrorValue "" UBYTE NO_COMPU_METHOD 0 0 0 1 BIT_MASK 0x1 ECU_ADDRESS 0x400DF658 /end MEASUREMENT
/begin MEASUREMENT MCore_rb_SipF_ProcessImage.Cat50[14].snapshotPeriod "" UWORD NO_COMPU_METHOD 0 0 0 65535 ECU_ADDRESS 0x400DF658 /end MEASUREMENT
/begin MEASUREMENT MCore_rb_SipF_ProcessImage.Cat50[14].snapshotReserved "" UBYTE NO_COMPU_METHOD 0 0 0 63 BIT_MASK 0xfc ECU_ADDRESS 0x400DF658 /end MEASUREMENT
/begin MEASUREMENT MCore_rb_SipF_ProcessImage.Cat50[14].snapshotSbmValue "" UBYTE NO_COMPU_METHOD 0 0 0 1 BIT_MASK 0x2 ECU_ADDRESS 0x400DF658 /end MEASUREMENT
/begin MEASUREMENT MCore_rb_SipF_ProcessImage.Cat50[14].switches "" UBYTE NO_COMPU_METHOD 0 0 0 255 ECU_ADDRESS 0x400DF668 /end MEASUREMENT
/begin MEASUREMENT MCore_rb_SipF_ProcessImage.Cat50[14].switches.mcalInputDisconnect "" SBYTE rb_SipF_ProcessImage.Cat50[14].switches.mcalInputDisconnect.CONVERSION 0 0 -128 127 ECU_ADDRESS 0x400DF668 /end MEASUREMENT
/begin MEASUREMENT MCore_rb_SipF_ProcessImage.Cat50[14].switches.sipfInputDisconnect "" SBYTE rb_SipF_ProcessImage.Cat50[14].switches.sipfInputDisconnect.CONVERSION 0 0 -128 127 ECU_ADDRESS 0x400DF669 /end MEASUREMENT
/begin MEASUREMENT MCore_rb_SipF_ProcessImage.Cat50[15].highRes "" UBYTE NO_COMPU_METHOD 0 0 0 255 ECU_ADDRESS 0x400DF674 /end MEASUREMENT
/begin MEASUREMENT MCore_rb_SipF_ProcessImage.Cat50[15].highRes.IrmsSq "" UWORD NO_COMPU_METHOD 0 0 0 65535 ECU_ADDRESS 0x400DF678 /end MEASUREMENT
/begin MEASUREMENT MCore_rb_SipF_ProcessImage.Cat50[15].highRes.IrmsSqFiltered "" UBYTE NO_COMPU_METHOD 0 0 0 255 ECU_ADDRESS 0x400DF674 /end MEASUREMENT
/begin MEASUREMENT MCore_rb_SipF_ProcessImage.Cat50[15].highRes.IrmsSqFiltered.B "" UBYTE NO_COMPU_METHOD 0 0 0 255 ECU_ADDRESS 0x400DF674 /end MEASUREMENT
/begin MEASUREMENT MCore_rb_SipF_ProcessImage.Cat50[15].highRes.IrmsSqFiltered.B.high_16 "" UWORD NO_COMPU_METHOD 0 0 0 65535 ECU_ADDRESS 0x400DF674 /end MEASUREMENT
/begin MEASUREMENT MCore_rb_SipF_ProcessImage.Cat50[15].highRes.IrmsSqFiltered.B.low_16 "" UWORD NO_COMPU_METHOD 0 0 0 65535 ECU_ADDRESS 0x400DF676 /end MEASUREMENT
/begin MEASUREMENT MCore_rb_SipF_ProcessImage.Cat50[15].highRes.IrmsSqFiltered.data_32 "" ULONG NO_COMPU_METHOD 0 0 0 4294967295 ECU_ADDRESS 0x400DF674 /end MEASUREMENT
/begin MEASUREMENT MCore_rb_SipF_ProcessImage.Cat50[15].processed "" UWORD NO_COMPU_METHOD 0 0 0 65535 ECU_ADDRESS 0x400DF67C /end MEASUREMENT
/begin MEASUREMENT MCore_rb_SipF_ProcessImage.Cat50[15].snapshot "" UWORD NO_COMPU_METHOD 0 0 0 65535 ECU_ADDRESS 0x400DF66C /end MEASUREMENT
/begin MEASUREMENT MCore_rb_SipF_ProcessImage.Cat50[15].snapshotDuty "" UWORD NO_COMPU_METHOD 0 0 0 65535 ECU_ADDRESS 0x400DF66E /end MEASUREMENT
/begin MEASUREMENT MCore_rb_SipF_ProcessImage.Cat50[15].snapshotErrorValue "" UBYTE NO_COMPU_METHOD 0 0 0 1 BIT_MASK 0x1 ECU_ADDRESS 0x400DF670 /end MEASUREMENT
/begin MEASUREMENT MCore_rb_SipF_ProcessImage.Cat50[15].snapshotPeriod "" UWORD NO_COMPU_METHOD 0 0 0 65535 ECU_ADDRESS 0x400DF670 /end MEASUREMENT
/begin MEASUREMENT MCore_rb_SipF_ProcessImage.Cat50[15].snapshotReserved "" UBYTE NO_COMPU_METHOD 0 0 0 63 BIT_MASK 0xfc ECU_ADDRESS 0x400DF670 /end MEASUREMENT
/begin MEASUREMENT MCore_rb_SipF_ProcessImage.Cat50[15].snapshotSbmValue "" UBYTE NO_COMPU_METHOD 0 0 0 1 BIT_MASK 0x2 ECU_ADDRESS 0x400DF670 /end MEASUREMENT
/begin MEASUREMENT MCore_rb_SipF_ProcessImage.Cat50[15].switches "" UBYTE NO_COMPU_METHOD 0 0 0 255 ECU_ADDRESS 0x400DF680 /end MEASUREMENT
/begin MEASUREMENT MCore_rb_SipF_ProcessImage.Cat50[15].switches.mcalInputDisconnect "" SBYTE rb_SipF_ProcessImage.Cat50[15].switches.mcalInputDisconnect.CONVERSION 0 0 -128 127 ECU_ADDRESS 0x400DF680 /end MEASUREMENT
/begin MEASUREMENT MCore_rb_SipF_ProcessImage.Cat50[15].switches.sipfInputDisconnect "" SBYTE rb_SipF_ProcessImage.Cat50[15].switches.sipfInputDisconnect.CONVERSION 0 0 -128 127 ECU_ADDRESS 0x400DF681 /end MEASUREMENT
/begin MEASUREMENT MCore_rb_SipF_ProcessImage.Cat50[16].highRes "" UBYTE NO_COMPU_METHOD 0 0 0 255 ECU_ADDRESS 0x400DF68C /end MEASUREMENT
/begin MEASUREMENT MCore_rb_SipF_ProcessImage.Cat50[16].highRes.IrmsSq "" UWORD NO_COMPU_METHOD 0 0 0 65535 ECU_ADDRESS 0x400DF690 /end MEASUREMENT
/begin MEASUREMENT MCore_rb_SipF_ProcessImage.Cat50[16].highRes.IrmsSqFiltered "" UBYTE NO_COMPU_METHOD 0 0 0 255 ECU_ADDRESS 0x400DF68C /end MEASUREMENT
/begin MEASUREMENT MCore_rb_SipF_ProcessImage.Cat50[16].highRes.IrmsSqFiltered.B "" UBYTE NO_COMPU_METHOD 0 0 0 255 ECU_ADDRESS 0x400DF68C /end MEASUREMENT
/begin MEASUREMENT MCore_rb_SipF_ProcessImage.Cat50[16].highRes.IrmsSqFiltered.B.high_16 "" UWORD NO_COMPU_METHOD 0 0 0 65535 ECU_ADDRESS 0x400DF68C /end MEASUREMENT
/begin MEASUREMENT MCore_rb_SipF_ProcessImage.Cat50[16].highRes.IrmsSqFiltered.B.low_16 "" UWORD NO_COMPU_METHOD 0 0 0 65535 ECU_ADDRESS 0x400DF68E /end MEASUREMENT
/begin MEASUREMENT MCore_rb_SipF_ProcessImage.Cat50[16].highRes.IrmsSqFiltered.data_32 "" ULONG NO_COMPU_METHOD 0 0 0 4294967295 ECU_ADDRESS 0x400DF68C /end MEASUREMENT
/begin MEASUREMENT MCore_rb_SipF_ProcessImage.Cat50[16].processed "" UWORD NO_COMPU_METHOD 0 0 0 65535 ECU_ADDRESS 0x400DF694 /end MEASUREMENT
/begin MEASUREMENT MCore_rb_SipF_ProcessImage.Cat50[16].snapshot "" UWORD NO_COMPU_METHOD 0 0 0 65535 ECU_ADDRESS 0x400DF684 /end MEASUREMENT
/begin MEASUREMENT MCore_rb_SipF_ProcessImage.Cat50[16].snapshotDuty "" UWORD NO_COMPU_METHOD 0 0 0 65535 ECU_ADDRESS 0x400DF686 /end MEASUREMENT
/begin MEASUREMENT MCore_rb_SipF_ProcessImage.Cat50[16].snapshotErrorValue "" UBYTE NO_COMPU_METHOD 0 0 0 1 BIT_MASK 0x1 ECU_ADDRESS 0x400DF688 /end MEASUREMENT
/begin MEASUREMENT MCore_rb_SipF_ProcessImage.Cat50[16].snapshotPeriod "" UWORD NO_COMPU_METHOD 0 0 0 65535 ECU_ADDRESS 0x400DF688 /end MEASUREMENT
/begin MEASUREMENT MCore_rb_SipF_ProcessImage.Cat50[16].snapshotReserved "" UBYTE NO_COMPU_METHOD 0 0 0 63 BIT_MASK 0xfc ECU_ADDRESS 0x400DF688 /end MEASUREMENT
/begin MEASUREMENT MCore_rb_SipF_ProcessImage.Cat50[16].snapshotSbmValue "" UBYTE NO_COMPU_METHOD 0 0 0 1 BIT_MASK 0x2 ECU_ADDRESS 0x400DF688 /end MEASUREMENT
/begin MEASUREMENT MCore_rb_SipF_ProcessImage.Cat50[16].switches "" UBYTE NO_COMPU_METHOD 0 0 0 255 ECU_ADDRESS 0x400DF698 /end MEASUREMENT
/begin MEASUREMENT MCore_rb_SipF_ProcessImage.Cat50[16].switches.mcalInputDisconnect "" SBYTE rb_SipF_ProcessImage.Cat50[16].switches.mcalInputDisconnect.CONVERSION 0 0 -128 127 ECU_ADDRESS 0x400DF698 /end MEASUREMENT
/begin MEASUREMENT MCore_rb_SipF_ProcessImage.Cat50[16].switches.sipfInputDisconnect "" SBYTE rb_SipF_ProcessImage.Cat50[16].switches.sipfInputDisconnect.CONVERSION 0 0 -128 127 ECU_ADDRESS 0x400DF699 /end MEASUREMENT
/begin MEASUREMENT MCore_rb_SipF_ProcessImage.Cat50[17].highRes "" UBYTE NO_COMPU_METHOD 0 0 0 255 ECU_ADDRESS 0x400DF6A4 /end MEASUREMENT
/begin MEASUREMENT MCore_rb_SipF_ProcessImage.Cat50[17].highRes.IrmsSq "" UWORD NO_COMPU_METHOD 0 0 0 65535 ECU_ADDRESS 0x400DF6A8 /end MEASUREMENT
/begin MEASUREMENT MCore_rb_SipF_ProcessImage.Cat50[17].highRes.IrmsSqFiltered "" UBYTE NO_COMPU_METHOD 0 0 0 255 ECU_ADDRESS 0x400DF6A4 /end MEASUREMENT
/begin MEASUREMENT MCore_rb_SipF_ProcessImage.Cat50[17].highRes.IrmsSqFiltered.B "" UBYTE NO_COMPU_METHOD 0 0 0 255 ECU_ADDRESS 0x400DF6A4 /end MEASUREMENT
/begin MEASUREMENT MCore_rb_SipF_ProcessImage.Cat50[17].highRes.IrmsSqFiltered.B.high_16 "" UWORD NO_COMPU_METHOD 0 0 0 65535 ECU_ADDRESS 0x400DF6A4 /end MEASUREMENT
/begin MEASUREMENT MCore_rb_SipF_ProcessImage.Cat50[17].highRes.IrmsSqFiltered.B.low_16 "" UWORD NO_COMPU_METHOD 0 0 0 65535 ECU_ADDRESS 0x400DF6A6 /end MEASUREMENT
/begin MEASUREMENT MCore_rb_SipF_ProcessImage.Cat50[17].highRes.IrmsSqFiltered.data_32 "" ULONG NO_COMPU_METHOD 0 0 0 4294967295 ECU_ADDRESS 0x400DF6A4 /end MEASUREMENT
/begin MEASUREMENT MCore_rb_SipF_ProcessImage.Cat50[17].processed "" UWORD NO_COMPU_METHOD 0 0 0 65535 ECU_ADDRESS 0x400DF6AC /end MEASUREMENT
/begin MEASUREMENT MCore_rb_SipF_ProcessImage.Cat50[17].snapshot "" UWORD NO_COMPU_METHOD 0 0 0 65535 ECU_ADDRESS 0x400DF69C /end MEASUREMENT
/begin MEASUREMENT MCore_rb_SipF_ProcessImage.Cat50[17].snapshotDuty "" UWORD NO_COMPU_METHOD 0 0 0 65535 ECU_ADDRESS 0x400DF69E /end MEASUREMENT
/begin MEASUREMENT MCore_rb_SipF_ProcessImage.Cat50[17].snapshotErrorValue "" UBYTE NO_COMPU_METHOD 0 0 0 1 BIT_MASK 0x1 ECU_ADDRESS 0x400DF6A0 /end MEASUREMENT
/begin MEASUREMENT MCore_rb_SipF_ProcessImage.Cat50[17].snapshotPeriod "" UWORD NO_COMPU_METHOD 0 0 0 65535 ECU_ADDRESS 0x400DF6A0 /end MEASUREMENT
/begin MEASUREMENT MCore_rb_SipF_ProcessImage.Cat50[17].snapshotReserved "" UBYTE NO_COMPU_METHOD 0 0 0 63 BIT_MASK 0xfc ECU_ADDRESS 0x400DF6A0 /end MEASUREMENT
/begin MEASUREMENT MCore_rb_SipF_ProcessImage.Cat50[17].snapshotSbmValue "" UBYTE NO_COMPU_METHOD 0 0 0 1 BIT_MASK 0x2 ECU_ADDRESS 0x400DF6A0 /end MEASUREMENT
/begin MEASUREMENT MCore_rb_SipF_ProcessImage.Cat50[17].switches "" UBYTE NO_COMPU_METHOD 0 0 0 255 ECU_ADDRESS 0x400DF6B0 /end MEASUREMENT
/begin MEASUREMENT MCore_rb_SipF_ProcessImage.Cat50[17].switches.mcalInputDisconnect "" SBYTE rb_SipF_ProcessImage.Cat50[17].switches.mcalInputDisconnect.CONVERSION 0 0 -128 127 ECU_ADDRESS 0x400DF6B0 /end MEASUREMENT
/begin MEASUREMENT MCore_rb_SipF_ProcessImage.Cat50[17].switches.sipfInputDisconnect "" SBYTE rb_SipF_ProcessImage.Cat50[17].switches.sipfInputDisconnect.CONVERSION 0 0 -128 127 ECU_ADDRESS 0x400DF6B1 /end MEASUREMENT
/begin MEASUREMENT MCore_rb_SipF_ProcessImage.Cat50[18].highRes "" UBYTE NO_COMPU_METHOD 0 0 0 255 ECU_ADDRESS 0x400DF6BC /end MEASUREMENT
/begin MEASUREMENT MCore_rb_SipF_ProcessImage.Cat50[18].highRes.IrmsSq "" UWORD NO_COMPU_METHOD 0 0 0 65535 ECU_ADDRESS 0x400DF6C0 /end MEASUREMENT
/begin MEASUREMENT MCore_rb_SipF_ProcessImage.Cat50[18].highRes.IrmsSqFiltered "" UBYTE NO_COMPU_METHOD 0 0 0 255 ECU_ADDRESS 0x400DF6BC /end MEASUREMENT
/begin MEASUREMENT MCore_rb_SipF_ProcessImage.Cat50[18].highRes.IrmsSqFiltered.B "" UBYTE NO_COMPU_METHOD 0 0 0 255 ECU_ADDRESS 0x400DF6BC /end MEASUREMENT
/begin MEASUREMENT MCore_rb_SipF_ProcessImage.Cat50[18].highRes.IrmsSqFiltered.B.high_16 "" UWORD NO_COMPU_METHOD 0 0 0 65535 ECU_ADDRESS 0x400DF6BC /end MEASUREMENT
/begin MEASUREMENT MCore_rb_SipF_ProcessImage.Cat50[18].highRes.IrmsSqFiltered.B.low_16 "" UWORD NO_COMPU_METHOD 0 0 0 65535 ECU_ADDRESS 0x400DF6BE /end MEASUREMENT
/begin MEASUREMENT MCore_rb_SipF_ProcessImage.Cat50[18].highRes.IrmsSqFiltered.data_32 "" ULONG NO_COMPU_METHOD 0 0 0 4294967295 ECU_ADDRESS 0x400DF6BC /end MEASUREMENT
/begin MEASUREMENT MCore_rb_SipF_ProcessImage.Cat50[18].processed "" UWORD NO_COMPU_METHOD 0 0 0 65535 ECU_ADDRESS 0x400DF6C4 /end MEASUREMENT
/begin MEASUREMENT MCore_rb_SipF_ProcessImage.Cat50[18].snapshot "" UWORD NO_COMPU_METHOD 0 0 0 65535 ECU_ADDRESS 0x400DF6B4 /end MEASUREMENT
/begin MEASUREMENT MCore_rb_SipF_ProcessImage.Cat50[18].snapshotDuty "" UWORD NO_COMPU_METHOD 0 0 0 65535 ECU_ADDRESS 0x400DF6B6 /end MEASUREMENT
/begin MEASUREMENT MCore_rb_SipF_ProcessImage.Cat50[18].snapshotErrorValue "" UBYTE NO_COMPU_METHOD 0 0 0 1 BIT_MASK 0x1 ECU_ADDRESS 0x400DF6B8 /end MEASUREMENT
/begin MEASUREMENT MCore_rb_SipF_ProcessImage.Cat50[18].snapshotPeriod "" UWORD NO_COMPU_METHOD 0 0 0 65535 ECU_ADDRESS 0x400DF6B8 /end MEASUREMENT
/begin MEASUREMENT MCore_rb_SipF_ProcessImage.Cat50[18].snapshotReserved "" UBYTE NO_COMPU_METHOD 0 0 0 63 BIT_MASK 0xfc ECU_ADDRESS 0x400DF6B8 /end MEASUREMENT
/begin MEASUREMENT MCore_rb_SipF_ProcessImage.Cat50[18].snapshotSbmValue "" UBYTE NO_COMPU_METHOD 0 0 0 1 BIT_MASK 0x2 ECU_ADDRESS 0x400DF6B8 /end MEASUREMENT
/begin MEASUREMENT MCore_rb_SipF_ProcessImage.Cat50[18].switches "" UBYTE NO_COMPU_METHOD 0 0 0 255 ECU_ADDRESS 0x400DF6C8 /end MEASUREMENT
/begin MEASUREMENT MCore_rb_SipF_ProcessImage.Cat50[18].switches.mcalInputDisconnect "" SBYTE rb_SipF_ProcessImage.Cat50[18].switches.mcalInputDisconnect.CONVERSION 0 0 -128 127 ECU_ADDRESS 0x400DF6C8 /end MEASUREMENT
/begin MEASUREMENT MCore_rb_SipF_ProcessImage.Cat50[18].switches.sipfInputDisconnect "" SBYTE rb_SipF_ProcessImage.Cat50[18].switches.sipfInputDisconnect.CONVERSION 0 0 -128 127 ECU_ADDRESS 0x400DF6C9 /end MEASUREMENT
/begin MEASUREMENT MCore_rb_SipF_ProcessImage.Cat50[19].highRes "" UBYTE NO_COMPU_METHOD 0 0 0 255 ECU_ADDRESS 0x400DF6D4 /end MEASUREMENT
/begin MEASUREMENT MCore_rb_SipF_ProcessImage.Cat50[19].highRes.IrmsSq "" UWORD NO_COMPU_METHOD 0 0 0 65535 ECU_ADDRESS 0x400DF6D8 /end MEASUREMENT
/begin MEASUREMENT MCore_rb_SipF_ProcessImage.Cat50[19].highRes.IrmsSqFiltered "" UBYTE NO_COMPU_METHOD 0 0 0 255 ECU_ADDRESS 0x400DF6D4 /end MEASUREMENT
/begin MEASUREMENT MCore_rb_SipF_ProcessImage.Cat50[19].highRes.IrmsSqFiltered.B "" UBYTE NO_COMPU_METHOD 0 0 0 255 ECU_ADDRESS 0x400DF6D4 /end MEASUREMENT
/begin MEASUREMENT MCore_rb_SipF_ProcessImage.Cat50[19].highRes.IrmsSqFiltered.B.high_16 "" UWORD NO_COMPU_METHOD 0 0 0 65535 ECU_ADDRESS 0x400DF6D4 /end MEASUREMENT
/begin MEASUREMENT MCore_rb_SipF_ProcessImage.Cat50[19].highRes.IrmsSqFiltered.B.low_16 "" UWORD NO_COMPU_METHOD 0 0 0 65535 ECU_ADDRESS 0x400DF6D6 /end MEASUREMENT
/begin MEASUREMENT MCore_rb_SipF_ProcessImage.Cat50[19].highRes.IrmsSqFiltered.data_32 "" ULONG NO_COMPU_METHOD 0 0 0 4294967295 ECU_ADDRESS 0x400DF6D4 /end MEASUREMENT
/begin MEASUREMENT MCore_rb_SipF_ProcessImage.Cat50[19].processed "" UWORD NO_COMPU_METHOD 0 0 0 65535 ECU_ADDRESS 0x400DF6DC /end MEASUREMENT
/begin MEASUREMENT MCore_rb_SipF_ProcessImage.Cat50[19].snapshot "" UWORD NO_COMPU_METHOD 0 0 0 65535 ECU_ADDRESS 0x400DF6CC /end MEASUREMENT
/begin MEASUREMENT MCore_rb_SipF_ProcessImage.Cat50[19].snapshotDuty "" UWORD NO_COMPU_METHOD 0 0 0 65535 ECU_ADDRESS 0x400DF6CE /end MEASUREMENT
/begin MEASUREMENT MCore_rb_SipF_ProcessImage.Cat50[19].snapshotErrorValue "" UBYTE NO_COMPU_METHOD 0 0 0 1 BIT_MASK 0x1 ECU_ADDRESS 0x400DF6D0 /end MEASUREMENT
/begin MEASUREMENT MCore_rb_SipF_ProcessImage.Cat50[19].snapshotPeriod "" UWORD NO_COMPU_METHOD 0 0 0 65535 ECU_ADDRESS 0x400DF6D0 /end MEASUREMENT
/begin MEASUREMENT MCore_rb_SipF_ProcessImage.Cat50[19].snapshotReserved "" UBYTE NO_COMPU_METHOD 0 0 0 63 BIT_MASK 0xfc ECU_ADDRESS 0x400DF6D0 /end MEASUREMENT
/begin MEASUREMENT MCore_rb_SipF_ProcessImage.Cat50[19].snapshotSbmValue "" UBYTE NO_COMPU_METHOD 0 0 0 1 BIT_MASK 0x2 ECU_ADDRESS 0x400DF6D0 /end MEASUREMENT
/begin MEASUREMENT MCore_rb_SipF_ProcessImage.Cat50[19].switches "" UBYTE NO_COMPU_METHOD 0 0 0 255 ECU_ADDRESS 0x400DF6E0 /end MEASUREMENT
/begin MEASUREMENT MCore_rb_SipF_ProcessImage.Cat50[19].switches.mcalInputDisconnect "" SBYTE rb_SipF_ProcessImage.Cat50[19].switches.mcalInputDisconnect.CONVERSION 0 0 -128 127 ECU_ADDRESS 0x400DF6E0 /end MEASUREMENT
/begin MEASUREMENT MCore_rb_SipF_ProcessImage.Cat50[19].switches.sipfInputDisconnect "" SBYTE rb_SipF_ProcessImage.Cat50[19].switches.sipfInputDisconnect.CONVERSION 0 0 -128 127 ECU_ADDRESS 0x400DF6E1 /end MEASUREMENT
/begin MEASUREMENT MCore_rb_SipF_ProcessImage.Cat50[1].highRes "" UBYTE NO_COMPU_METHOD 0 0 0 255 ECU_ADDRESS 0x400DF524 /end MEASUREMENT
/begin MEASUREMENT MCore_rb_SipF_ProcessImage.Cat50[1].highRes.IrmsSq "" UWORD NO_COMPU_METHOD 0 0 0 65535 ECU_ADDRESS 0x400DF528 /end MEASUREMENT
/begin MEASUREMENT MCore_rb_SipF_ProcessImage.Cat50[1].highRes.IrmsSqFiltered "" UBYTE NO_COMPU_METHOD 0 0 0 255 ECU_ADDRESS 0x400DF524 /end MEASUREMENT
/begin MEASUREMENT MCore_rb_SipF_ProcessImage.Cat50[1].highRes.IrmsSqFiltered.B "" UBYTE NO_COMPU_METHOD 0 0 0 255 ECU_ADDRESS 0x400DF524 /end MEASUREMENT
/begin MEASUREMENT MCore_rb_SipF_ProcessImage.Cat50[1].highRes.IrmsSqFiltered.B.high_16 "" UWORD NO_COMPU_METHOD 0 0 0 65535 ECU_ADDRESS 0x400DF524 /end MEASUREMENT
/begin MEASUREMENT MCore_rb_SipF_ProcessImage.Cat50[1].highRes.IrmsSqFiltered.B.low_16 "" UWORD NO_COMPU_METHOD 0 0 0 65535 ECU_ADDRESS 0x400DF526 /end MEASUREMENT
/begin MEASUREMENT MCore_rb_SipF_ProcessImage.Cat50[1].highRes.IrmsSqFiltered.data_32 "" ULONG NO_COMPU_METHOD 0 0 0 4294967295 ECU_ADDRESS 0x400DF524 /end MEASUREMENT
/begin MEASUREMENT MCore_rb_SipF_ProcessImage.Cat50[1].processed "" UWORD NO_COMPU_METHOD 0 0 0 65535 ECU_ADDRESS 0x400DF52C /end MEASUREMENT
/begin MEASUREMENT MCore_rb_SipF_ProcessImage.Cat50[1].snapshot "" UWORD NO_COMPU_METHOD 0 0 0 65535 ECU_ADDRESS 0x400DF51C /end MEASUREMENT
/begin MEASUREMENT MCore_rb_SipF_ProcessImage.Cat50[1].snapshotDuty "" UWORD NO_COMPU_METHOD 0 0 0 65535 ECU_ADDRESS 0x400DF51E /end MEASUREMENT
/begin MEASUREMENT MCore_rb_SipF_ProcessImage.Cat50[1].snapshotErrorValue "" UBYTE NO_COMPU_METHOD 0 0 0 1 BIT_MASK 0x1 ECU_ADDRESS 0x400DF520 /end MEASUREMENT
/begin MEASUREMENT MCore_rb_SipF_ProcessImage.Cat50[1].snapshotPeriod "" UWORD NO_COMPU_METHOD 0 0 0 65535 ECU_ADDRESS 0x400DF520 /end MEASUREMENT
/begin MEASUREMENT MCore_rb_SipF_ProcessImage.Cat50[1].snapshotReserved "" UBYTE NO_COMPU_METHOD 0 0 0 63 BIT_MASK 0xfc ECU_ADDRESS 0x400DF520 /end MEASUREMENT
/begin MEASUREMENT MCore_rb_SipF_ProcessImage.Cat50[1].snapshotSbmValue "" UBYTE NO_COMPU_METHOD 0 0 0 1 BIT_MASK 0x2 ECU_ADDRESS 0x400DF520 /end MEASUREMENT
/begin MEASUREMENT MCore_rb_SipF_ProcessImage.Cat50[1].switches "" UBYTE NO_COMPU_METHOD 0 0 0 255 ECU_ADDRESS 0x400DF530 /end MEASUREMENT
/begin MEASUREMENT MCore_rb_SipF_ProcessImage.Cat50[1].switches.mcalInputDisconnect "" SBYTE rb_SipF_ProcessImage.Cat50[1].switches.mcalInputDisconnect.CONVERSION 0 0 -128 127 ECU_ADDRESS 0x400DF530 /end MEASUREMENT
/begin MEASUREMENT MCore_rb_SipF_ProcessImage.Cat50[1].switches.sipfInputDisconnect "" SBYTE rb_SipF_ProcessImage.Cat50[1].switches.sipfInputDisconnect.CONVERSION 0 0 -128 127 ECU_ADDRESS 0x400DF531 /end MEASUREMENT
/begin MEASUREMENT MCore_rb_SipF_ProcessImage.Cat50[20].highRes "" UBYTE NO_COMPU_METHOD 0 0 0 255 ECU_ADDRESS 0x400DF6EC /end MEASUREMENT
/begin MEASUREMENT MCore_rb_SipF_ProcessImage.Cat50[20].highRes.IrmsSq "" UWORD NO_COMPU_METHOD 0 0 0 65535 ECU_ADDRESS 0x400DF6F0 /end MEASUREMENT
/begin MEASUREMENT MCore_rb_SipF_ProcessImage.Cat50[20].highRes.IrmsSqFiltered "" UBYTE NO_COMPU_METHOD 0 0 0 255 ECU_ADDRESS 0x400DF6EC /end MEASUREMENT
/begin MEASUREMENT MCore_rb_SipF_ProcessImage.Cat50[20].highRes.IrmsSqFiltered.B "" UBYTE NO_COMPU_METHOD 0 0 0 255 ECU_ADDRESS 0x400DF6EC /end MEASUREMENT
/begin MEASUREMENT MCore_rb_SipF_ProcessImage.Cat50[20].highRes.IrmsSqFiltered.B.high_16 "" UWORD NO_COMPU_METHOD 0 0 0 65535 ECU_ADDRESS 0x400DF6EC /end MEASUREMENT
/begin MEASUREMENT MCore_rb_SipF_ProcessImage.Cat50[20].highRes.IrmsSqFiltered.B.low_16 "" UWORD NO_COMPU_METHOD 0 0 0 65535 ECU_ADDRESS 0x400DF6EE /end MEASUREMENT
/begin MEASUREMENT MCore_rb_SipF_ProcessImage.Cat50[20].highRes.IrmsSqFiltered.data_32 "" ULONG NO_COMPU_METHOD 0 0 0 4294967295 ECU_ADDRESS 0x400DF6EC /end MEASUREMENT
/begin MEASUREMENT MCore_rb_SipF_ProcessImage.Cat50[20].processed "" UWORD NO_COMPU_METHOD 0 0 0 65535 ECU_ADDRESS 0x400DF6F4 /end MEASUREMENT
/begin MEASUREMENT MCore_rb_SipF_ProcessImage.Cat50[20].snapshot "" UWORD NO_COMPU_METHOD 0 0 0 65535 ECU_ADDRESS 0x400DF6E4 /end MEASUREMENT
/begin MEASUREMENT MCore_rb_SipF_ProcessImage.Cat50[20].snapshotDuty "" UWORD NO_COMPU_METHOD 0 0 0 65535 ECU_ADDRESS 0x400DF6E6 /end MEASUREMENT
/begin MEASUREMENT MCore_rb_SipF_ProcessImage.Cat50[20].snapshotErrorValue "" UBYTE NO_COMPU_METHOD 0 0 0 1 BIT_MASK 0x1 ECU_ADDRESS 0x400DF6E8 /end MEASUREMENT
/begin MEASUREMENT MCore_rb_SipF_ProcessImage.Cat50[20].snapshotPeriod "" UWORD NO_COMPU_METHOD 0 0 0 65535 ECU_ADDRESS 0x400DF6E8 /end MEASUREMENT
/begin MEASUREMENT MCore_rb_SipF_ProcessImage.Cat50[20].snapshotReserved "" UBYTE NO_COMPU_METHOD 0 0 0 63 BIT_MASK 0xfc ECU_ADDRESS 0x400DF6E8 /end MEASUREMENT
/begin MEASUREMENT MCore_rb_SipF_ProcessImage.Cat50[20].snapshotSbmValue "" UBYTE NO_COMPU_METHOD 0 0 0 1 BIT_MASK 0x2 ECU_ADDRESS 0x400DF6E8 /end MEASUREMENT
/begin MEASUREMENT MCore_rb_SipF_ProcessImage.Cat50[20].switches "" UBYTE NO_COMPU_METHOD 0 0 0 255 ECU_ADDRESS 0x400DF6F8 /end MEASUREMENT
/begin MEASUREMENT MCore_rb_SipF_ProcessImage.Cat50[20].switches.mcalInputDisconnect "" SBYTE rb_SipF_ProcessImage.Cat50[20].switches.mcalInputDisconnect.CONVERSION 0 0 -128 127 ECU_ADDRESS 0x400DF6F8 /end MEASUREMENT
/begin MEASUREMENT MCore_rb_SipF_ProcessImage.Cat50[20].switches.sipfInputDisconnect "" SBYTE rb_SipF_ProcessImage.Cat50[20].switches.sipfInputDisconnect.CONVERSION 0 0 -128 127 ECU_ADDRESS 0x400DF6F9 /end MEASUREMENT
/begin MEASUREMENT MCore_rb_SipF_ProcessImage.Cat50[21].highRes "" UBYTE NO_COMPU_METHOD 0 0 0 255 ECU_ADDRESS 0x400DF704 /end MEASUREMENT
/begin MEASUREMENT MCore_rb_SipF_ProcessImage.Cat50[21].highRes.IrmsSq "" UWORD NO_COMPU_METHOD 0 0 0 65535 ECU_ADDRESS 0x400DF708 /end MEASUREMENT
/begin MEASUREMENT MCore_rb_SipF_ProcessImage.Cat50[21].highRes.IrmsSqFiltered "" UBYTE NO_COMPU_METHOD 0 0 0 255 ECU_ADDRESS 0x400DF704 /end MEASUREMENT
/begin MEASUREMENT MCore_rb_SipF_ProcessImage.Cat50[21].highRes.IrmsSqFiltered.B "" UBYTE NO_COMPU_METHOD 0 0 0 255 ECU_ADDRESS 0x400DF704 /end MEASUREMENT
/begin MEASUREMENT MCore_rb_SipF_ProcessImage.Cat50[21].highRes.IrmsSqFiltered.B.high_16 "" UWORD NO_COMPU_METHOD 0 0 0 65535 ECU_ADDRESS 0x400DF704 /end MEASUREMENT
/begin MEASUREMENT MCore_rb_SipF_ProcessImage.Cat50[21].highRes.IrmsSqFiltered.B.low_16 "" UWORD NO_COMPU_METHOD 0 0 0 65535 ECU_ADDRESS 0x400DF706 /end MEASUREMENT
/begin MEASUREMENT MCore_rb_SipF_ProcessImage.Cat50[21].highRes.IrmsSqFiltered.data_32 "" ULONG NO_COMPU_METHOD 0 0 0 4294967295 ECU_ADDRESS 0x400DF704 /end MEASUREMENT
/begin MEASUREMENT MCore_rb_SipF_ProcessImage.Cat50[21].processed "" UWORD NO_COMPU_METHOD 0 0 0 65535 ECU_ADDRESS 0x400DF70C /end MEASUREMENT
/begin MEASUREMENT MCore_rb_SipF_ProcessImage.Cat50[21].snapshot "" UWORD NO_COMPU_METHOD 0 0 0 65535 ECU_ADDRESS 0x400DF6FC /end MEASUREMENT
/begin MEASUREMENT MCore_rb_SipF_ProcessImage.Cat50[21].snapshotDuty "" UWORD NO_COMPU_METHOD 0 0 0 65535 ECU_ADDRESS 0x400DF6FE /end MEASUREMENT
/begin MEASUREMENT MCore_rb_SipF_ProcessImage.Cat50[21].snapshotErrorValue "" UBYTE NO_COMPU_METHOD 0 0 0 1 BIT_MASK 0x1 ECU_ADDRESS 0x400DF700 /end MEASUREMENT
/begin MEASUREMENT MCore_rb_SipF_ProcessImage.Cat50[21].snapshotPeriod "" UWORD NO_COMPU_METHOD 0 0 0 65535 ECU_ADDRESS 0x400DF700 /end MEASUREMENT
/begin MEASUREMENT MCore_rb_SipF_ProcessImage.Cat50[21].snapshotReserved "" UBYTE NO_COMPU_METHOD 0 0 0 63 BIT_MASK 0xfc ECU_ADDRESS 0x400DF700 /end MEASUREMENT
/begin MEASUREMENT MCore_rb_SipF_ProcessImage.Cat50[21].snapshotSbmValue "" UBYTE NO_COMPU_METHOD 0 0 0 1 BIT_MASK 0x2 ECU_ADDRESS 0x400DF700 /end MEASUREMENT
/begin MEASUREMENT MCore_rb_SipF_ProcessImage.Cat50[21].switches "" UBYTE NO_COMPU_METHOD 0 0 0 255 ECU_ADDRESS 0x400DF710 /end MEASUREMENT
/begin MEASUREMENT MCore_rb_SipF_ProcessImage.Cat50[21].switches.mcalInputDisconnect "" SBYTE rb_SipF_ProcessImage.Cat50[21].switches.mcalInputDisconnect.CONVERSION 0 0 -128 127 ECU_ADDRESS 0x400DF710 /end MEASUREMENT
/begin MEASUREMENT MCore_rb_SipF_ProcessImage.Cat50[21].switches.sipfInputDisconnect "" SBYTE rb_SipF_ProcessImage.Cat50[21].switches.sipfInputDisconnect.CONVERSION 0 0 -128 127 ECU_ADDRESS 0x400DF711 /end MEASUREMENT
/begin MEASUREMENT MCore_rb_SipF_ProcessImage.Cat50[22].highRes "" UBYTE NO_COMPU_METHOD 0 0 0 255 ECU_ADDRESS 0x400DF71C /end MEASUREMENT
/begin MEASUREMENT MCore_rb_SipF_ProcessImage.Cat50[22].highRes.IrmsSq "" UWORD NO_COMPU_METHOD 0 0 0 65535 ECU_ADDRESS 0x400DF720 /end MEASUREMENT
/begin MEASUREMENT MCore_rb_SipF_ProcessImage.Cat50[22].highRes.IrmsSqFiltered "" UBYTE NO_COMPU_METHOD 0 0 0 255 ECU_ADDRESS 0x400DF71C /end MEASUREMENT
/begin MEASUREMENT MCore_rb_SipF_ProcessImage.Cat50[22].highRes.IrmsSqFiltered.B "" UBYTE NO_COMPU_METHOD 0 0 0 255 ECU_ADDRESS 0x400DF71C /end MEASUREMENT
/begin MEASUREMENT MCore_rb_SipF_ProcessImage.Cat50[22].highRes.IrmsSqFiltered.B.high_16 "" UWORD NO_COMPU_METHOD 0 0 0 65535 ECU_ADDRESS 0x400DF71C /end MEASUREMENT
/begin MEASUREMENT MCore_rb_SipF_ProcessImage.Cat50[22].highRes.IrmsSqFiltered.B.low_16 "" UWORD NO_COMPU_METHOD 0 0 0 65535 ECU_ADDRESS 0x400DF71E /end MEASUREMENT
/begin MEASUREMENT MCore_rb_SipF_ProcessImage.Cat50[22].highRes.IrmsSqFiltered.data_32 "" ULONG NO_COMPU_METHOD 0 0 0 4294967295 ECU_ADDRESS 0x400DF71C /end MEASUREMENT
/begin MEASUREMENT MCore_rb_SipF_ProcessImage.Cat50[22].processed "" UWORD NO_COMPU_METHOD 0 0 0 65535 ECU_ADDRESS 0x400DF724 /end MEASUREMENT
/begin MEASUREMENT MCore_rb_SipF_ProcessImage.Cat50[22].snapshot "" UWORD NO_COMPU_METHOD 0 0 0 65535 ECU_ADDRESS 0x400DF714 /end MEASUREMENT
/begin MEASUREMENT MCore_rb_SipF_ProcessImage.Cat50[22].snapshotDuty "" UWORD NO_COMPU_METHOD 0 0 0 65535 ECU_ADDRESS 0x400DF716 /end MEASUREMENT
/begin MEASUREMENT MCore_rb_SipF_ProcessImage.Cat50[22].snapshotErrorValue "" UBYTE NO_COMPU_METHOD 0 0 0 1 BIT_MASK 0x1 ECU_ADDRESS 0x400DF718 /end MEASUREMENT
/begin MEASUREMENT MCore_rb_SipF_ProcessImage.Cat50[22].snapshotPeriod "" UWORD NO_COMPU_METHOD 0 0 0 65535 ECU_ADDRESS 0x400DF718 /end MEASUREMENT
/begin MEASUREMENT MCore_rb_SipF_ProcessImage.Cat50[22].snapshotReserved "" UBYTE NO_COMPU_METHOD 0 0 0 63 BIT_MASK 0xfc ECU_ADDRESS 0x400DF718 /end MEASUREMENT
/begin MEASUREMENT MCore_rb_SipF_ProcessImage.Cat50[22].snapshotSbmValue "" UBYTE NO_COMPU_METHOD 0 0 0 1 BIT_MASK 0x2 ECU_ADDRESS 0x400DF718 /end MEASUREMENT
/begin MEASUREMENT MCore_rb_SipF_ProcessImage.Cat50[22].switches "" UBYTE NO_COMPU_METHOD 0 0 0 255 ECU_ADDRESS 0x400DF728 /end MEASUREMENT
/begin MEASUREMENT MCore_rb_SipF_ProcessImage.Cat50[22].switches.mcalInputDisconnect "" SBYTE rb_SipF_ProcessImage.Cat50[22].switches.mcalInputDisconnect.CONVERSION 0 0 -128 127 ECU_ADDRESS 0x400DF728 /end MEASUREMENT
/begin MEASUREMENT MCore_rb_SipF_ProcessImage.Cat50[22].switches.sipfInputDisconnect "" SBYTE rb_SipF_ProcessImage.Cat50[22].switches.sipfInputDisconnect.CONVERSION 0 0 -128 127 ECU_ADDRESS 0x400DF729 /end MEASUREMENT
/begin MEASUREMENT MCore_rb_SipF_ProcessImage.Cat50[23].highRes "" UBYTE NO_COMPU_METHOD 0 0 0 255 ECU_ADDRESS 0x400DF734 /end MEASUREMENT
/begin MEASUREMENT MCore_rb_SipF_ProcessImage.Cat50[23].highRes.IrmsSq "" UWORD NO_COMPU_METHOD 0 0 0 65535 ECU_ADDRESS 0x400DF738 /end MEASUREMENT
/begin MEASUREMENT MCore_rb_SipF_ProcessImage.Cat50[23].highRes.IrmsSqFiltered "" UBYTE NO_COMPU_METHOD 0 0 0 255 ECU_ADDRESS 0x400DF734 /end MEASUREMENT
/begin MEASUREMENT MCore_rb_SipF_ProcessImage.Cat50[23].highRes.IrmsSqFiltered.B "" UBYTE NO_COMPU_METHOD 0 0 0 255 ECU_ADDRESS 0x400DF734 /end MEASUREMENT
/begin MEASUREMENT MCore_rb_SipF_ProcessImage.Cat50[23].highRes.IrmsSqFiltered.B.high_16 "" UWORD NO_COMPU_METHOD 0 0 0 65535 ECU_ADDRESS 0x400DF734 /end MEASUREMENT
/begin MEASUREMENT MCore_rb_SipF_ProcessImage.Cat50[23].highRes.IrmsSqFiltered.B.low_16 "" UWORD NO_COMPU_METHOD 0 0 0 65535 ECU_ADDRESS 0x400DF736 /end MEASUREMENT
/begin MEASUREMENT MCore_rb_SipF_ProcessImage.Cat50[23].highRes.IrmsSqFiltered.data_32 "" ULONG NO_COMPU_METHOD 0 0 0 4294967295 ECU_ADDRESS 0x400DF734 /end MEASUREMENT
/begin MEASUREMENT MCore_rb_SipF_ProcessImage.Cat50[23].processed "" UWORD NO_COMPU_METHOD 0 0 0 65535 ECU_ADDRESS 0x400DF73C /end MEASUREMENT
/begin MEASUREMENT MCore_rb_SipF_ProcessImage.Cat50[23].snapshot "" UWORD NO_COMPU_METHOD 0 0 0 65535 ECU_ADDRESS 0x400DF72C /end MEASUREMENT
/begin MEASUREMENT MCore_rb_SipF_ProcessImage.Cat50[23].snapshotDuty "" UWORD NO_COMPU_METHOD 0 0 0 65535 ECU_ADDRESS 0x400DF72E /end MEASUREMENT
/begin MEASUREMENT MCore_rb_SipF_ProcessImage.Cat50[23].snapshotErrorValue "" UBYTE NO_COMPU_METHOD 0 0 0 1 BIT_MASK 0x1 ECU_ADDRESS 0x400DF730 /end MEASUREMENT
/begin MEASUREMENT MCore_rb_SipF_ProcessImage.Cat50[23].snapshotPeriod "" UWORD NO_COMPU_METHOD 0 0 0 65535 ECU_ADDRESS 0x400DF730 /end MEASUREMENT
/begin MEASUREMENT MCore_rb_SipF_ProcessImage.Cat50[23].snapshotReserved "" UBYTE NO_COMPU_METHOD 0 0 0 63 BIT_MASK 0xfc ECU_ADDRESS 0x400DF730 /end MEASUREMENT
/begin MEASUREMENT MCore_rb_SipF_ProcessImage.Cat50[23].snapshotSbmValue "" UBYTE NO_COMPU_METHOD 0 0 0 1 BIT_MASK 0x2 ECU_ADDRESS 0x400DF730 /end MEASUREMENT
/begin MEASUREMENT MCore_rb_SipF_ProcessImage.Cat50[23].switches "" UBYTE NO_COMPU_METHOD 0 0 0 255 ECU_ADDRESS 0x400DF740 /end MEASUREMENT
/begin MEASUREMENT MCore_rb_SipF_ProcessImage.Cat50[23].switches.mcalInputDisconnect "" SBYTE rb_SipF_ProcessImage.Cat50[23].switches.mcalInputDisconnect.CONVERSION 0 0 -128 127 ECU_ADDRESS 0x400DF740 /end MEASUREMENT
/begin MEASUREMENT MCore_rb_SipF_ProcessImage.Cat50[23].switches.sipfInputDisconnect "" SBYTE rb_SipF_ProcessImage.Cat50[23].switches.sipfInputDisconnect.CONVERSION 0 0 -128 127 ECU_ADDRESS 0x400DF741 /end MEASUREMENT
/begin MEASUREMENT MCore_rb_SipF_ProcessImage.Cat50[24].highRes "" UBYTE NO_COMPU_METHOD 0 0 0 255 ECU_ADDRESS 0x400DF74C /end MEASUREMENT
/begin MEASUREMENT MCore_rb_SipF_ProcessImage.Cat50[24].highRes.IrmsSq "" UWORD NO_COMPU_METHOD 0 0 0 65535 ECU_ADDRESS 0x400DF750 /end MEASUREMENT
/begin MEASUREMENT MCore_rb_SipF_ProcessImage.Cat50[24].highRes.IrmsSqFiltered "" UBYTE NO_COMPU_METHOD 0 0 0 255 ECU_ADDRESS 0x400DF74C /end MEASUREMENT
/begin MEASUREMENT MCore_rb_SipF_ProcessImage.Cat50[24].highRes.IrmsSqFiltered.B "" UBYTE NO_COMPU_METHOD 0 0 0 255 ECU_ADDRESS 0x400DF74C /end MEASUREMENT
/begin MEASUREMENT MCore_rb_SipF_ProcessImage.Cat50[24].highRes.IrmsSqFiltered.B.high_16 "" UWORD NO_COMPU_METHOD 0 0 0 65535 ECU_ADDRESS 0x400DF74C /end MEASUREMENT
/begin MEASUREMENT MCore_rb_SipF_ProcessImage.Cat50[24].highRes.IrmsSqFiltered.B.low_16 "" UWORD NO_COMPU_METHOD 0 0 0 65535 ECU_ADDRESS 0x400DF74E /end MEASUREMENT
/begin MEASUREMENT MCore_rb_SipF_ProcessImage.Cat50[24].highRes.IrmsSqFiltered.data_32 "" ULONG NO_COMPU_METHOD 0 0 0 4294967295 ECU_ADDRESS 0x400DF74C /end MEASUREMENT
/begin MEASUREMENT MCore_rb_SipF_ProcessImage.Cat50[24].processed "" UWORD NO_COMPU_METHOD 0 0 0 65535 ECU_ADDRESS 0x400DF754 /end MEASUREMENT
/begin MEASUREMENT MCore_rb_SipF_ProcessImage.Cat50[24].snapshot "" UWORD NO_COMPU_METHOD 0 0 0 65535 ECU_ADDRESS 0x400DF744 /end MEASUREMENT
/begin MEASUREMENT MCore_rb_SipF_ProcessImage.Cat50[24].snapshotDuty "" UWORD NO_COMPU_METHOD 0 0 0 65535 ECU_ADDRESS 0x400DF746 /end MEASUREMENT
/begin MEASUREMENT MCore_rb_SipF_ProcessImage.Cat50[24].snapshotErrorValue "" UBYTE NO_COMPU_METHOD 0 0 0 1 BIT_MASK 0x1 ECU_ADDRESS 0x400DF748 /end MEASUREMENT
/begin MEASUREMENT MCore_rb_SipF_ProcessImage.Cat50[24].snapshotPeriod "" UWORD NO_COMPU_METHOD 0 0 0 65535 ECU_ADDRESS 0x400DF748 /end MEASUREMENT
/begin MEASUREMENT MCore_rb_SipF_ProcessImage.Cat50[24].snapshotReserved "" UBYTE NO_COMPU_METHOD 0 0 0 63 BIT_MASK 0xfc ECU_ADDRESS 0x400DF748 /end MEASUREMENT
/begin MEASUREMENT MCore_rb_SipF_ProcessImage.Cat50[24].snapshotSbmValue "" UBYTE NO_COMPU_METHOD 0 0 0 1 BIT_MASK 0x2 ECU_ADDRESS 0x400DF748 /end MEASUREMENT
/begin MEASUREMENT MCore_rb_SipF_ProcessImage.Cat50[24].switches "" UBYTE NO_COMPU_METHOD 0 0 0 255 ECU_ADDRESS 0x400DF758 /end MEASUREMENT
/begin MEASUREMENT MCore_rb_SipF_ProcessImage.Cat50[24].switches.mcalInputDisconnect "" SBYTE rb_SipF_ProcessImage.Cat50[24].switches.mcalInputDisconnect.CONVERSION 0 0 -128 127 ECU_ADDRESS 0x400DF758 /end MEASUREMENT
/begin MEASUREMENT MCore_rb_SipF_ProcessImage.Cat50[24].switches.sipfInputDisconnect "" SBYTE rb_SipF_ProcessImage.Cat50[24].switches.sipfInputDisconnect.CONVERSION 0 0 -128 127 ECU_ADDRESS 0x400DF759 /end MEASUREMENT
/begin MEASUREMENT MCore_rb_SipF_ProcessImage.Cat50[25].highRes "" UBYTE NO_COMPU_METHOD 0 0 0 255 ECU_ADDRESS 0x400DF764 /end MEASUREMENT
/begin MEASUREMENT MCore_rb_SipF_ProcessImage.Cat50[25].highRes.IrmsSq "" UWORD NO_COMPU_METHOD 0 0 0 65535 ECU_ADDRESS 0x400DF768 /end MEASUREMENT
/begin MEASUREMENT MCore_rb_SipF_ProcessImage.Cat50[25].highRes.IrmsSqFiltered "" UBYTE NO_COMPU_METHOD 0 0 0 255 ECU_ADDRESS 0x400DF764 /end MEASUREMENT
/begin MEASUREMENT MCore_rb_SipF_ProcessImage.Cat50[25].highRes.IrmsSqFiltered.B "" UBYTE NO_COMPU_METHOD 0 0 0 255 ECU_ADDRESS 0x400DF764 /end MEASUREMENT
/begin MEASUREMENT MCore_rb_SipF_ProcessImage.Cat50[25].highRes.IrmsSqFiltered.B.high_16 "" UWORD NO_COMPU_METHOD 0 0 0 65535 ECU_ADDRESS 0x400DF764 /end MEASUREMENT
/begin MEASUREMENT MCore_rb_SipF_ProcessImage.Cat50[25].highRes.IrmsSqFiltered.B.low_16 "" UWORD NO_COMPU_METHOD 0 0 0 65535 ECU_ADDRESS 0x400DF766 /end MEASUREMENT
/begin MEASUREMENT MCore_rb_SipF_ProcessImage.Cat50[25].highRes.IrmsSqFiltered.data_32 "" ULONG NO_COMPU_METHOD 0 0 0 4294967295 ECU_ADDRESS 0x400DF764 /end MEASUREMENT
/begin MEASUREMENT MCore_rb_SipF_ProcessImage.Cat50[25].processed "" UWORD NO_COMPU_METHOD 0 0 0 65535 ECU_ADDRESS 0x400DF76C /end MEASUREMENT
/begin MEASUREMENT MCore_rb_SipF_ProcessImage.Cat50[25].snapshot "" UWORD NO_COMPU_METHOD 0 0 0 65535 ECU_ADDRESS 0x400DF75C /end MEASUREMENT
/begin MEASUREMENT MCore_rb_SipF_ProcessImage.Cat50[25].snapshotDuty "" UWORD NO_COMPU_METHOD 0 0 0 65535 ECU_ADDRESS 0x400DF75E /end MEASUREMENT
/begin MEASUREMENT MCore_rb_SipF_ProcessImage.Cat50[25].snapshotErrorValue "" UBYTE NO_COMPU_METHOD 0 0 0 1 BIT_MASK 0x1 ECU_ADDRESS 0x400DF760 /end MEASUREMENT
/begin MEASUREMENT MCore_rb_SipF_ProcessImage.Cat50[25].snapshotPeriod "" UWORD NO_COMPU_METHOD 0 0 0 65535 ECU_ADDRESS 0x400DF760 /end MEASUREMENT
/begin MEASUREMENT MCore_rb_SipF_ProcessImage.Cat50[25].snapshotReserved "" UBYTE NO_COMPU_METHOD 0 0 0 63 BIT_MASK 0xfc ECU_ADDRESS 0x400DF760 /end MEASUREMENT
/begin MEASUREMENT MCore_rb_SipF_ProcessImage.Cat50[25].snapshotSbmValue "" UBYTE NO_COMPU_METHOD 0 0 0 1 BIT_MASK 0x2 ECU_ADDRESS 0x400DF760 /end MEASUREMENT
/begin MEASUREMENT MCore_rb_SipF_ProcessImage.Cat50[25].switches "" UBYTE NO_COMPU_METHOD 0 0 0 255 ECU_ADDRESS 0x400DF770 /end MEASUREMENT
/begin MEASUREMENT MCore_rb_SipF_ProcessImage.Cat50[25].switches.mcalInputDisconnect "" SBYTE rb_SipF_ProcessImage.Cat50[25].switches.mcalInputDisconnect.CONVERSION 0 0 -128 127 ECU_ADDRESS 0x400DF770 /end MEASUREMENT
/begin MEASUREMENT MCore_rb_SipF_ProcessImage.Cat50[25].switches.sipfInputDisconnect "" SBYTE rb_SipF_ProcessImage.Cat50[25].switches.sipfInputDisconnect.CONVERSION 0 0 -128 127 ECU_ADDRESS 0x400DF771 /end MEASUREMENT
/begin MEASUREMENT MCore_rb_SipF_ProcessImage.Cat50[26].highRes "" UBYTE NO_COMPU_METHOD 0 0 0 255 ECU_ADDRESS 0x400DF77C /end MEASUREMENT
/begin MEASUREMENT MCore_rb_SipF_ProcessImage.Cat50[26].highRes.IrmsSq "" UWORD NO_COMPU_METHOD 0 0 0 65535 ECU_ADDRESS 0x400DF780 /end MEASUREMENT
/begin MEASUREMENT MCore_rb_SipF_ProcessImage.Cat50[26].highRes.IrmsSqFiltered "" UBYTE NO_COMPU_METHOD 0 0 0 255 ECU_ADDRESS 0x400DF77C /end MEASUREMENT
/begin MEASUREMENT MCore_rb_SipF_ProcessImage.Cat50[26].highRes.IrmsSqFiltered.B "" UBYTE NO_COMPU_METHOD 0 0 0 255 ECU_ADDRESS 0x400DF77C /end MEASUREMENT
/begin MEASUREMENT MCore_rb_SipF_ProcessImage.Cat50[26].highRes.IrmsSqFiltered.B.high_16 "" UWORD NO_COMPU_METHOD 0 0 0 65535 ECU_ADDRESS 0x400DF77C /end MEASUREMENT
/begin MEASUREMENT MCore_rb_SipF_ProcessImage.Cat50[26].highRes.IrmsSqFiltered.B.low_16 "" UWORD NO_COMPU_METHOD 0 0 0 65535 ECU_ADDRESS 0x400DF77E /end MEASUREMENT
/begin MEASUREMENT MCore_rb_SipF_ProcessImage.Cat50[26].highRes.IrmsSqFiltered.data_32 "" ULONG NO_COMPU_METHOD 0 0 0 4294967295 ECU_ADDRESS 0x400DF77C /end MEASUREMENT
/begin MEASUREMENT MCore_rb_SipF_ProcessImage.Cat50[26].processed "" UWORD NO_COMPU_METHOD 0 0 0 65535 ECU_ADDRESS 0x400DF784 /end MEASUREMENT
/begin MEASUREMENT MCore_rb_SipF_ProcessImage.Cat50[26].snapshot "" UWORD NO_COMPU_METHOD 0 0 0 65535 ECU_ADDRESS 0x400DF774 /end MEASUREMENT
/begin MEASUREMENT MCore_rb_SipF_ProcessImage.Cat50[26].snapshotDuty "" UWORD NO_COMPU_METHOD 0 0 0 65535 ECU_ADDRESS 0x400DF776 /end MEASUREMENT
/begin MEASUREMENT MCore_rb_SipF_ProcessImage.Cat50[26].snapshotErrorValue "" UBYTE NO_COMPU_METHOD 0 0 0 1 BIT_MASK 0x1 ECU_ADDRESS 0x400DF778 /end MEASUREMENT
/begin MEASUREMENT MCore_rb_SipF_ProcessImage.Cat50[26].snapshotPeriod "" UWORD NO_COMPU_METHOD 0 0 0 65535 ECU_ADDRESS 0x400DF778 /end MEASUREMENT
/begin MEASUREMENT MCore_rb_SipF_ProcessImage.Cat50[26].snapshotReserved "" UBYTE NO_COMPU_METHOD 0 0 0 63 BIT_MASK 0xfc ECU_ADDRESS 0x400DF778 /end MEASUREMENT
/begin MEASUREMENT MCore_rb_SipF_ProcessImage.Cat50[26].snapshotSbmValue "" UBYTE NO_COMPU_METHOD 0 0 0 1 BIT_MASK 0x2 ECU_ADDRESS 0x400DF778 /end MEASUREMENT
/begin MEASUREMENT MCore_rb_SipF_ProcessImage.Cat50[26].switches "" UBYTE NO_COMPU_METHOD 0 0 0 255 ECU_ADDRESS 0x400DF788 /end MEASUREMENT
/begin MEASUREMENT MCore_rb_SipF_ProcessImage.Cat50[26].switches.mcalInputDisconnect "" SBYTE rb_SipF_ProcessImage.Cat50[26].switches.mcalInputDisconnect.CONVERSION 0 0 -128 127 ECU_ADDRESS 0x400DF788 /end MEASUREMENT
/begin MEASUREMENT MCore_rb_SipF_ProcessImage.Cat50[26].switches.sipfInputDisconnect "" SBYTE rb_SipF_ProcessImage.Cat50[26].switches.sipfInputDisconnect.CONVERSION 0 0 -128 127 ECU_ADDRESS 0x400DF789 /end MEASUREMENT
/begin MEASUREMENT MCore_rb_SipF_ProcessImage.Cat50[27].highRes "" UBYTE NO_COMPU_METHOD 0 0 0 255 ECU_ADDRESS 0x400DF794 /end MEASUREMENT
/begin MEASUREMENT MCore_rb_SipF_ProcessImage.Cat50[27].highRes.IrmsSq "" UWORD NO_COMPU_METHOD 0 0 0 65535 ECU_ADDRESS 0x400DF798 /end MEASUREMENT
/begin MEASUREMENT MCore_rb_SipF_ProcessImage.Cat50[27].highRes.IrmsSqFiltered "" UBYTE NO_COMPU_METHOD 0 0 0 255 ECU_ADDRESS 0x400DF794 /end MEASUREMENT
/begin MEASUREMENT MCore_rb_SipF_ProcessImage.Cat50[27].highRes.IrmsSqFiltered.B "" UBYTE NO_COMPU_METHOD 0 0 0 255 ECU_ADDRESS 0x400DF794 /end MEASUREMENT
/begin MEASUREMENT MCore_rb_SipF_ProcessImage.Cat50[27].highRes.IrmsSqFiltered.B.high_16 "" UWORD NO_COMPU_METHOD 0 0 0 65535 ECU_ADDRESS 0x400DF794 /end MEASUREMENT
/begin MEASUREMENT MCore_rb_SipF_ProcessImage.Cat50[27].highRes.IrmsSqFiltered.B.low_16 "" UWORD NO_COMPU_METHOD 0 0 0 65535 ECU_ADDRESS 0x400DF796 /end MEASUREMENT
/begin MEASUREMENT MCore_rb_SipF_ProcessImage.Cat50[27].highRes.IrmsSqFiltered.data_32 "" ULONG NO_COMPU_METHOD 0 0 0 4294967295 ECU_ADDRESS 0x400DF794 /end MEASUREMENT
/begin MEASUREMENT MCore_rb_SipF_ProcessImage.Cat50[27].processed "" UWORD NO_COMPU_METHOD 0 0 0 65535 ECU_ADDRESS 0x400DF79C /end MEASUREMENT
/begin MEASUREMENT MCore_rb_SipF_ProcessImage.Cat50[27].snapshot "" UWORD NO_COMPU_METHOD 0 0 0 65535 ECU_ADDRESS 0x400DF78C /end MEASUREMENT
/begin MEASUREMENT MCore_rb_SipF_ProcessImage.Cat50[27].snapshotDuty "" UWORD NO_COMPU_METHOD 0 0 0 65535 ECU_ADDRESS 0x400DF78E /end MEASUREMENT
/begin MEASUREMENT MCore_rb_SipF_ProcessImage.Cat50[27].snapshotErrorValue "" UBYTE NO_COMPU_METHOD 0 0 0 1 BIT_MASK 0x1 ECU_ADDRESS 0x400DF790 /end MEASUREMENT
/begin MEASUREMENT MCore_rb_SipF_ProcessImage.Cat50[27].snapshotPeriod "" UWORD NO_COMPU_METHOD 0 0 0 65535 ECU_ADDRESS 0x400DF790 /end MEASUREMENT
/begin MEASUREMENT MCore_rb_SipF_ProcessImage.Cat50[27].snapshotReserved "" UBYTE NO_COMPU_METHOD 0 0 0 63 BIT_MASK 0xfc ECU_ADDRESS 0x400DF790 /end MEASUREMENT
/begin MEASUREMENT MCore_rb_SipF_ProcessImage.Cat50[27].snapshotSbmValue "" UBYTE NO_COMPU_METHOD 0 0 0 1 BIT_MASK 0x2 ECU_ADDRESS 0x400DF790 /end MEASUREMENT
/begin MEASUREMENT MCore_rb_SipF_ProcessImage.Cat50[27].switches "" UBYTE NO_COMPU_METHOD 0 0 0 255 ECU_ADDRESS 0x400DF7A0 /end MEASUREMENT
/begin MEASUREMENT MCore_rb_SipF_ProcessImage.Cat50[27].switches.mcalInputDisconnect "" SBYTE rb_SipF_ProcessImage.Cat50[27].switches.mcalInputDisconnect.CONVERSION 0 0 -128 127 ECU_ADDRESS 0x400DF7A0 /end MEASUREMENT
/begin MEASUREMENT MCore_rb_SipF_ProcessImage.Cat50[27].switches.sipfInputDisconnect "" SBYTE rb_SipF_ProcessImage.Cat50[27].switches.sipfInputDisconnect.CONVERSION 0 0 -128 127 ECU_ADDRESS 0x400DF7A1 /end MEASUREMENT
/begin MEASUREMENT MCore_rb_SipF_ProcessImage.Cat50[28].highRes "" UBYTE NO_COMPU_METHOD 0 0 0 255 ECU_ADDRESS 0x400DF7AC /end MEASUREMENT
/begin MEASUREMENT MCore_rb_SipF_ProcessImage.Cat50[28].highRes.IrmsSq "" UWORD NO_COMPU_METHOD 0 0 0 65535 ECU_ADDRESS 0x400DF7B0 /end MEASUREMENT
/begin MEASUREMENT MCore_rb_SipF_ProcessImage.Cat50[28].highRes.IrmsSqFiltered "" UBYTE NO_COMPU_METHOD 0 0 0 255 ECU_ADDRESS 0x400DF7AC /end MEASUREMENT
/begin MEASUREMENT MCore_rb_SipF_ProcessImage.Cat50[28].highRes.IrmsSqFiltered.B "" UBYTE NO_COMPU_METHOD 0 0 0 255 ECU_ADDRESS 0x400DF7AC /end MEASUREMENT
/begin MEASUREMENT MCore_rb_SipF_ProcessImage.Cat50[28].highRes.IrmsSqFiltered.B.high_16 "" UWORD NO_COMPU_METHOD 0 0 0 65535 ECU_ADDRESS 0x400DF7AC /end MEASUREMENT
/begin MEASUREMENT MCore_rb_SipF_ProcessImage.Cat50[28].highRes.IrmsSqFiltered.B.low_16 "" UWORD NO_COMPU_METHOD 0 0 0 65535 ECU_ADDRESS 0x400DF7AE /end MEASUREMENT
/begin MEASUREMENT MCore_rb_SipF_ProcessImage.Cat50[28].highRes.IrmsSqFiltered.data_32 "" ULONG NO_COMPU_METHOD 0 0 0 4294967295 ECU_ADDRESS 0x400DF7AC /end MEASUREMENT
/begin MEASUREMENT MCore_rb_SipF_ProcessImage.Cat50[28].processed "" UWORD NO_COMPU_METHOD 0 0 0 65535 ECU_ADDRESS 0x400DF7B4 /end MEASUREMENT
/begin MEASUREMENT MCore_rb_SipF_ProcessImage.Cat50[28].snapshot "" UWORD NO_COMPU_METHOD 0 0 0 65535 ECU_ADDRESS 0x400DF7A4 /end MEASUREMENT
/begin MEASUREMENT MCore_rb_SipF_ProcessImage.Cat50[28].snapshotDuty "" UWORD NO_COMPU_METHOD 0 0 0 65535 ECU_ADDRESS 0x400DF7A6 /end MEASUREMENT
/begin MEASUREMENT MCore_rb_SipF_ProcessImage.Cat50[28].snapshotErrorValue "" UBYTE NO_COMPU_METHOD 0 0 0 1 BIT_MASK 0x1 ECU_ADDRESS 0x400DF7A8 /end MEASUREMENT
/begin MEASUREMENT MCore_rb_SipF_ProcessImage.Cat50[28].snapshotPeriod "" UWORD NO_COMPU_METHOD 0 0 0 65535 ECU_ADDRESS 0x400DF7A8 /end MEASUREMENT
/begin MEASUREMENT MCore_rb_SipF_ProcessImage.Cat50[28].snapshotReserved "" UBYTE NO_COMPU_METHOD 0 0 0 63 BIT_MASK 0xfc ECU_ADDRESS 0x400DF7A8 /end MEASUREMENT
/begin MEASUREMENT MCore_rb_SipF_ProcessImage.Cat50[28].snapshotSbmValue "" UBYTE NO_COMPU_METHOD 0 0 0 1 BIT_MASK 0x2 ECU_ADDRESS 0x400DF7A8 /end MEASUREMENT
/begin MEASUREMENT MCore_rb_SipF_ProcessImage.Cat50[28].switches "" UBYTE NO_COMPU_METHOD 0 0 0 255 ECU_ADDRESS 0x400DF7B8 /end MEASUREMENT
/begin MEASUREMENT MCore_rb_SipF_ProcessImage.Cat50[28].switches.mcalInputDisconnect "" SBYTE rb_SipF_ProcessImage.Cat50[28].switches.mcalInputDisconnect.CONVERSION 0 0 -128 127 ECU_ADDRESS 0x400DF7B8 /end MEASUREMENT
/begin MEASUREMENT MCore_rb_SipF_ProcessImage.Cat50[28].switches.sipfInputDisconnect "" SBYTE rb_SipF_ProcessImage.Cat50[28].switches.sipfInputDisconnect.CONVERSION 0 0 -128 127 ECU_ADDRESS 0x400DF7B9 /end MEASUREMENT
/begin MEASUREMENT MCore_rb_SipF_ProcessImage.Cat50[29].highRes "" UBYTE NO_COMPU_METHOD 0 0 0 255 ECU_ADDRESS 0x400DF7C4 /end MEASUREMENT
/begin MEASUREMENT MCore_rb_SipF_ProcessImage.Cat50[29].highRes.IrmsSq "" UWORD NO_COMPU_METHOD 0 0 0 65535 ECU_ADDRESS 0x400DF7C8 /end MEASUREMENT
/begin MEASUREMENT MCore_rb_SipF_ProcessImage.Cat50[29].highRes.IrmsSqFiltered "" UBYTE NO_COMPU_METHOD 0 0 0 255 ECU_ADDRESS 0x400DF7C4 /end MEASUREMENT
/begin MEASUREMENT MCore_rb_SipF_ProcessImage.Cat50[29].highRes.IrmsSqFiltered.B "" UBYTE NO_COMPU_METHOD 0 0 0 255 ECU_ADDRESS 0x400DF7C4 /end MEASUREMENT
/begin MEASUREMENT MCore_rb_SipF_ProcessImage.Cat50[29].highRes.IrmsSqFiltered.B.high_16 "" UWORD NO_COMPU_METHOD 0 0 0 65535 ECU_ADDRESS 0x400DF7C4 /end MEASUREMENT
/begin MEASUREMENT MCore_rb_SipF_ProcessImage.Cat50[29].highRes.IrmsSqFiltered.B.low_16 "" UWORD NO_COMPU_METHOD 0 0 0 65535 ECU_ADDRESS 0x400DF7C6 /end MEASUREMENT
/begin MEASUREMENT MCore_rb_SipF_ProcessImage.Cat50[29].highRes.IrmsSqFiltered.data_32 "" ULONG NO_COMPU_METHOD 0 0 0 4294967295 ECU_ADDRESS 0x400DF7C4 /end MEASUREMENT
/begin MEASUREMENT MCore_rb_SipF_ProcessImage.Cat50[29].processed "" UWORD NO_COMPU_METHOD 0 0 0 65535 ECU_ADDRESS 0x400DF7CC /end MEASUREMENT
/begin MEASUREMENT MCore_rb_SipF_ProcessImage.Cat50[29].snapshot "" UWORD NO_COMPU_METHOD 0 0 0 65535 ECU_ADDRESS 0x400DF7BC /end MEASUREMENT
/begin MEASUREMENT MCore_rb_SipF_ProcessImage.Cat50[29].snapshotDuty "" UWORD NO_COMPU_METHOD 0 0 0 65535 ECU_ADDRESS 0x400DF7BE /end MEASUREMENT
/begin MEASUREMENT MCore_rb_SipF_ProcessImage.Cat50[29].snapshotErrorValue "" UBYTE NO_COMPU_METHOD 0 0 0 1 BIT_MASK 0x1 ECU_ADDRESS 0x400DF7C0 /end MEASUREMENT
/begin MEASUREMENT MCore_rb_SipF_ProcessImage.Cat50[29].snapshotPeriod "" UWORD NO_COMPU_METHOD 0 0 0 65535 ECU_ADDRESS 0x400DF7C0 /end MEASUREMENT
/begin MEASUREMENT MCore_rb_SipF_ProcessImage.Cat50[29].snapshotReserved "" UBYTE NO_COMPU_METHOD 0 0 0 63 BIT_MASK 0xfc ECU_ADDRESS 0x400DF7C0 /end MEASUREMENT
/begin MEASUREMENT MCore_rb_SipF_ProcessImage.Cat50[29].snapshotSbmValue "" UBYTE NO_COMPU_METHOD 0 0 0 1 BIT_MASK 0x2 ECU_ADDRESS 0x400DF7C0 /end MEASUREMENT
/begin MEASUREMENT MCore_rb_SipF_ProcessImage.Cat50[29].switches "" UBYTE NO_COMPU_METHOD 0 0 0 255 ECU_ADDRESS 0x400DF7D0 /end MEASUREMENT
/begin MEASUREMENT MCore_rb_SipF_ProcessImage.Cat50[29].switches.mcalInputDisconnect "" SBYTE rb_SipF_ProcessImage.Cat50[29].switches.mcalInputDisconnect.CONVERSION 0 0 -128 127 ECU_ADDRESS 0x400DF7D0 /end MEASUREMENT
/begin MEASUREMENT MCore_rb_SipF_ProcessImage.Cat50[29].switches.sipfInputDisconnect "" SBYTE rb_SipF_ProcessImage.Cat50[29].switches.sipfInputDisconnect.CONVERSION 0 0 -128 127 ECU_ADDRESS 0x400DF7D1 /end MEASUREMENT
/begin MEASUREMENT MCore_rb_SipF_ProcessImage.Cat50[2].highRes "" UBYTE NO_COMPU_METHOD 0 0 0 255 ECU_ADDRESS 0x400DF53C /end MEASUREMENT
/begin MEASUREMENT MCore_rb_SipF_ProcessImage.Cat50[2].highRes.IrmsSq "" UWORD NO_COMPU_METHOD 0 0 0 65535 ECU_ADDRESS 0x400DF540 /end MEASUREMENT
/begin MEASUREMENT MCore_rb_SipF_ProcessImage.Cat50[2].highRes.IrmsSqFiltered "" UBYTE NO_COMPU_METHOD 0 0 0 255 ECU_ADDRESS 0x400DF53C /end MEASUREMENT
/begin MEASUREMENT MCore_rb_SipF_ProcessImage.Cat50[2].highRes.IrmsSqFiltered.B "" UBYTE NO_COMPU_METHOD 0 0 0 255 ECU_ADDRESS 0x400DF53C /end MEASUREMENT
/begin MEASUREMENT MCore_rb_SipF_ProcessImage.Cat50[2].highRes.IrmsSqFiltered.B.high_16 "" UWORD NO_COMPU_METHOD 0 0 0 65535 ECU_ADDRESS 0x400DF53C /end MEASUREMENT
/begin MEASUREMENT MCore_rb_SipF_ProcessImage.Cat50[2].highRes.IrmsSqFiltered.B.low_16 "" UWORD NO_COMPU_METHOD 0 0 0 65535 ECU_ADDRESS 0x400DF53E /end MEASUREMENT
/begin MEASUREMENT MCore_rb_SipF_ProcessImage.Cat50[2].highRes.IrmsSqFiltered.data_32 "" ULONG NO_COMPU_METHOD 0 0 0 4294967295 ECU_ADDRESS 0x400DF53C /end MEASUREMENT
/begin MEASUREMENT MCore_rb_SipF_ProcessImage.Cat50[2].processed "" UWORD NO_COMPU_METHOD 0 0 0 65535 ECU_ADDRESS 0x400DF544 /end MEASUREMENT
/begin MEASUREMENT MCore_rb_SipF_ProcessImage.Cat50[2].snapshot "" UWORD NO_COMPU_METHOD 0 0 0 65535 ECU_ADDRESS 0x400DF534 /end MEASUREMENT
/begin MEASUREMENT MCore_rb_SipF_ProcessImage.Cat50[2].snapshotDuty "" UWORD NO_COMPU_METHOD 0 0 0 65535 ECU_ADDRESS 0x400DF536 /end MEASUREMENT
/begin MEASUREMENT MCore_rb_SipF_ProcessImage.Cat50[2].snapshotErrorValue "" UBYTE NO_COMPU_METHOD 0 0 0 1 BIT_MASK 0x1 ECU_ADDRESS 0x400DF538 /end MEASUREMENT
/begin MEASUREMENT MCore_rb_SipF_ProcessImage.Cat50[2].snapshotPeriod "" UWORD NO_COMPU_METHOD 0 0 0 65535 ECU_ADDRESS 0x400DF538 /end MEASUREMENT
/begin MEASUREMENT MCore_rb_SipF_ProcessImage.Cat50[2].snapshotReserved "" UBYTE NO_COMPU_METHOD 0 0 0 63 BIT_MASK 0xfc ECU_ADDRESS 0x400DF538 /end MEASUREMENT
/begin MEASUREMENT MCore_rb_SipF_ProcessImage.Cat50[2].snapshotSbmValue "" UBYTE NO_COMPU_METHOD 0 0 0 1 BIT_MASK 0x2 ECU_ADDRESS 0x400DF538 /end MEASUREMENT
/begin MEASUREMENT MCore_rb_SipF_ProcessImage.Cat50[2].switches "" UBYTE NO_COMPU_METHOD 0 0 0 255 ECU_ADDRESS 0x400DF548 /end MEASUREMENT
/begin MEASUREMENT MCore_rb_SipF_ProcessImage.Cat50[2].switches.mcalInputDisconnect "" SBYTE rb_SipF_ProcessImage.Cat50[2].switches.mcalInputDisconnect.CONVERSION 0 0 -128 127 ECU_ADDRESS 0x400DF548 /end MEASUREMENT
/begin MEASUREMENT MCore_rb_SipF_ProcessImage.Cat50[2].switches.sipfInputDisconnect "" SBYTE rb_SipF_ProcessImage.Cat50[2].switches.sipfInputDisconnect.CONVERSION 0 0 -128 127 ECU_ADDRESS 0x400DF549 /end MEASUREMENT
/begin MEASUREMENT MCore_rb_SipF_ProcessImage.Cat50[30].highRes "" UBYTE NO_COMPU_METHOD 0 0 0 255 ECU_ADDRESS 0x400DF7DC /end MEASUREMENT
/begin MEASUREMENT MCore_rb_SipF_ProcessImage.Cat50[30].highRes.IrmsSq "" UWORD NO_COMPU_METHOD 0 0 0 65535 ECU_ADDRESS 0x400DF7E0 /end MEASUREMENT
/begin MEASUREMENT MCore_rb_SipF_ProcessImage.Cat50[30].highRes.IrmsSqFiltered "" UBYTE NO_COMPU_METHOD 0 0 0 255 ECU_ADDRESS 0x400DF7DC /end MEASUREMENT
/begin MEASUREMENT MCore_rb_SipF_ProcessImage.Cat50[30].highRes.IrmsSqFiltered.B "" UBYTE NO_COMPU_METHOD 0 0 0 255 ECU_ADDRESS 0x400DF7DC /end MEASUREMENT
/begin MEASUREMENT MCore_rb_SipF_ProcessImage.Cat50[30].highRes.IrmsSqFiltered.B.high_16 "" UWORD NO_COMPU_METHOD 0 0 0 65535 ECU_ADDRESS 0x400DF7DC /end MEASUREMENT
/begin MEASUREMENT MCore_rb_SipF_ProcessImage.Cat50[30].highRes.IrmsSqFiltered.B.low_16 "" UWORD NO_COMPU_METHOD 0 0 0 65535 ECU_ADDRESS 0x400DF7DE /end MEASUREMENT
/begin MEASUREMENT MCore_rb_SipF_ProcessImage.Cat50[30].highRes.IrmsSqFiltered.data_32 "" ULONG NO_COMPU_METHOD 0 0 0 4294967295 ECU_ADDRESS 0x400DF7DC /end MEASUREMENT
/begin MEASUREMENT MCore_rb_SipF_ProcessImage.Cat50[30].processed "" UWORD NO_COMPU_METHOD 0 0 0 65535 ECU_ADDRESS 0x400DF7E4 /end MEASUREMENT
/begin MEASUREMENT MCore_rb_SipF_ProcessImage.Cat50[30].snapshot "" UWORD NO_COMPU_METHOD 0 0 0 65535 ECU_ADDRESS 0x400DF7D4 /end MEASUREMENT
/begin MEASUREMENT MCore_rb_SipF_ProcessImage.Cat50[30].snapshotDuty "" UWORD NO_COMPU_METHOD 0 0 0 65535 ECU_ADDRESS 0x400DF7D6 /end MEASUREMENT
/begin MEASUREMENT MCore_rb_SipF_ProcessImage.Cat50[30].snapshotErrorValue "" UBYTE NO_COMPU_METHOD 0 0 0 1 BIT_MASK 0x1 ECU_ADDRESS 0x400DF7D8 /end MEASUREMENT
/begin MEASUREMENT MCore_rb_SipF_ProcessImage.Cat50[30].snapshotPeriod "" UWORD NO_COMPU_METHOD 0 0 0 65535 ECU_ADDRESS 0x400DF7D8 /end MEASUREMENT
/begin MEASUREMENT MCore_rb_SipF_ProcessImage.Cat50[30].snapshotReserved "" UBYTE NO_COMPU_METHOD 0 0 0 63 BIT_MASK 0xfc ECU_ADDRESS 0x400DF7D8 /end MEASUREMENT
/begin MEASUREMENT MCore_rb_SipF_ProcessImage.Cat50[30].snapshotSbmValue "" UBYTE NO_COMPU_METHOD 0 0 0 1 BIT_MASK 0x2 ECU_ADDRESS 0x400DF7D8 /end MEASUREMENT
/begin MEASUREMENT MCore_rb_SipF_ProcessImage.Cat50[30].switches "" UBYTE NO_COMPU_METHOD 0 0 0 255 ECU_ADDRESS 0x400DF7E8 /end MEASUREMENT
/begin MEASUREMENT MCore_rb_SipF_ProcessImage.Cat50[30].switches.mcalInputDisconnect "" SBYTE rb_SipF_ProcessImage.Cat50[30].switches.mcalInputDisconnect.CONVERSION 0 0 -128 127 ECU_ADDRESS 0x400DF7E8 /end MEASUREMENT
/begin MEASUREMENT MCore_rb_SipF_ProcessImage.Cat50[30].switches.sipfInputDisconnect "" SBYTE rb_SipF_ProcessImage.Cat50[30].switches.sipfInputDisconnect.CONVERSION 0 0 -128 127 ECU_ADDRESS 0x400DF7E9 /end MEASUREMENT
/begin MEASUREMENT MCore_rb_SipF_ProcessImage.Cat50[31].highRes "" UBYTE NO_COMPU_METHOD 0 0 0 255 ECU_ADDRESS 0x400DF7F4 /end MEASUREMENT
/begin MEASUREMENT MCore_rb_SipF_ProcessImage.Cat50[31].highRes.IrmsSq "" UWORD NO_COMPU_METHOD 0 0 0 65535 ECU_ADDRESS 0x400DF7F8 /end MEASUREMENT
/begin MEASUREMENT MCore_rb_SipF_ProcessImage.Cat50[31].highRes.IrmsSqFiltered "" UBYTE NO_COMPU_METHOD 0 0 0 255 ECU_ADDRESS 0x400DF7F4 /end MEASUREMENT
/begin MEASUREMENT MCore_rb_SipF_ProcessImage.Cat50[31].highRes.IrmsSqFiltered.B "" UBYTE NO_COMPU_METHOD 0 0 0 255 ECU_ADDRESS 0x400DF7F4 /end MEASUREMENT
/begin MEASUREMENT MCore_rb_SipF_ProcessImage.Cat50[31].highRes.IrmsSqFiltered.B.high_16 "" UWORD NO_COMPU_METHOD 0 0 0 65535 ECU_ADDRESS 0x400DF7F4 /end MEASUREMENT
/begin MEASUREMENT MCore_rb_SipF_ProcessImage.Cat50[31].highRes.IrmsSqFiltered.B.low_16 "" UWORD NO_COMPU_METHOD 0 0 0 65535 ECU_ADDRESS 0x400DF7F6 /end MEASUREMENT
/begin MEASUREMENT MCore_rb_SipF_ProcessImage.Cat50[31].highRes.IrmsSqFiltered.data_32 "" ULONG NO_COMPU_METHOD 0 0 0 4294967295 ECU_ADDRESS 0x400DF7F4 /end MEASUREMENT
/begin MEASUREMENT MCore_rb_SipF_ProcessImage.Cat50[31].processed "" UWORD NO_COMPU_METHOD 0 0 0 65535 ECU_ADDRESS 0x400DF7FC /end MEASUREMENT
/begin MEASUREMENT MCore_rb_SipF_ProcessImage.Cat50[31].snapshot "" UWORD NO_COMPU_METHOD 0 0 0 65535 ECU_ADDRESS 0x400DF7EC /end MEASUREMENT
/begin MEASUREMENT MCore_rb_SipF_ProcessImage.Cat50[31].snapshotDuty "" UWORD NO_COMPU_METHOD 0 0 0 65535 ECU_ADDRESS 0x400DF7EE /end MEASUREMENT
/begin MEASUREMENT MCore_rb_SipF_ProcessImage.Cat50[31].snapshotErrorValue "" UBYTE NO_COMPU_METHOD 0 0 0 1 BIT_MASK 0x1 ECU_ADDRESS 0x400DF7F0 /end MEASUREMENT
/begin MEASUREMENT MCore_rb_SipF_ProcessImage.Cat50[31].snapshotPeriod "" UWORD NO_COMPU_METHOD 0 0 0 65535 ECU_ADDRESS 0x400DF7F0 /end MEASUREMENT
/begin MEASUREMENT MCore_rb_SipF_ProcessImage.Cat50[31].snapshotReserved "" UBYTE NO_COMPU_METHOD 0 0 0 63 BIT_MASK 0xfc ECU_ADDRESS 0x400DF7F0 /end MEASUREMENT
/begin MEASUREMENT MCore_rb_SipF_ProcessImage.Cat50[31].snapshotSbmValue "" UBYTE NO_COMPU_METHOD 0 0 0 1 BIT_MASK 0x2 ECU_ADDRESS 0x400DF7F0 /end MEASUREMENT
/begin MEASUREMENT MCore_rb_SipF_ProcessImage.Cat50[31].switches "" UBYTE NO_COMPU_METHOD 0 0 0 255 ECU_ADDRESS 0x400DF800 /end MEASUREMENT
/begin MEASUREMENT MCore_rb_SipF_ProcessImage.Cat50[31].switches.mcalInputDisconnect "" SBYTE rb_SipF_ProcessImage.Cat50[31].switches.mcalInputDisconnect.CONVERSION 0 0 -128 127 ECU_ADDRESS 0x400DF800 /end MEASUREMENT
/begin MEASUREMENT MCore_rb_SipF_ProcessImage.Cat50[31].switches.sipfInputDisconnect "" SBYTE rb_SipF_ProcessImage.Cat50[31].switches.sipfInputDisconnect.CONVERSION 0 0 -128 127 ECU_ADDRESS 0x400DF801 /end MEASUREMENT
/begin MEASUREMENT MCore_rb_SipF_ProcessImage.Cat50[32].highRes "" UBYTE NO_COMPU_METHOD 0 0 0 255 ECU_ADDRESS 0x400DF80C /end MEASUREMENT
/begin MEASUREMENT MCore_rb_SipF_ProcessImage.Cat50[32].highRes.IrmsSq "" UWORD NO_COMPU_METHOD 0 0 0 65535 ECU_ADDRESS 0x400DF810 /end MEASUREMENT
/begin MEASUREMENT MCore_rb_SipF_ProcessImage.Cat50[32].highRes.IrmsSqFiltered "" UBYTE NO_COMPU_METHOD 0 0 0 255 ECU_ADDRESS 0x400DF80C /end MEASUREMENT
/begin MEASUREMENT MCore_rb_SipF_ProcessImage.Cat50[32].highRes.IrmsSqFiltered.B "" UBYTE NO_COMPU_METHOD 0 0 0 255 ECU_ADDRESS 0x400DF80C /end MEASUREMENT
/begin MEASUREMENT MCore_rb_SipF_ProcessImage.Cat50[32].highRes.IrmsSqFiltered.B.high_16 "" UWORD NO_COMPU_METHOD 0 0 0 65535 ECU_ADDRESS 0x400DF80C /end MEASUREMENT
/begin MEASUREMENT MCore_rb_SipF_ProcessImage.Cat50[32].highRes.IrmsSqFiltered.B.low_16 "" UWORD NO_COMPU_METHOD 0 0 0 65535 ECU_ADDRESS 0x400DF80E /end MEASUREMENT
/begin MEASUREMENT MCore_rb_SipF_ProcessImage.Cat50[32].highRes.IrmsSqFiltered.data_32 "" ULONG NO_COMPU_METHOD 0 0 0 4294967295 ECU_ADDRESS 0x400DF80C /end MEASUREMENT
/begin MEASUREMENT MCore_rb_SipF_ProcessImage.Cat50[32].processed "" UWORD NO_COMPU_METHOD 0 0 0 65535 ECU_ADDRESS 0x400DF814 /end MEASUREMENT
/begin MEASUREMENT MCore_rb_SipF_ProcessImage.Cat50[32].snapshot "" UWORD NO_COMPU_METHOD 0 0 0 65535 ECU_ADDRESS 0x400DF804 /end MEASUREMENT
/begin MEASUREMENT MCore_rb_SipF_ProcessImage.Cat50[32].snapshotDuty "" UWORD NO_COMPU_METHOD 0 0 0 65535 ECU_ADDRESS 0x400DF806 /end MEASUREMENT
/begin MEASUREMENT MCore_rb_SipF_ProcessImage.Cat50[32].snapshotErrorValue "" UBYTE NO_COMPU_METHOD 0 0 0 1 BIT_MASK 0x1 ECU_ADDRESS 0x400DF808 /end MEASUREMENT
/begin MEASUREMENT MCore_rb_SipF_ProcessImage.Cat50[32].snapshotPeriod "" UWORD NO_COMPU_METHOD 0 0 0 65535 ECU_ADDRESS 0x400DF808 /end MEASUREMENT
/begin MEASUREMENT MCore_rb_SipF_ProcessImage.Cat50[32].snapshotReserved "" UBYTE NO_COMPU_METHOD 0 0 0 63 BIT_MASK 0xfc ECU_ADDRESS 0x400DF808 /end MEASUREMENT
/begin MEASUREMENT MCore_rb_SipF_ProcessImage.Cat50[32].snapshotSbmValue "" UBYTE NO_COMPU_METHOD 0 0 0 1 BIT_MASK 0x2 ECU_ADDRESS 0x400DF808 /end MEASUREMENT
/begin MEASUREMENT MCore_rb_SipF_ProcessImage.Cat50[32].switches "" UBYTE NO_COMPU_METHOD 0 0 0 255 ECU_ADDRESS 0x400DF818 /end MEASUREMENT
/begin MEASUREMENT MCore_rb_SipF_ProcessImage.Cat50[32].switches.mcalInputDisconnect "" SBYTE rb_SipF_ProcessImage.Cat50[32].switches.mcalInputDisconnect.CONVERSION 0 0 -128 127 ECU_ADDRESS 0x400DF818 /end MEASUREMENT
/begin MEASUREMENT MCore_rb_SipF_ProcessImage.Cat50[32].switches.sipfInputDisconnect "" SBYTE rb_SipF_ProcessImage.Cat50[32].switches.sipfInputDisconnect.CONVERSION 0 0 -128 127 ECU_ADDRESS 0x400DF819 /end MEASUREMENT
/begin MEASUREMENT MCore_rb_SipF_ProcessImage.Cat50[33].highRes "" UBYTE NO_COMPU_METHOD 0 0 0 255 ECU_ADDRESS 0x400DF824 /end MEASUREMENT
/begin MEASUREMENT MCore_rb_SipF_ProcessImage.Cat50[33].highRes.IrmsSq "" UWORD NO_COMPU_METHOD 0 0 0 65535 ECU_ADDRESS 0x400DF828 /end MEASUREMENT
/begin MEASUREMENT MCore_rb_SipF_ProcessImage.Cat50[33].highRes.IrmsSqFiltered "" UBYTE NO_COMPU_METHOD 0 0 0 255 ECU_ADDRESS 0x400DF824 /end MEASUREMENT
/begin MEASUREMENT MCore_rb_SipF_ProcessImage.Cat50[33].highRes.IrmsSqFiltered.B "" UBYTE NO_COMPU_METHOD 0 0 0 255 ECU_ADDRESS 0x400DF824 /end MEASUREMENT
/begin MEASUREMENT MCore_rb_SipF_ProcessImage.Cat50[33].highRes.IrmsSqFiltered.B.high_16 "" UWORD NO_COMPU_METHOD 0 0 0 65535 ECU_ADDRESS 0x400DF824 /end MEASUREMENT
/begin MEASUREMENT MCore_rb_SipF_ProcessImage.Cat50[33].highRes.IrmsSqFiltered.B.low_16 "" UWORD NO_COMPU_METHOD 0 0 0 65535 ECU_ADDRESS 0x400DF826 /end MEASUREMENT
/begin MEASUREMENT MCore_rb_SipF_ProcessImage.Cat50[33].highRes.IrmsSqFiltered.data_32 "" ULONG NO_COMPU_METHOD 0 0 0 4294967295 ECU_ADDRESS 0x400DF824 /end MEASUREMENT
/begin MEASUREMENT MCore_rb_SipF_ProcessImage.Cat50[33].processed "" UWORD NO_COMPU_METHOD 0 0 0 65535 ECU_ADDRESS 0x400DF82C /end MEASUREMENT
/begin MEASUREMENT MCore_rb_SipF_ProcessImage.Cat50[33].snapshot "" UWORD NO_COMPU_METHOD 0 0 0 65535 ECU_ADDRESS 0x400DF81C /end MEASUREMENT
/begin MEASUREMENT MCore_rb_SipF_ProcessImage.Cat50[33].snapshotDuty "" UWORD NO_COMPU_METHOD 0 0 0 65535 ECU_ADDRESS 0x400DF81E /end MEASUREMENT
/begin MEASUREMENT MCore_rb_SipF_ProcessImage.Cat50[33].snapshotErrorValue "" UBYTE NO_COMPU_METHOD 0 0 0 1 BIT_MASK 0x1 ECU_ADDRESS 0x400DF820 /end MEASUREMENT
/begin MEASUREMENT MCore_rb_SipF_ProcessImage.Cat50[33].snapshotPeriod "" UWORD NO_COMPU_METHOD 0 0 0 65535 ECU_ADDRESS 0x400DF820 /end MEASUREMENT
/begin MEASUREMENT MCore_rb_SipF_ProcessImage.Cat50[33].snapshotReserved "" UBYTE NO_COMPU_METHOD 0 0 0 63 BIT_MASK 0xfc ECU_ADDRESS 0x400DF820 /end MEASUREMENT
/begin MEASUREMENT MCore_rb_SipF_ProcessImage.Cat50[33].snapshotSbmValue "" UBYTE NO_COMPU_METHOD 0 0 0 1 BIT_MASK 0x2 ECU_ADDRESS 0x400DF820 /end MEASUREMENT
/begin MEASUREMENT MCore_rb_SipF_ProcessImage.Cat50[33].switches "" UBYTE NO_COMPU_METHOD 0 0 0 255 ECU_ADDRESS 0x400DF830 /end MEASUREMENT
/begin MEASUREMENT MCore_rb_SipF_ProcessImage.Cat50[33].switches.mcalInputDisconnect "" SBYTE rb_SipF_ProcessImage.Cat50[33].switches.mcalInputDisconnect.CONVERSION 0 0 -128 127 ECU_ADDRESS 0x400DF830 /end MEASUREMENT
/begin MEASUREMENT MCore_rb_SipF_ProcessImage.Cat50[33].switches.sipfInputDisconnect "" SBYTE rb_SipF_ProcessImage.Cat50[33].switches.sipfInputDisconnect.CONVERSION 0 0 -128 127 ECU_ADDRESS 0x400DF831 /end MEASUREMENT
/begin MEASUREMENT MCore_rb_SipF_ProcessImage.Cat50[34].highRes "" UBYTE NO_COMPU_METHOD 0 0 0 255 ECU_ADDRESS 0x400DF83C /end MEASUREMENT
/begin MEASUREMENT MCore_rb_SipF_ProcessImage.Cat50[34].highRes.IrmsSq "" UWORD NO_COMPU_METHOD 0 0 0 65535 ECU_ADDRESS 0x400DF840 /end MEASUREMENT
/begin MEASUREMENT MCore_rb_SipF_ProcessImage.Cat50[34].highRes.IrmsSqFiltered "" UBYTE NO_COMPU_METHOD 0 0 0 255 ECU_ADDRESS 0x400DF83C /end MEASUREMENT
/begin MEASUREMENT MCore_rb_SipF_ProcessImage.Cat50[34].highRes.IrmsSqFiltered.B "" UBYTE NO_COMPU_METHOD 0 0 0 255 ECU_ADDRESS 0x400DF83C /end MEASUREMENT
/begin MEASUREMENT MCore_rb_SipF_ProcessImage.Cat50[34].highRes.IrmsSqFiltered.B.high_16 "" UWORD NO_COMPU_METHOD 0 0 0 65535 ECU_ADDRESS 0x400DF83C /end MEASUREMENT
/begin MEASUREMENT MCore_rb_SipF_ProcessImage.Cat50[34].highRes.IrmsSqFiltered.B.low_16 "" UWORD NO_COMPU_METHOD 0 0 0 65535 ECU_ADDRESS 0x400DF83E /end MEASUREMENT
/begin MEASUREMENT MCore_rb_SipF_ProcessImage.Cat50[34].highRes.IrmsSqFiltered.data_32 "" ULONG NO_COMPU_METHOD 0 0 0 4294967295 ECU_ADDRESS 0x400DF83C /end MEASUREMENT
/begin MEASUREMENT MCore_rb_SipF_ProcessImage.Cat50[34].processed "" UWORD NO_COMPU_METHOD 0 0 0 65535 ECU_ADDRESS 0x400DF844 /end MEASUREMENT
/begin MEASUREMENT MCore_rb_SipF_ProcessImage.Cat50[34].snapshot "" UWORD NO_COMPU_METHOD 0 0 0 65535 ECU_ADDRESS 0x400DF834 /end MEASUREMENT
/begin MEASUREMENT MCore_rb_SipF_ProcessImage.Cat50[34].snapshotDuty "" UWORD NO_COMPU_METHOD 0 0 0 65535 ECU_ADDRESS 0x400DF836 /end MEASUREMENT
/begin MEASUREMENT MCore_rb_SipF_ProcessImage.Cat50[34].snapshotErrorValue "" UBYTE NO_COMPU_METHOD 0 0 0 1 BIT_MASK 0x1 ECU_ADDRESS 0x400DF838 /end MEASUREMENT
/begin MEASUREMENT MCore_rb_SipF_ProcessImage.Cat50[34].snapshotPeriod "" UWORD NO_COMPU_METHOD 0 0 0 65535 ECU_ADDRESS 0x400DF838 /end MEASUREMENT
/begin MEASUREMENT MCore_rb_SipF_ProcessImage.Cat50[34].snapshotReserved "" UBYTE NO_COMPU_METHOD 0 0 0 63 BIT_MASK 0xfc ECU_ADDRESS 0x400DF838 /end MEASUREMENT
/begin MEASUREMENT MCore_rb_SipF_ProcessImage.Cat50[34].snapshotSbmValue "" UBYTE NO_COMPU_METHOD 0 0 0 1 BIT_MASK 0x2 ECU_ADDRESS 0x400DF838 /end MEASUREMENT
/begin MEASUREMENT MCore_rb_SipF_ProcessImage.Cat50[34].switches "" UBYTE NO_COMPU_METHOD 0 0 0 255 ECU_ADDRESS 0x400DF848 /end MEASUREMENT
/begin MEASUREMENT MCore_rb_SipF_ProcessImage.Cat50[34].switches.mcalInputDisconnect "" SBYTE rb_SipF_ProcessImage.Cat50[34].switches.mcalInputDisconnect.CONVERSION 0 0 -128 127 ECU_ADDRESS 0x400DF848 /end MEASUREMENT
/begin MEASUREMENT MCore_rb_SipF_ProcessImage.Cat50[34].switches.sipfInputDisconnect "" SBYTE rb_SipF_ProcessImage.Cat50[34].switches.sipfInputDisconnect.CONVERSION 0 0 -128 127 ECU_ADDRESS 0x400DF849 /end MEASUREMENT
/begin MEASUREMENT MCore_rb_SipF_ProcessImage.Cat50[35].highRes "" UBYTE NO_COMPU_METHOD 0 0 0 255 ECU_ADDRESS 0x400DF854 /end MEASUREMENT
/begin MEASUREMENT MCore_rb_SipF_ProcessImage.Cat50[35].highRes.IrmsSq "" UWORD NO_COMPU_METHOD 0 0 0 65535 ECU_ADDRESS 0x400DF858 /end MEASUREMENT
/begin MEASUREMENT MCore_rb_SipF_ProcessImage.Cat50[35].highRes.IrmsSqFiltered "" UBYTE NO_COMPU_METHOD 0 0 0 255 ECU_ADDRESS 0x400DF854 /end MEASUREMENT
/begin MEASUREMENT MCore_rb_SipF_ProcessImage.Cat50[35].highRes.IrmsSqFiltered.B "" UBYTE NO_COMPU_METHOD 0 0 0 255 ECU_ADDRESS 0x400DF854 /end MEASUREMENT
/begin MEASUREMENT MCore_rb_SipF_ProcessImage.Cat50[35].highRes.IrmsSqFiltered.B.high_16 "" UWORD NO_COMPU_METHOD 0 0 0 65535 ECU_ADDRESS 0x400DF854 /end MEASUREMENT
/begin MEASUREMENT MCore_rb_SipF_ProcessImage.Cat50[35].highRes.IrmsSqFiltered.B.low_16 "" UWORD NO_COMPU_METHOD 0 0 0 65535 ECU_ADDRESS 0x400DF856 /end MEASUREMENT
/begin MEASUREMENT MCore_rb_SipF_ProcessImage.Cat50[35].highRes.IrmsSqFiltered.data_32 "" ULONG NO_COMPU_METHOD 0 0 0 4294967295 ECU_ADDRESS 0x400DF854 /end MEASUREMENT
/begin MEASUREMENT MCore_rb_SipF_ProcessImage.Cat50[35].processed "" UWORD NO_COMPU_METHOD 0 0 0 65535 ECU_ADDRESS 0x400DF85C /end MEASUREMENT
/begin MEASUREMENT MCore_rb_SipF_ProcessImage.Cat50[35].snapshot "" UWORD NO_COMPU_METHOD 0 0 0 65535 ECU_ADDRESS 0x400DF84C /end MEASUREMENT
/begin MEASUREMENT MCore_rb_SipF_ProcessImage.Cat50[35].snapshotDuty "" UWORD NO_COMPU_METHOD 0 0 0 65535 ECU_ADDRESS 0x400DF84E /end MEASUREMENT
/begin MEASUREMENT MCore_rb_SipF_ProcessImage.Cat50[35].snapshotErrorValue "" UBYTE NO_COMPU_METHOD 0 0 0 1 BIT_MASK 0x1 ECU_ADDRESS 0x400DF850 /end MEASUREMENT
/begin MEASUREMENT MCore_rb_SipF_ProcessImage.Cat50[35].snapshotPeriod "" UWORD NO_COMPU_METHOD 0 0 0 65535 ECU_ADDRESS 0x400DF850 /end MEASUREMENT
/begin MEASUREMENT MCore_rb_SipF_ProcessImage.Cat50[35].snapshotReserved "" UBYTE NO_COMPU_METHOD 0 0 0 63 BIT_MASK 0xfc ECU_ADDRESS 0x400DF850 /end MEASUREMENT
/begin MEASUREMENT MCore_rb_SipF_ProcessImage.Cat50[35].snapshotSbmValue "" UBYTE NO_COMPU_METHOD 0 0 0 1 BIT_MASK 0x2 ECU_ADDRESS 0x400DF850 /end MEASUREMENT
/begin MEASUREMENT MCore_rb_SipF_ProcessImage.Cat50[35].switches "" UBYTE NO_COMPU_METHOD 0 0 0 255 ECU_ADDRESS 0x400DF860 /end MEASUREMENT
/begin MEASUREMENT MCore_rb_SipF_ProcessImage.Cat50[35].switches.mcalInputDisconnect "" SBYTE rb_SipF_ProcessImage.Cat50[35].switches.mcalInputDisconnect.CONVERSION 0 0 -128 127 ECU_ADDRESS 0x400DF860 /end MEASUREMENT
/begin MEASUREMENT MCore_rb_SipF_ProcessImage.Cat50[35].switches.sipfInputDisconnect "" SBYTE rb_SipF_ProcessImage.Cat50[35].switches.sipfInputDisconnect.CONVERSION 0 0 -128 127 ECU_ADDRESS 0x400DF861 /end MEASUREMENT
/begin MEASUREMENT MCore_rb_SipF_ProcessImage.Cat50[36].highRes "" UBYTE NO_COMPU_METHOD 0 0 0 255 ECU_ADDRESS 0x400DF86C /end MEASUREMENT
/begin MEASUREMENT MCore_rb_SipF_ProcessImage.Cat50[36].highRes.IrmsSq "" UWORD NO_COMPU_METHOD 0 0 0 65535 ECU_ADDRESS 0x400DF870 /end MEASUREMENT
/begin MEASUREMENT MCore_rb_SipF_ProcessImage.Cat50[36].highRes.IrmsSqFiltered "" UBYTE NO_COMPU_METHOD 0 0 0 255 ECU_ADDRESS 0x400DF86C /end MEASUREMENT
/begin MEASUREMENT MCore_rb_SipF_ProcessImage.Cat50[36].highRes.IrmsSqFiltered.B "" UBYTE NO_COMPU_METHOD 0 0 0 255 ECU_ADDRESS 0x400DF86C /end MEASUREMENT
/begin MEASUREMENT MCore_rb_SipF_ProcessImage.Cat50[36].highRes.IrmsSqFiltered.B.high_16 "" UWORD NO_COMPU_METHOD 0 0 0 65535 ECU_ADDRESS 0x400DF86C /end MEASUREMENT
/begin MEASUREMENT MCore_rb_SipF_ProcessImage.Cat50[36].highRes.IrmsSqFiltered.B.low_16 "" UWORD NO_COMPU_METHOD 0 0 0 65535 ECU_ADDRESS 0x400DF86E /end MEASUREMENT
/begin MEASUREMENT MCore_rb_SipF_ProcessImage.Cat50[36].highRes.IrmsSqFiltered.data_32 "" ULONG NO_COMPU_METHOD 0 0 0 4294967295 ECU_ADDRESS 0x400DF86C /end MEASUREMENT
/begin MEASUREMENT MCore_rb_SipF_ProcessImage.Cat50[36].processed "" UWORD NO_COMPU_METHOD 0 0 0 65535 ECU_ADDRESS 0x400DF874 /end MEASUREMENT
/begin MEASUREMENT MCore_rb_SipF_ProcessImage.Cat50[36].snapshot "" UWORD NO_COMPU_METHOD 0 0 0 65535 ECU_ADDRESS 0x400DF864 /end MEASUREMENT
/begin MEASUREMENT MCore_rb_SipF_ProcessImage.Cat50[36].snapshotDuty "" UWORD NO_COMPU_METHOD 0 0 0 65535 ECU_ADDRESS 0x400DF866 /end MEASUREMENT
/begin MEASUREMENT MCore_rb_SipF_ProcessImage.Cat50[36].snapshotErrorValue "" UBYTE NO_COMPU_METHOD 0 0 0 1 BIT_MASK 0x1 ECU_ADDRESS 0x400DF868 /end MEASUREMENT
/begin MEASUREMENT MCore_rb_SipF_ProcessImage.Cat50[36].snapshotPeriod "" UWORD NO_COMPU_METHOD 0 0 0 65535 ECU_ADDRESS 0x400DF868 /end MEASUREMENT
/begin MEASUREMENT MCore_rb_SipF_ProcessImage.Cat50[36].snapshotReserved "" UBYTE NO_COMPU_METHOD 0 0 0 63 BIT_MASK 0xfc ECU_ADDRESS 0x400DF868 /end MEASUREMENT
/begin MEASUREMENT MCore_rb_SipF_ProcessImage.Cat50[36].snapshotSbmValue "" UBYTE NO_COMPU_METHOD 0 0 0 1 BIT_MASK 0x2 ECU_ADDRESS 0x400DF868 /end MEASUREMENT
/begin MEASUREMENT MCore_rb_SipF_ProcessImage.Cat50[36].switches "" UBYTE NO_COMPU_METHOD 0 0 0 255 ECU_ADDRESS 0x400DF878 /end MEASUREMENT
/begin MEASUREMENT MCore_rb_SipF_ProcessImage.Cat50[36].switches.mcalInputDisconnect "" SBYTE rb_SipF_ProcessImage.Cat50[36].switches.mcalInputDisconnect.CONVERSION 0 0 -128 127 ECU_ADDRESS 0x400DF878 /end MEASUREMENT
/begin MEASUREMENT MCore_rb_SipF_ProcessImage.Cat50[36].switches.sipfInputDisconnect "" SBYTE rb_SipF_ProcessImage.Cat50[36].switches.sipfInputDisconnect.CONVERSION 0 0 -128 127 ECU_ADDRESS 0x400DF879 /end MEASUREMENT
/begin MEASUREMENT MCore_rb_SipF_ProcessImage.Cat50[37].highRes "" UBYTE NO_COMPU_METHOD 0 0 0 255 ECU_ADDRESS 0x400DF884 /end MEASUREMENT
/begin MEASUREMENT MCore_rb_SipF_ProcessImage.Cat50[37].highRes.IrmsSq "" UWORD NO_COMPU_METHOD 0 0 0 65535 ECU_ADDRESS 0x400DF888 /end MEASUREMENT
/begin MEASUREMENT MCore_rb_SipF_ProcessImage.Cat50[37].highRes.IrmsSqFiltered "" UBYTE NO_COMPU_METHOD 0 0 0 255 ECU_ADDRESS 0x400DF884 /end MEASUREMENT
/begin MEASUREMENT MCore_rb_SipF_ProcessImage.Cat50[37].highRes.IrmsSqFiltered.B "" UBYTE NO_COMPU_METHOD 0 0 0 255 ECU_ADDRESS 0x400DF884 /end MEASUREMENT
/begin MEASUREMENT MCore_rb_SipF_ProcessImage.Cat50[37].highRes.IrmsSqFiltered.B.high_16 "" UWORD NO_COMPU_METHOD 0 0 0 65535 ECU_ADDRESS 0x400DF884 /end MEASUREMENT
/begin MEASUREMENT MCore_rb_SipF_ProcessImage.Cat50[37].highRes.IrmsSqFiltered.B.low_16 "" UWORD NO_COMPU_METHOD 0 0 0 65535 ECU_ADDRESS 0x400DF886 /end MEASUREMENT
/begin MEASUREMENT MCore_rb_SipF_ProcessImage.Cat50[37].highRes.IrmsSqFiltered.data_32 "" ULONG NO_COMPU_METHOD 0 0 0 4294967295 ECU_ADDRESS 0x400DF884 /end MEASUREMENT
/begin MEASUREMENT MCore_rb_SipF_ProcessImage.Cat50[37].processed "" UWORD NO_COMPU_METHOD 0 0 0 65535 ECU_ADDRESS 0x400DF88C /end MEASUREMENT
/begin MEASUREMENT MCore_rb_SipF_ProcessImage.Cat50[37].snapshot "" UWORD NO_COMPU_METHOD 0 0 0 65535 ECU_ADDRESS 0x400DF87C /end MEASUREMENT
/begin MEASUREMENT MCore_rb_SipF_ProcessImage.Cat50[37].snapshotDuty "" UWORD NO_COMPU_METHOD 0 0 0 65535 ECU_ADDRESS 0x400DF87E /end MEASUREMENT
/begin MEASUREMENT MCore_rb_SipF_ProcessImage.Cat50[37].snapshotErrorValue "" UBYTE NO_COMPU_METHOD 0 0 0 1 BIT_MASK 0x1 ECU_ADDRESS 0x400DF880 /end MEASUREMENT
/begin MEASUREMENT MCore_rb_SipF_ProcessImage.Cat50[37].snapshotPeriod "" UWORD NO_COMPU_METHOD 0 0 0 65535 ECU_ADDRESS 0x400DF880 /end MEASUREMENT
/begin MEASUREMENT MCore_rb_SipF_ProcessImage.Cat50[37].snapshotReserved "" UBYTE NO_COMPU_METHOD 0 0 0 63 BIT_MASK 0xfc ECU_ADDRESS 0x400DF880 /end MEASUREMENT
/begin MEASUREMENT MCore_rb_SipF_ProcessImage.Cat50[37].snapshotSbmValue "" UBYTE NO_COMPU_METHOD 0 0 0 1 BIT_MASK 0x2 ECU_ADDRESS 0x400DF880 /end MEASUREMENT
/begin MEASUREMENT MCore_rb_SipF_ProcessImage.Cat50[37].switches "" UBYTE NO_COMPU_METHOD 0 0 0 255 ECU_ADDRESS 0x400DF890 /end MEASUREMENT
/begin MEASUREMENT MCore_rb_SipF_ProcessImage.Cat50[37].switches.mcalInputDisconnect "" SBYTE rb_SipF_ProcessImage.Cat50[37].switches.mcalInputDisconnect.CONVERSION 0 0 -128 127 ECU_ADDRESS 0x400DF890 /end MEASUREMENT
/begin MEASUREMENT MCore_rb_SipF_ProcessImage.Cat50[37].switches.sipfInputDisconnect "" SBYTE rb_SipF_ProcessImage.Cat50[37].switches.sipfInputDisconnect.CONVERSION 0 0 -128 127 ECU_ADDRESS 0x400DF891 /end MEASUREMENT
/begin MEASUREMENT MCore_rb_SipF_ProcessImage.Cat50[38].highRes "" UBYTE NO_COMPU_METHOD 0 0 0 255 ECU_ADDRESS 0x400DF89C /end MEASUREMENT
/begin MEASUREMENT MCore_rb_SipF_ProcessImage.Cat50[38].highRes.IrmsSq "" UWORD NO_COMPU_METHOD 0 0 0 65535 ECU_ADDRESS 0x400DF8A0 /end MEASUREMENT
/begin MEASUREMENT MCore_rb_SipF_ProcessImage.Cat50[38].highRes.IrmsSqFiltered "" UBYTE NO_COMPU_METHOD 0 0 0 255 ECU_ADDRESS 0x400DF89C /end MEASUREMENT
/begin MEASUREMENT MCore_rb_SipF_ProcessImage.Cat50[38].highRes.IrmsSqFiltered.B "" UBYTE NO_COMPU_METHOD 0 0 0 255 ECU_ADDRESS 0x400DF89C /end MEASUREMENT
/begin MEASUREMENT MCore_rb_SipF_ProcessImage.Cat50[38].highRes.IrmsSqFiltered.B.high_16 "" UWORD NO_COMPU_METHOD 0 0 0 65535 ECU_ADDRESS 0x400DF89C /end MEASUREMENT
/begin MEASUREMENT MCore_rb_SipF_ProcessImage.Cat50[38].highRes.IrmsSqFiltered.B.low_16 "" UWORD NO_COMPU_METHOD 0 0 0 65535 ECU_ADDRESS 0x400DF89E /end MEASUREMENT
/begin MEASUREMENT MCore_rb_SipF_ProcessImage.Cat50[38].highRes.IrmsSqFiltered.data_32 "" ULONG NO_COMPU_METHOD 0 0 0 4294967295 ECU_ADDRESS 0x400DF89C /end MEASUREMENT
/begin MEASUREMENT MCore_rb_SipF_ProcessImage.Cat50[38].processed "" UWORD NO_COMPU_METHOD 0 0 0 65535 ECU_ADDRESS 0x400DF8A4 /end MEASUREMENT
/begin MEASUREMENT MCore_rb_SipF_ProcessImage.Cat50[38].snapshot "" UWORD NO_COMPU_METHOD 0 0 0 65535 ECU_ADDRESS 0x400DF894 /end MEASUREMENT
/begin MEASUREMENT MCore_rb_SipF_ProcessImage.Cat50[38].snapshotDuty "" UWORD NO_COMPU_METHOD 0 0 0 65535 ECU_ADDRESS 0x400DF896 /end MEASUREMENT
/begin MEASUREMENT MCore_rb_SipF_ProcessImage.Cat50[38].snapshotErrorValue "" UBYTE NO_COMPU_METHOD 0 0 0 1 BIT_MASK 0x1 ECU_ADDRESS 0x400DF898 /end MEASUREMENT
/begin MEASUREMENT MCore_rb_SipF_ProcessImage.Cat50[38].snapshotPeriod "" UWORD NO_COMPU_METHOD 0 0 0 65535 ECU_ADDRESS 0x400DF898 /end MEASUREMENT
/begin MEASUREMENT MCore_rb_SipF_ProcessImage.Cat50[38].snapshotReserved "" UBYTE NO_COMPU_METHOD 0 0 0 63 BIT_MASK 0xfc ECU_ADDRESS 0x400DF898 /end MEASUREMENT
/begin MEASUREMENT MCore_rb_SipF_ProcessImage.Cat50[38].snapshotSbmValue "" UBYTE NO_COMPU_METHOD 0 0 0 1 BIT_MASK 0x2 ECU_ADDRESS 0x400DF898 /end MEASUREMENT
/begin MEASUREMENT MCore_rb_SipF_ProcessImage.Cat50[38].switches "" UBYTE NO_COMPU_METHOD 0 0 0 255 ECU_ADDRESS 0x400DF8A8 /end MEASUREMENT
/begin MEASUREMENT MCore_rb_SipF_ProcessImage.Cat50[38].switches.mcalInputDisconnect "" SBYTE rb_SipF_ProcessImage.Cat50[38].switches.mcalInputDisconnect.CONVERSION 0 0 -128 127 ECU_ADDRESS 0x400DF8A8 /end MEASUREMENT
/begin MEASUREMENT MCore_rb_SipF_ProcessImage.Cat50[38].switches.sipfInputDisconnect "" SBYTE rb_SipF_ProcessImage.Cat50[38].switches.sipfInputDisconnect.CONVERSION 0 0 -128 127 ECU_ADDRESS 0x400DF8A9 /end MEASUREMENT
/begin MEASUREMENT MCore_rb_SipF_ProcessImage.Cat50[39].highRes "" UBYTE NO_COMPU_METHOD 0 0 0 255 ECU_ADDRESS 0x400DF8B4 /end MEASUREMENT
/begin MEASUREMENT MCore_rb_SipF_ProcessImage.Cat50[39].highRes.IrmsSq "" UWORD NO_COMPU_METHOD 0 0 0 65535 ECU_ADDRESS 0x400DF8B8 /end MEASUREMENT
/begin MEASUREMENT MCore_rb_SipF_ProcessImage.Cat50[39].highRes.IrmsSqFiltered "" UBYTE NO_COMPU_METHOD 0 0 0 255 ECU_ADDRESS 0x400DF8B4 /end MEASUREMENT
/begin MEASUREMENT MCore_rb_SipF_ProcessImage.Cat50[39].highRes.IrmsSqFiltered.B "" UBYTE NO_COMPU_METHOD 0 0 0 255 ECU_ADDRESS 0x400DF8B4 /end MEASUREMENT
/begin MEASUREMENT MCore_rb_SipF_ProcessImage.Cat50[39].highRes.IrmsSqFiltered.B.high_16 "" UWORD NO_COMPU_METHOD 0 0 0 65535 ECU_ADDRESS 0x400DF8B4 /end MEASUREMENT
/begin MEASUREMENT MCore_rb_SipF_ProcessImage.Cat50[39].highRes.IrmsSqFiltered.B.low_16 "" UWORD NO_COMPU_METHOD 0 0 0 65535 ECU_ADDRESS 0x400DF8B6 /end MEASUREMENT
/begin MEASUREMENT MCore_rb_SipF_ProcessImage.Cat50[39].highRes.IrmsSqFiltered.data_32 "" ULONG NO_COMPU_METHOD 0 0 0 4294967295 ECU_ADDRESS 0x400DF8B4 /end MEASUREMENT
/begin MEASUREMENT MCore_rb_SipF_ProcessImage.Cat50[39].processed "" UWORD NO_COMPU_METHOD 0 0 0 65535 ECU_ADDRESS 0x400DF8BC /end MEASUREMENT
/begin MEASUREMENT MCore_rb_SipF_ProcessImage.Cat50[39].snapshot "" UWORD NO_COMPU_METHOD 0 0 0 65535 ECU_ADDRESS 0x400DF8AC /end MEASUREMENT
/begin MEASUREMENT MCore_rb_SipF_ProcessImage.Cat50[39].snapshotDuty "" UWORD NO_COMPU_METHOD 0 0 0 65535 ECU_ADDRESS 0x400DF8AE /end MEASUREMENT
/begin MEASUREMENT MCore_rb_SipF_ProcessImage.Cat50[39].snapshotErrorValue "" UBYTE NO_COMPU_METHOD 0 0 0 1 BIT_MASK 0x1 ECU_ADDRESS 0x400DF8B0 /end MEASUREMENT
/begin MEASUREMENT MCore_rb_SipF_ProcessImage.Cat50[39].snapshotPeriod "" UWORD NO_COMPU_METHOD 0 0 0 65535 ECU_ADDRESS 0x400DF8B0 /end MEASUREMENT
/begin MEASUREMENT MCore_rb_SipF_ProcessImage.Cat50[39].snapshotReserved "" UBYTE NO_COMPU_METHOD 0 0 0 63 BIT_MASK 0xfc ECU_ADDRESS 0x400DF8B0 /end MEASUREMENT
/begin MEASUREMENT MCore_rb_SipF_ProcessImage.Cat50[39].snapshotSbmValue "" UBYTE NO_COMPU_METHOD 0 0 0 1 BIT_MASK 0x2 ECU_ADDRESS 0x400DF8B0 /end MEASUREMENT
/begin MEASUREMENT MCore_rb_SipF_ProcessImage.Cat50[39].switches "" UBYTE NO_COMPU_METHOD 0 0 0 255 ECU_ADDRESS 0x400DF8C0 /end MEASUREMENT
/begin MEASUREMENT MCore_rb_SipF_ProcessImage.Cat50[39].switches.mcalInputDisconnect "" SBYTE rb_SipF_ProcessImage.Cat50[39].switches.mcalInputDisconnect.CONVERSION 0 0 -128 127 ECU_ADDRESS 0x400DF8C0 /end MEASUREMENT
/begin MEASUREMENT MCore_rb_SipF_ProcessImage.Cat50[39].switches.sipfInputDisconnect "" SBYTE rb_SipF_ProcessImage.Cat50[39].switches.sipfInputDisconnect.CONVERSION 0 0 -128 127 ECU_ADDRESS 0x400DF8C1 /end MEASUREMENT
/begin MEASUREMENT MCore_rb_SipF_ProcessImage.Cat50[3].highRes "" UBYTE NO_COMPU_METHOD 0 0 0 255 ECU_ADDRESS 0x400DF554 /end MEASUREMENT
/begin MEASUREMENT MCore_rb_SipF_ProcessImage.Cat50[3].highRes.IrmsSq "" UWORD NO_COMPU_METHOD 0 0 0 65535 ECU_ADDRESS 0x400DF558 /end MEASUREMENT
/begin MEASUREMENT MCore_rb_SipF_ProcessImage.Cat50[3].highRes.IrmsSqFiltered "" UBYTE NO_COMPU_METHOD 0 0 0 255 ECU_ADDRESS 0x400DF554 /end MEASUREMENT
/begin MEASUREMENT MCore_rb_SipF_ProcessImage.Cat50[3].highRes.IrmsSqFiltered.B "" UBYTE NO_COMPU_METHOD 0 0 0 255 ECU_ADDRESS 0x400DF554 /end MEASUREMENT
/begin MEASUREMENT MCore_rb_SipF_ProcessImage.Cat50[3].highRes.IrmsSqFiltered.B.high_16 "" UWORD NO_COMPU_METHOD 0 0 0 65535 ECU_ADDRESS 0x400DF554 /end MEASUREMENT
/begin MEASUREMENT MCore_rb_SipF_ProcessImage.Cat50[3].highRes.IrmsSqFiltered.B.low_16 "" UWORD NO_COMPU_METHOD 0 0 0 65535 ECU_ADDRESS 0x400DF556 /end MEASUREMENT
/begin MEASUREMENT MCore_rb_SipF_ProcessImage.Cat50[3].highRes.IrmsSqFiltered.data_32 "" ULONG NO_COMPU_METHOD 0 0 0 4294967295 ECU_ADDRESS 0x400DF554 /end MEASUREMENT
/begin MEASUREMENT MCore_rb_SipF_ProcessImage.Cat50[3].processed "" UWORD NO_COMPU_METHOD 0 0 0 65535 ECU_ADDRESS 0x400DF55C /end MEASUREMENT
/begin MEASUREMENT MCore_rb_SipF_ProcessImage.Cat50[3].snapshot "" UWORD NO_COMPU_METHOD 0 0 0 65535 ECU_ADDRESS 0x400DF54C /end MEASUREMENT
/begin MEASUREMENT MCore_rb_SipF_ProcessImage.Cat50[3].snapshotDuty "" UWORD NO_COMPU_METHOD 0 0 0 65535 ECU_ADDRESS 0x400DF54E /end MEASUREMENT
/begin MEASUREMENT MCore_rb_SipF_ProcessImage.Cat50[3].snapshotErrorValue "" UBYTE NO_COMPU_METHOD 0 0 0 1 BIT_MASK 0x1 ECU_ADDRESS 0x400DF550 /end MEASUREMENT
/begin MEASUREMENT MCore_rb_SipF_ProcessImage.Cat50[3].snapshotPeriod "" UWORD NO_COMPU_METHOD 0 0 0 65535 ECU_ADDRESS 0x400DF550 /end MEASUREMENT
/begin MEASUREMENT MCore_rb_SipF_ProcessImage.Cat50[3].snapshotReserved "" UBYTE NO_COMPU_METHOD 0 0 0 63 BIT_MASK 0xfc ECU_ADDRESS 0x400DF550 /end MEASUREMENT
/begin MEASUREMENT MCore_rb_SipF_ProcessImage.Cat50[3].snapshotSbmValue "" UBYTE NO_COMPU_METHOD 0 0 0 1 BIT_MASK 0x2 ECU_ADDRESS 0x400DF550 /end MEASUREMENT
/begin MEASUREMENT MCore_rb_SipF_ProcessImage.Cat50[3].switches "" UBYTE NO_COMPU_METHOD 0 0 0 255 ECU_ADDRESS 0x400DF560 /end MEASUREMENT
/begin MEASUREMENT MCore_rb_SipF_ProcessImage.Cat50[3].switches.mcalInputDisconnect "" SBYTE rb_SipF_ProcessImage.Cat50[3].switches.mcalInputDisconnect.CONVERSION 0 0 -128 127 ECU_ADDRESS 0x400DF560 /end MEASUREMENT
/begin MEASUREMENT MCore_rb_SipF_ProcessImage.Cat50[3].switches.sipfInputDisconnect "" SBYTE rb_SipF_ProcessImage.Cat50[3].switches.sipfInputDisconnect.CONVERSION 0 0 -128 127 ECU_ADDRESS 0x400DF561 /end MEASUREMENT
/begin MEASUREMENT MCore_rb_SipF_ProcessImage.Cat50[40].highRes "" UBYTE NO_COMPU_METHOD 0 0 0 255 ECU_ADDRESS 0x400DF8CC /end MEASUREMENT
/begin MEASUREMENT MCore_rb_SipF_ProcessImage.Cat50[40].highRes.IrmsSq "" UWORD NO_COMPU_METHOD 0 0 0 65535 ECU_ADDRESS 0x400DF8D0 /end MEASUREMENT
/begin MEASUREMENT MCore_rb_SipF_ProcessImage.Cat50[40].highRes.IrmsSqFiltered "" UBYTE NO_COMPU_METHOD 0 0 0 255 ECU_ADDRESS 0x400DF8CC /end MEASUREMENT
/begin MEASUREMENT MCore_rb_SipF_ProcessImage.Cat50[40].highRes.IrmsSqFiltered.B "" UBYTE NO_COMPU_METHOD 0 0 0 255 ECU_ADDRESS 0x400DF8CC /end MEASUREMENT
/begin MEASUREMENT MCore_rb_SipF_ProcessImage.Cat50[40].highRes.IrmsSqFiltered.B.high_16 "" UWORD NO_COMPU_METHOD 0 0 0 65535 ECU_ADDRESS 0x400DF8CC /end MEASUREMENT
/begin MEASUREMENT MCore_rb_SipF_ProcessImage.Cat50[40].highRes.IrmsSqFiltered.B.low_16 "" UWORD NO_COMPU_METHOD 0 0 0 65535 ECU_ADDRESS 0x400DF8CE /end MEASUREMENT
/begin MEASUREMENT MCore_rb_SipF_ProcessImage.Cat50[40].highRes.IrmsSqFiltered.data_32 "" ULONG NO_COMPU_METHOD 0 0 0 4294967295 ECU_ADDRESS 0x400DF8CC /end MEASUREMENT
/begin MEASUREMENT MCore_rb_SipF_ProcessImage.Cat50[40].processed "" UWORD NO_COMPU_METHOD 0 0 0 65535 ECU_ADDRESS 0x400DF8D4 /end MEASUREMENT
/begin MEASUREMENT MCore_rb_SipF_ProcessImage.Cat50[40].snapshot "" UWORD NO_COMPU_METHOD 0 0 0 65535 ECU_ADDRESS 0x400DF8C4 /end MEASUREMENT
/begin MEASUREMENT MCore_rb_SipF_ProcessImage.Cat50[40].snapshotDuty "" UWORD NO_COMPU_METHOD 0 0 0 65535 ECU_ADDRESS 0x400DF8C6 /end MEASUREMENT
/begin MEASUREMENT MCore_rb_SipF_ProcessImage.Cat50[40].snapshotErrorValue "" UBYTE NO_COMPU_METHOD 0 0 0 1 BIT_MASK 0x1 ECU_ADDRESS 0x400DF8C8 /end MEASUREMENT
/begin MEASUREMENT MCore_rb_SipF_ProcessImage.Cat50[40].snapshotPeriod "" UWORD NO_COMPU_METHOD 0 0 0 65535 ECU_ADDRESS 0x400DF8C8 /end MEASUREMENT
/begin MEASUREMENT MCore_rb_SipF_ProcessImage.Cat50[40].snapshotReserved "" UBYTE NO_COMPU_METHOD 0 0 0 63 BIT_MASK 0xfc ECU_ADDRESS 0x400DF8C8 /end MEASUREMENT
/begin MEASUREMENT MCore_rb_SipF_ProcessImage.Cat50[40].snapshotSbmValue "" UBYTE NO_COMPU_METHOD 0 0 0 1 BIT_MASK 0x2 ECU_ADDRESS 0x400DF8C8 /end MEASUREMENT
/begin MEASUREMENT MCore_rb_SipF_ProcessImage.Cat50[40].switches "" UBYTE NO_COMPU_METHOD 0 0 0 255 ECU_ADDRESS 0x400DF8D8 /end MEASUREMENT
/begin MEASUREMENT MCore_rb_SipF_ProcessImage.Cat50[40].switches.mcalInputDisconnect "" SBYTE rb_SipF_ProcessImage.Cat50[40].switches.mcalInputDisconnect.CONVERSION 0 0 -128 127 ECU_ADDRESS 0x400DF8D8 /end MEASUREMENT
/begin MEASUREMENT MCore_rb_SipF_ProcessImage.Cat50[40].switches.sipfInputDisconnect "" SBYTE rb_SipF_ProcessImage.Cat50[40].switches.sipfInputDisconnect.CONVERSION 0 0 -128 127 ECU_ADDRESS 0x400DF8D9 /end MEASUREMENT
/begin MEASUREMENT MCore_rb_SipF_ProcessImage.Cat50[41].highRes "" UBYTE NO_COMPU_METHOD 0 0 0 255 ECU_ADDRESS 0x400DF8E4 /end MEASUREMENT
/begin MEASUREMENT MCore_rb_SipF_ProcessImage.Cat50[41].highRes.IrmsSq "" UWORD NO_COMPU_METHOD 0 0 0 65535 ECU_ADDRESS 0x400DF8E8 /end MEASUREMENT
/begin MEASUREMENT MCore_rb_SipF_ProcessImage.Cat50[41].highRes.IrmsSqFiltered "" UBYTE NO_COMPU_METHOD 0 0 0 255 ECU_ADDRESS 0x400DF8E4 /end MEASUREMENT
/begin MEASUREMENT MCore_rb_SipF_ProcessImage.Cat50[41].highRes.IrmsSqFiltered.B "" UBYTE NO_COMPU_METHOD 0 0 0 255 ECU_ADDRESS 0x400DF8E4 /end MEASUREMENT
/begin MEASUREMENT MCore_rb_SipF_ProcessImage.Cat50[41].highRes.IrmsSqFiltered.B.high_16 "" UWORD NO_COMPU_METHOD 0 0 0 65535 ECU_ADDRESS 0x400DF8E4 /end MEASUREMENT
/begin MEASUREMENT MCore_rb_SipF_ProcessImage.Cat50[41].highRes.IrmsSqFiltered.B.low_16 "" UWORD NO_COMPU_METHOD 0 0 0 65535 ECU_ADDRESS 0x400DF8E6 /end MEASUREMENT
/begin MEASUREMENT MCore_rb_SipF_ProcessImage.Cat50[41].highRes.IrmsSqFiltered.data_32 "" ULONG NO_COMPU_METHOD 0 0 0 4294967295 ECU_ADDRESS 0x400DF8E4 /end MEASUREMENT
/begin MEASUREMENT MCore_rb_SipF_ProcessImage.Cat50[41].processed "" UWORD NO_COMPU_METHOD 0 0 0 65535 ECU_ADDRESS 0x400DF8EC /end MEASUREMENT
/begin MEASUREMENT MCore_rb_SipF_ProcessImage.Cat50[41].snapshot "" UWORD NO_COMPU_METHOD 0 0 0 65535 ECU_ADDRESS 0x400DF8DC /end MEASUREMENT
/begin MEASUREMENT MCore_rb_SipF_ProcessImage.Cat50[41].snapshotDuty "" UWORD NO_COMPU_METHOD 0 0 0 65535 ECU_ADDRESS 0x400DF8DE /end MEASUREMENT
/begin MEASUREMENT MCore_rb_SipF_ProcessImage.Cat50[41].snapshotErrorValue "" UBYTE NO_COMPU_METHOD 0 0 0 1 BIT_MASK 0x1 ECU_ADDRESS 0x400DF8E0 /end MEASUREMENT
/begin MEASUREMENT MCore_rb_SipF_ProcessImage.Cat50[41].snapshotPeriod "" UWORD NO_COMPU_METHOD 0 0 0 65535 ECU_ADDRESS 0x400DF8E0 /end MEASUREMENT
/begin MEASUREMENT MCore_rb_SipF_ProcessImage.Cat50[41].snapshotReserved "" UBYTE NO_COMPU_METHOD 0 0 0 63 BIT_MASK 0xfc ECU_ADDRESS 0x400DF8E0 /end MEASUREMENT
/begin MEASUREMENT MCore_rb_SipF_ProcessImage.Cat50[41].snapshotSbmValue "" UBYTE NO_COMPU_METHOD 0 0 0 1 BIT_MASK 0x2 ECU_ADDRESS 0x400DF8E0 /end MEASUREMENT
/begin MEASUREMENT MCore_rb_SipF_ProcessImage.Cat50[41].switches "" UBYTE NO_COMPU_METHOD 0 0 0 255 ECU_ADDRESS 0x400DF8F0 /end MEASUREMENT
/begin MEASUREMENT MCore_rb_SipF_ProcessImage.Cat50[41].switches.mcalInputDisconnect "" SBYTE rb_SipF_ProcessImage.Cat50[41].switches.mcalInputDisconnect.CONVERSION 0 0 -128 127 ECU_ADDRESS 0x400DF8F0 /end MEASUREMENT
/begin MEASUREMENT MCore_rb_SipF_ProcessImage.Cat50[41].switches.sipfInputDisconnect "" SBYTE rb_SipF_ProcessImage.Cat50[41].switches.sipfInputDisconnect.CONVERSION 0 0 -128 127 ECU_ADDRESS 0x400DF8F1 /end MEASUREMENT
/begin MEASUREMENT MCore_rb_SipF_ProcessImage.Cat50[42].highRes "" UBYTE NO_COMPU_METHOD 0 0 0 255 ECU_ADDRESS 0x400DF8FC /end MEASUREMENT
/begin MEASUREMENT MCore_rb_SipF_ProcessImage.Cat50[42].highRes.IrmsSq "" UWORD NO_COMPU_METHOD 0 0 0 65535 ECU_ADDRESS 0x400DF900 /end MEASUREMENT
/begin MEASUREMENT MCore_rb_SipF_ProcessImage.Cat50[42].highRes.IrmsSqFiltered "" UBYTE NO_COMPU_METHOD 0 0 0 255 ECU_ADDRESS 0x400DF8FC /end MEASUREMENT
/begin MEASUREMENT MCore_rb_SipF_ProcessImage.Cat50[42].highRes.IrmsSqFiltered.B "" UBYTE NO_COMPU_METHOD 0 0 0 255 ECU_ADDRESS 0x400DF8FC /end MEASUREMENT
/begin MEASUREMENT MCore_rb_SipF_ProcessImage.Cat50[42].highRes.IrmsSqFiltered.B.high_16 "" UWORD NO_COMPU_METHOD 0 0 0 65535 ECU_ADDRESS 0x400DF8FC /end MEASUREMENT
/begin MEASUREMENT MCore_rb_SipF_ProcessImage.Cat50[42].highRes.IrmsSqFiltered.B.low_16 "" UWORD NO_COMPU_METHOD 0 0 0 65535 ECU_ADDRESS 0x400DF8FE /end MEASUREMENT
/begin MEASUREMENT MCore_rb_SipF_ProcessImage.Cat50[42].highRes.IrmsSqFiltered.data_32 "" ULONG NO_COMPU_METHOD 0 0 0 4294967295 ECU_ADDRESS 0x400DF8FC /end MEASUREMENT
/begin MEASUREMENT MCore_rb_SipF_ProcessImage.Cat50[42].processed "" UWORD NO_COMPU_METHOD 0 0 0 65535 ECU_ADDRESS 0x400DF904 /end MEASUREMENT
/begin MEASUREMENT MCore_rb_SipF_ProcessImage.Cat50[42].snapshot "" UWORD NO_COMPU_METHOD 0 0 0 65535 ECU_ADDRESS 0x400DF8F4 /end MEASUREMENT
/begin MEASUREMENT MCore_rb_SipF_ProcessImage.Cat50[42].snapshotDuty "" UWORD NO_COMPU_METHOD 0 0 0 65535 ECU_ADDRESS 0x400DF8F6 /end MEASUREMENT
/begin MEASUREMENT MCore_rb_SipF_ProcessImage.Cat50[42].snapshotErrorValue "" UBYTE NO_COMPU_METHOD 0 0 0 1 BIT_MASK 0x1 ECU_ADDRESS 0x400DF8F8 /end MEASUREMENT
/begin MEASUREMENT MCore_rb_SipF_ProcessImage.Cat50[42].snapshotPeriod "" UWORD NO_COMPU_METHOD 0 0 0 65535 ECU_ADDRESS 0x400DF8F8 /end MEASUREMENT
/begin MEASUREMENT MCore_rb_SipF_ProcessImage.Cat50[42].snapshotReserved "" UBYTE NO_COMPU_METHOD 0 0 0 63 BIT_MASK 0xfc ECU_ADDRESS 0x400DF8F8 /end MEASUREMENT
/begin MEASUREMENT MCore_rb_SipF_ProcessImage.Cat50[42].snapshotSbmValue "" UBYTE NO_COMPU_METHOD 0 0 0 1 BIT_MASK 0x2 ECU_ADDRESS 0x400DF8F8 /end MEASUREMENT
/begin MEASUREMENT MCore_rb_SipF_ProcessImage.Cat50[42].switches "" UBYTE NO_COMPU_METHOD 0 0 0 255 ECU_ADDRESS 0x400DF908 /end MEASUREMENT
/begin MEASUREMENT MCore_rb_SipF_ProcessImage.Cat50[42].switches.mcalInputDisconnect "" SBYTE rb_SipF_ProcessImage.Cat50[42].switches.mcalInputDisconnect.CONVERSION 0 0 -128 127 ECU_ADDRESS 0x400DF908 /end MEASUREMENT
/begin MEASUREMENT MCore_rb_SipF_ProcessImage.Cat50[42].switches.sipfInputDisconnect "" SBYTE rb_SipF_ProcessImage.Cat50[42].switches.sipfInputDisconnect.CONVERSION 0 0 -128 127 ECU_ADDRESS 0x400DF909 /end MEASUREMENT
/begin MEASUREMENT MCore_rb_SipF_ProcessImage.Cat50[43].highRes "" UBYTE NO_COMPU_METHOD 0 0 0 255 ECU_ADDRESS 0x400DF914 /end MEASUREMENT
/begin MEASUREMENT MCore_rb_SipF_ProcessImage.Cat50[43].highRes.IrmsSq "" UWORD NO_COMPU_METHOD 0 0 0 65535 ECU_ADDRESS 0x400DF918 /end MEASUREMENT
/end MODULE
/end PROJECT

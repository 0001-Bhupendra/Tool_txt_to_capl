ASAP2_VERSION 1 61
/begin PROJECT prjDemo ""
/begin HEADER "" PROJECT_NO prjDemo_1_0 VERSION "AR_A2L_1.0" /end HEADER
/begin MODULE modFinalDemo ""
/begin MOD_COMMON "" BYTE_ORDER MSB_FIRST ALIGNMENT_BYTE 1 ALIGNMENT_WORD 1 ALIGNMENT_LONG 1 ALIGNMENT_INT64 1 ALIGNMENT_FLOAT32_IEEE 1 ALIGNMENT_FLOAT64_IEEE 4 /end MOD_COMMON
/begin RECORD_LAYOUT SSV__UWORD_S_s1 AXIS_PTS_X 1 UWORD INDEX_INCR DIRECT /end RECORD_LAYOUT
/begin RECORD_LAYOUT SSV__ULONG_S_s1 AXIS_PTS_X 1 ULONG INDEX_INCR DIRECT /end RECORD_LAYOUT
/begin RECORD_LAYOUT SSV__SBYTE_S_s1 AXIS_PTS_X 1 SBYTE INDEX_INCR DIRECT /end RECORD_LAYOUT
/begin RECORD_LAYOUT SSV__SWORD_S_s1 AXIS_PTS_X 1 SWORD INDEX_INCR DIRECT /end RECORD_LAYOUT
/begin RECORD_LAYOUT SSV__SLONG_S_s1 AXIS_PTS_X 1 SLONG INDEX_INCR DIRECT /end RECORD_LAYOUT
/begin RECORD_LAYOUT SSV__FLOAT32_IEEE_S_s1 AXIS_PTS_X 1 FLOAT32_IEEE INDEX_INCR DIRECT /end RECORD_LAYOUT
/begin RECORD_LAYOUT SSV__FLOAT64_IEEE_S_s1 AXIS_PTS_X 1 FLOAT64_IEEE INDEX_INCR DIRECT /end RECORD_LAYOUT
/begin RECORD_LAYOUT __A_UINT64_Z_s1 FNC_VALUES 1 A_UINT64 ROW_DIR DIRECT /end RECORD_LAYOUT
/begin RECORD_LAYOUT __A_INT64_Z_s1 FNC_VALUES 1 A_INT64 ROW_DIR DIRECT /end RECORD_LAYOUT
/begin RECORD_LAYOUT __A_UINT64_S_s1 FNC_VALUES 1 A_UINT64 COLUMN_DIR DIRECT /end RECORD_LAYOUT
/begin RECORD_LAYOUT __A_INT64_S_s1 FNC_VALUES 1 A_INT64 COLUMN_DIR DIRECT /end RECORD_LAYOUT
/begin RECORD_LAYOUT SSV__A_UINT64_S_s1 AXIS_PTS_X 1 A_UINT64 INDEX_INCR DIRECT /end RECORD_LAYOUT
/begin RECORD_LAYOUT SSV__A_INT64_S_s1 AXIS_PTS_X 1 A_INT64 INDEX_INCR DIRECT /end RECORD_LAYOUT
/*********** End of merged RECORD_LAYOUT blocks ***********/
/begin RECORD_LAYOUT __UBYTE_Z FNC_VALUES 1 UBYTE ROW_DIR DIRECT /end RECORD_LAYOUT
/begin RECORD_LAYOUT __UWORD_Z FNC_VALUES 1 UWORD ROW_DIR DIRECT /end RECORD_LAYOUT
/begin RECORD_LAYOUT __ULONG_Z FNC_VALUES 1 ULONG ROW_DIR DIRECT /end RECORD_LAYOUT
/begin MEASUREMENT MCore_ParkingLightCmd_0 "unsigned integer 8bit" UBYTE VW_BCM_CompuMethods_SC_F1_O0_UNoUnit 1 100 0.0 255.0 MAX_REFRESH 4 1 ECU_ADDRESS 0x400E3ADD /end MEASUREMENT
/begin MEASUREMENT MCore_StMon_387 "" UBYTE DefaultIdenticalCompu 1 100 0.0 255.0 MAX_REFRESH 4 1 ECU_ADDRESS 0x400E3ADE
 /begin ANNOTATION ANNOTATION_LABEL "Description (coming from AUTOSAR DESC field)"
  /begin ANNOTATION_TEXT "Application data type for error type data elements. Error types are bit coded\r\n" /end ANNOTATION_TEXT
 /end ANNOTATION
/end MEASUREMENT
/begin MEASUREMENT MCore_Unconnected_DeLowBeamStateLed "" UBYTE Methods_boolean 1 100 0.0 255.0 MAX_REFRESH 4 1 ECU_ADDRESS 0x400E3275 /end MEASUREMENT
/begin MEASUREMENT MCore_DeDRLCmd "Boolean" UBYTE Methods_boolean 1 100 0.0 1.0 MAX_REFRESH 4 1 ECU_ADDRESS 0x400E3AE3 /end MEASUREMENT
/begin MEASUREMENT MCore_DeSideMarkerCmd "Boolean" UBYTE Methods_boolean 1 100 0.0 1.0 MAX_REFRESH 4 1 ECU_ADDRESS 0x400E3AE4 /end MEASUREMENT
/begin MEASUREMENT MCore_DePlateLightCmd "Boolean" UBYTE Methods_boolean 1 100 0.0 1.0 MAX_REFRESH 4 1 ECU_ADDRESS 0x400E3AE5 /end MEASUREMENT
/begin MEASUREMENT MCore_AutoParkButtonSts "unsigned integer 8bit" UBYTE VW_BCM_CompuMethods_SC_F1_O0_UNoUnit 1 100 0.0 255.0 MAX_REFRESH 4 1 ECU_ADDRESS 0x400E3276 /end MEASUREMENT
/begin MEASUREMENT MCore_GloveBoxLockEnable "Boolean" UBYTE Methods_boolean 1 100 0.0 1.0 MAX_REFRESH 4 1 ECU_ADDRESS 0x400E3AE6 /end MEASUREMENT
/begin MEASUREMENT MCore_DeGloveboxOpenCmd_Int "Boolean" UBYTE Methods_boolean 1 100 0.0 1.0 MAX_REFRESH 4 1 ECU_ADDRESS 0x400AB3A1 /end MEASUREMENT
/begin MEASUREMENT MCore_VF267_Glovebox_open "unsigned integer 8bit" UBYTE VW_BCM_CompuMethods_SC_F1_O0_UNoUnit 1 100 0.0 255.0 MAX_REFRESH 4 1 ECU_ADDRESS 0x400AB3A2 /end MEASUREMENT
/begin MEASUREMENT MCore_VF267_SBMT_Enable_Glovebox "unsigned integer 8bit" UBYTE VW_BCM_CompuMethods_SC_F1_O0_UNoUnit 1 100 0.0 255.0 MAX_REFRESH 4 1 ECU_ADDRESS 0x400E3AE7 /end MEASUREMENT
/begin MEASUREMENT MCore_TesterValue_53 "Boolean" UBYTE Methods_boolean 1 100 0.0 1.0 MAX_REFRESH 4 1 ECU_ADDRESS 0x400E3AE9 /end MEASUREMENT
/begin MEASUREMENT MCore_TesterValue_54 "Boolean" UBYTE Methods_boolean 1 100 0.0 1.0 MAX_REFRESH 4 1 ECU_ADDRESS 0x400E3AEB /end MEASUREMENT
/begin MEASUREMENT MCore_TesterValue_55 "Boolean" UBYTE Methods_boolean 1 100 0.0 1.0 MAX_REFRESH 4 1 ECU_ADDRESS 0x400E3AED /end MEASUREMENT
/begin MEASUREMENT MCore_VF301_STS_DRS_VPSTrunkSts "unsigned integer 8bit" UBYTE VW_BCM_CompuMethods_SC_F1_O0_UNoUnit 1 100 0.0 255.0 MAX_REFRESH 4 1 ECU_ADDRESS 0x400E3AEE /end MEASUREMENT
/begin MEASUREMENT MCore_VF301_EngineBonnetSts_0 "Boolean" UBYTE Methods_boolean 1 100 0.0 1.0 MAX_REFRESH 4 1 ECU_ADDRESS 0x400E3277 /end MEASUREMENT
/begin MEASUREMENT MCore_VF301_EngineBonnetSts_LH_0 "" UBYTE VF301_CompuMethod_CM_HatchSts 1 100 0.0 255.0 MAX_REFRESH 4 1 ECU_ADDRESS 0x400E3AF0 /end MEASUREMENT
/begin MEASUREMENT MCore_VF301_FHatchSts "Boolean" UBYTE Methods_boolean 1 100 0.0 1.0 MAX_REFRESH 4 1 ECU_ADDRESS 0x400E3AF1 /end MEASUREMENT
/begin MEASUREMENT MCore_Unconnected_VF_FeedbackBackLight "Boolean" UBYTE Methods_boolean 1 100 0.0 1.0 MAX_REFRESH 4 1 ECU_ADDRESS 0x400E3278 /end MEASUREMENT
/begin MEASUREMENT MCore_VF301_TGL_Motor_0 "unsigned integer 8bit" UBYTE VW_BCM_CompuMethods_SC_F1_O0_UNoUnit 1 100 0.0 255.0 MAX_REFRESH 4 1 ECU_ADDRESS 0x400E3AF2 /end MEASUREMENT
/begin MEASUREMENT MCore_Unconnected_DF_Sts "Boolean" UBYTE Methods_boolean 1 100 0.0 1.0 MAX_REFRESH 4 1 ECU_ADDRESS 0x400E327A /end MEASUREMENT
/begin MEASUREMENT MCore_Unconnected_SA_Sts "Boolean" UBYTE Methods_boolean 1 100 0.0 1.0 MAX_REFRESH 4 1 ECU_ADDRESS 0x400E327B /end MEASUREMENT
/begin MEASUREMENT MCore_Unconnected_SK_Sts "Boolean" UBYTE Methods_boolean 1 100 0.0 1.0 MAX_REFRESH 4 1 ECU_ADDRESS 0x400E3279 /end MEASUREMENT
/begin MEASUREMENT MCore_VF301_STS_DRS_VPSTrunkSts_0 "unsigned integer 8bit" UBYTE VW_BCM_CompuMethods_SC_F1_O0_UNoUnit 1 100 0.0 255.0 MAX_REFRESH 4 1 ECU_ADDRESS 0x400AB3A5 /end MEASUREMENT
/begin MEASUREMENT MCore_DeTrunkExtCntrl "Boolean" UBYTE Methods_boolean 1 100 0.0 1.0 MAX_REFRESH 4 1 ECU_ADDRESS 0x400E3AF3 /end MEASUREMENT
/begin MEASUREMENT MCore_Unconnected_DeTrunkExternalButton "Boolean" UBYTE Methods_boolean 1 100 0.0 1.0 MAX_REFRESH 4 1 ECU_ADDRESS 0x400E3283 /end MEASUREMENT
/begin MEASUREMENT MCore_DeTrunkFOBSearchRequest "" UBYTE VF301_CompuMethod_CM_TrunkFOBSearchRequest 1 100 0.0 255.0 MAX_REFRESH 4 1 ECU_ADDRESS 0x400D9210 /end MEASUREMENT
/begin MEASUREMENT MCore_DeTrunkFailSts "Boolean" UBYTE Methods_boolean 1 100 0.0 1.0 MAX_REFRESH 4 1 ECU_ADDRESS 0x400E3AF4 /end MEASUREMENT
/begin MEASUREMENT MCore_DeTrunkInternalButton "Boolean" UBYTE Methods_boolean 1 100 0.0 1.0 MAX_REFRESH 4 1 ECU_ADDRESS 0x400E3AF5 /end MEASUREMENT
/begin MEASUREMENT MCore_DeTrunkSts "Boolean" UBYTE Methods_boolean 1 100 0.0 1.0 MAX_REFRESH 4 1 ECU_ADDRESS 0x52800071 /end MEASUREMENT
/begin MEASUREMENT MCore_Unconnected_VF301_EngineBonnetSts_2 "Boolean" UBYTE Methods_boolean 1 100 0.0 1.0 MAX_REFRESH 4 1 ECU_ADDRESS 0x400E3284 /end MEASUREMENT
/begin MEASUREMENT MCore_DeVPSTrDoorLockCtrl "Boolean" UBYTE Methods_boolean 1 100 0.0 1.0 MAX_REFRESH 4 1 ECU_ADDRESS 0x400E3AF6 /end MEASUREMENT
/begin MEASUREMENT MCore_VF301_VPSTrunkSts_0 "unsigned integer 8bit" UBYTE VW_BCM_CompuMethods_SC_F1_O0_UNoUnit 1 100 0.0 255.0 MAX_REFRESH 4 1 ECU_ADDRESS 0x400E3AF7 /end MEASUREMENT
/begin MEASUREMENT MCore_VF506_EDriveSts_0 "" UBYTE DefaultIdenticalCompu 1 100 0.0 255.0 MAX_REFRESH 4 1 ECU_ADDRESS 0x52800072 /end MEASUREMENT
/begin MEASUREMENT MCore_VF506_EngineSts_0 "" UBYTE DefaultIdenticalCompu 1 100 0.0 255.0 MAX_REFRESH 4 1 ECU_ADDRESS 0x52800073 /end MEASUREMENT
/begin MEASUREMENT MCore_VF506_StopStartSts "" UBYTE DefaultIdenticalCompu 1 100 0.0 255.0 MAX_REFRESH 4 1 ECU_ADDRESS 0x52800074 /end MEASUREMENT
/begin MEASUREMENT MCore_Unconnected_VF506_BCANAutoStopEnableSts "" UBYTE Methods_boolean 1 100 0.0 255.0 MAX_REFRESH 4 1 ECU_ADDRESS 0x400E3285 /end MEASUREMENT
/begin MEASUREMENT MCore_Unconnected_VF506_BCANAutoStopFailSts "" UBYTE VF506_DataType_DataTypeSemantics_CM_BCANAutoStopFailSts 1 100 0.0 255.0 MAX_REFRESH 4 1 ECU_ADDRESS 0x400E3286 /end MEASUREMENT
/begin MEASUREMENT MCore_Unconnected_VF506_BCANAutoStopStaySts "" UBYTE Methods_boolean 1 100 0.0 255.0 MAX_REFRESH 4 1 ECU_ADDRESS 0x400E3287 /end MEASUREMENT
/begin MEASUREMENT MCore_VF506_NBCStopStartButtonSts "" UBYTE Methods_boolean 1 100 0.0 255.0 MAX_REFRESH 4 1 ECU_ADDRESS 0x528081E0 /end MEASUREMENT
/begin MEASUREMENT MCore_VF506_StopStartActivationSts "" UBYTE Methods_boolean 1 100 0.0 255.0 MAX_REFRESH 4 1 ECU_ADDRESS 0x528081E1 /end MEASUREMENT
/begin MEASUREMENT MCore_NPS_NPS_StopStartButtonSts "Boolean" UBYTE Methods_boolean 1 100 0.0 1.0 MAX_REFRESH 4 1 ECU_ADDRESS 0x5280D392 /end MEASUREMENT
/begin MEASUREMENT MCore_NPS_StopStartButtonValidData "Boolean" UBYTE Methods_boolean 1 100 0.0 1.0 MAX_REFRESH 4 1 ECU_ADDRESS 0x5280D393 /end MEASUREMENT
/begin MEASUREMENT MCore_NCP_NCPAutoStopEnableSts "Boolean" UBYTE Methods_boolean 1 100 0.0 1.0 MAX_REFRESH 4 1 ECU_ADDRESS 0x5280D397 /end MEASUREMENT
/begin MEASUREMENT MCore_NCP_NCPAutoStopFailSts "Boolean" UBYTE Methods_boolean 1 100 0.0 1.0 MAX_REFRESH 4 1 ECU_ADDRESS 0x5280D398 /end MEASUREMENT
/begin MEASUREMENT MCore_NCP_NCPAutoStopStaySts "Boolean" UBYTE Methods_boolean 1 100 0.0 1.0 MAX_REFRESH 4 1 ECU_ADDRESS 0x5280D399 /end MEASUREMENT
/begin MEASUREMENT MCore_StMon_388 "" UBYTE DefaultIdenticalCompu 1 100 0.0 255.0 MAX_REFRESH 4 1 ECU_ADDRESS 0x400E3AFB
 /begin ANNOTATION ANNOTATION_LABEL "Description (coming from AUTOSAR DESC field)"
  /begin ANNOTATION_TEXT "Application data type for error type data elements. Error types are bit coded\r\n" /end ANNOTATION_TEXT
 /end ANNOTATION
/end MEASUREMENT
/begin MEASUREMENT MCore_StMon_389 "" UBYTE DefaultIdenticalCompu 1 100 0.0 255.0 MAX_REFRESH 4 1 ECU_ADDRESS 0x400E3AFC
 /begin ANNOTATION ANNOTATION_LABEL "Description (coming from AUTOSAR DESC field)"
  /begin ANNOTATION_TEXT "Application data type for error type data elements. Error types are bit coded\r\n" /end ANNOTATION_TEXT
 /end ANNOTATION
/end MEASUREMENT
/begin MEASUREMENT MCore_DeCIDOnBoard_0 "" UBYTE Methods_boolean 1 100 0.0 255.0 MAX_REFRESH 4 1 ECU_ADDRESS 0x400E3AFD /end MEASUREMENT
/begin MEASUREMENT MCore_DeEngineOnFobLeftVeh "" UBYTE Methods_boolean 1 100 0.0 255.0 MAX_REFRESH 4 1 ECU_ADDRESS 0x528081E2
 /begin ANNOTATION ANNOTATION_LABEL "Description (coming from AUTOSAR DESC field)"
  /begin ANNOTATION_TEXT "Boolean has the value space required to support the mathematical concept of binary-valued logic: {true, false}.\r\n" /end ANNOTATION_TEXT
 /end ANNOTATION
/end MEASUREMENT
/begin MEASUREMENT MCore_Unconnected_CeilingSts "Boolean" UBYTE Methods_boolean 1 100 0.0 1.0 MAX_REFRESH 4 1 ECU_ADDRESS 0x400E328D /end MEASUREMENT
/begin MEASUREMENT MCore_Unconnected_KeySts "Boolean" UBYTE Methods_boolean 1 100 0.0 1.0 MAX_REFRESH 4 1 ECU_ADDRESS 0x400E328C /end MEASUREMENT
/begin MEASUREMENT MCore_IRV_Rec_CMD_NIT_NBC_Trig_SETUP_NBC "unsigned integer 8bit" UBYTE VW_BCM_CompuMethods_SC_F1_O0_UNoUnit 1 100 0.0 255.0 MAX_REFRESH 4 1 ECU_ADDRESS 0x528080D1 /end MEASUREMENT
/begin MEASUREMENT MCore_Unconnected_NAMEnable "Boolean" UBYTE Methods_boolean 1 100 0.0 1.0 MAX_REFRESH 4 1 ECU_ADDRESS 0x400E328E /end MEASUREMENT
/begin MEASUREMENT MCore_DeChargingFOBSearchRequest "" UBYTE VF301_CompuMethod_CM_TrunkFOBSearchRequest 1 100 0.0 255.0 MAX_REFRESH 4 1 ECU_ADDRESS 0x400E3B0B /end MEASUREMENT
/begin MEASUREMENT MCore_De_HW_HornActuator "" UBYTE VF834_CompuMethod_CM_HornActivation 1 100 0.0 255.0 MAX_REFRESH 4 1 ECU_ADDRESS 0x400E3B0C /end MEASUREMENT
/begin MEASUREMENT MCore_NewFuncReq_Horn "" UBYTE VF834_CompuMethod_CM_HornActivation 1 100 0.0 255.0 MAX_REFRESH 4 1 ECU_ADDRESS 0x400E3B0D /end MEASUREMENT
/begin MEASUREMENT MCore_TesterValue_56 "Boolean" UBYTE Methods_boolean 1 100 0.0 1.0 MAX_REFRESH 4 1 ECU_ADDRESS 0x400E3B0F /end MEASUREMENT
/begin MEASUREMENT MCore_StMon_390 "" UBYTE DefaultIdenticalCompu 1 100 0.0 255.0 MAX_REFRESH 4 1 ECU_ADDRESS 0x400E3B10
 /begin ANNOTATION ANNOTATION_LABEL "Description (coming from AUTOSAR DESC field)"
  /begin ANNOTATION_TEXT "Application data type for error type data elements. Error types are bit coded\r\n" /end ANNOTATION_TEXT
 /end ANNOTATION
/end MEASUREMENT
/begin MEASUREMENT MCore_VehicleNotInUse_0 "unsigned integer 8bit" UBYTE VW_BCM_CompuMethods_SC_F1_O0_UNoUnit 1 100 0.0 255.0 MAX_REFRESH 4 1 ECU_ADDRESS 0x400E3B11 /end MEASUREMENT
/begin MEASUREMENT MCore_Unconnected_WindStopperSts "unsigned integer 8bit" UBYTE VW_BCM_CompuMethods_SC_F1_O0_UNoUnit 1 100 0.0 255.0 MAX_REFRESH 4 1 ECU_ADDRESS 0x400E3296 /end MEASUREMENT
/begin MEASUREMENT MCore_Unconnected_DeMotUnlckWindStopPowerSupply_0 "Boolean" UBYTE Methods_boolean 1 100 0.0 1.0 MAX_REFRESH 4 1 ECU_ADDRESS 0x400E3297 /end MEASUREMENT
/begin MEASUREMENT MCore_Unconnected_DeMotUNlckRiOrFifthWall_0 "Boolean" UBYTE Methods_boolean 1 100 0.0 1.0 MAX_REFRESH 4 1 ECU_ADDRESS 0x400E3299 /end MEASUREMENT
/begin MEASUREMENT MCore_Unconnected_DeMotUnlckLeOrWindStop_0 "Boolean" UBYTE Methods_boolean 1 100 0.0 1.0 MAX_REFRESH 4 1 ECU_ADDRESS 0x400E3298 /end MEASUREMENT
/begin MEASUREMENT MCore_TesterValue_57 "Boolean" UBYTE Methods_boolean 1 100 0.0 1.0 MAX_REFRESH 4 1 ECU_ADDRESS 0x400E3B13 /end MEASUREMENT
/begin MEASUREMENT MCore_TesterValue_58 "Boolean" UBYTE Methods_boolean 1 100 0.0 1.0 MAX_REFRESH 4 1 ECU_ADDRESS 0x400E3B15 /end MEASUREMENT
/begin MEASUREMENT MCore_Unconnected_TesterValue_59 "Boolean" UBYTE Methods_boolean 1 100 0.0 1.0 MAX_REFRESH 4 1 ECU_ADDRESS 0x400E329A /end MEASUREMENT
/begin MEASUREMENT MCore_LeftRearSeatFoldingCmd_info "Boolean" UBYTE Methods_boolean 1 100 0.0 1.0 MAX_REFRESH 4 1 ECU_ADDRESS 0x400E3B16 /end MEASUREMENT
/begin MEASUREMENT MCore_RightRearSeatFoldingCmd_info "Boolean" UBYTE Methods_boolean 1 100 0.0 1.0 MAX_REFRESH 4 1 ECU_ADDRESS 0x400E3B17 /end MEASUREMENT
/begin MEASUREMENT MCore_LeftRearBackrestUnlock "Boolean" UBYTE Methods_boolean 1 100 0.0 1.0 MAX_REFRESH 4 1 ECU_ADDRESS 0x400E3B18 /end MEASUREMENT
/begin MEASUREMENT MCore_RightRearBackrestUnlock "Boolean" UBYTE Methods_boolean 1 100 0.0 1.0 MAX_REFRESH 4 1 ECU_ADDRESS 0x400E3B19 /end MEASUREMENT
/begin MEASUREMENT MCore_RequestActive_66 "Boolean" UBYTE Methods_boolean 1 100 0.0 1.0 MAX_REFRESH 4 1 ECU_ADDRESS 0x400E3B22 /end MEASUREMENT
/begin MEASUREMENT MCore_RequestValue_59 "Boolean" UBYTE Methods_boolean 1 100 0.0 1.0 MAX_REFRESH 4 1 ECU_ADDRESS 0x400E3B23 /end MEASUREMENT
/begin MEASUREMENT MCore_OSC_ErrMonFb_71 "unsigned integer 8bit" UBYTE VW_BCM_CompuMethods_SC_F1_O0_UNoUnit 1 100 0.0 255.0 MAX_REFRESH 4 1 ECU_ADDRESS 0x400E3B24 /end MEASUREMENT
/begin MEASUREMENT MCore_DeNightDaySts_for_IE "" UBYTE Methods_boolean 1 100 0.0 255.0 MAX_REFRESH 4 1 ECU_ADDRESS 0x400E3B25 /end MEASUREMENT
/begin MEASUREMENT MCore_VF506_EngineSts_1 "" UBYTE DefaultIdenticalCompu 1 100 0.0 255.0 MAX_REFRESH 4 1 ECU_ADDRESS 0x400E3B26 /end MEASUREMENT
/begin MEASUREMENT MCore_VF506_StopStartSts_0 "" UBYTE DefaultIdenticalCompu 1 100 0.0 255.0 MAX_REFRESH 4 1 ECU_ADDRESS 0x400E3B27 /end MEASUREMENT
/begin MEASUREMENT MCore_SteeringRimHeaterCmd "Boolean" UBYTE CompuMethods_boolean 1 100 0.0 255.0 MAX_REFRESH 4 1 ECU_ADDRESS 0x400E3B28 /end MEASUREMENT
/begin MEASUREMENT MCore_TesterValue_60 "Boolean" UBYTE Methods_boolean 1 100 0.0 1.0 MAX_REFRESH 4 1 ECU_ADDRESS 0x400E3B2A /end MEASUREMENT
/begin MEASUREMENT MCore_MKFFailSts "Boolean" UBYTE Methods_boolean 1 100 0.0 1.0 MAX_REFRESH 4 1 ECU_ADDRESS 0x400E3B2B /end MEASUREMENT
/begin MEASUREMENT MCore_MKF_DimmingLevelRoof1 "unsigned integer 8bit" UBYTE VW_BCM_CompuMethods_SC_F1_O0_UNoUnit 1 100 0.0 255.0 MAX_REFRESH 4 1 ECU_ADDRESS 0x400E3B2C /end MEASUREMENT
/begin MEASUREMENT MCore_MKF_DimmingLevelRoof2 "unsigned integer 8bit" UBYTE VW_BCM_CompuMethods_SC_F1_O0_UNoUnit 1 100 0.0 255.0 MAX_REFRESH 4 1 ECU_ADDRESS 0x400E3B2D /end MEASUREMENT
/begin MEASUREMENT MCore_MKF_DimmingLevelRoof3 "unsigned integer 8bit" UBYTE VW_BCM_CompuMethods_SC_F1_O0_UNoUnit 1 100 0.0 255.0 MAX_REFRESH 4 1 ECU_ADDRESS 0x400E3B2E /end MEASUREMENT
/begin MEASUREMENT MCore_MKF_DimmingLevelRoof4 "unsigned integer 8bit" UBYTE VW_BCM_CompuMethods_SC_F1_O0_UNoUnit 1 100 0.0 255.0 MAX_REFRESH 4 1 ECU_ADDRESS 0x400E3B2F /end MEASUREMENT
/begin MEASUREMENT MCore_MKF_DimmingLevelRoof5 "unsigned integer 8bit" UBYTE VW_BCM_CompuMethods_SC_F1_O0_UNoUnit 1 100 0.0 255.0 MAX_REFRESH 4 1 ECU_ADDRESS 0x400E3B30 /end MEASUREMENT
/begin MEASUREMENT MCore_MKF_DimmingLevelRoof6 "unsigned integer 8bit" UBYTE VW_BCM_CompuMethods_SC_F1_O0_UNoUnit 1 100 0.0 255.0 MAX_REFRESH 4 1 ECU_ADDRESS 0x400E3B31 /end MEASUREMENT
/begin MEASUREMENT MCore_MKRFailSts "Boolean" UBYTE Methods_boolean 1 100 0.0 1.0 MAX_REFRESH 4 1 ECU_ADDRESS 0x400E3B32 /end MEASUREMENT
/begin MEASUREMENT MCore_MKR_DimmingLevelRoof1 "unsigned integer 8bit" UBYTE VW_BCM_CompuMethods_SC_F1_O0_UNoUnit 1 100 0.0 255.0 MAX_REFRESH 4 1 ECU_ADDRESS 0x400E3B33 /end MEASUREMENT
/begin MEASUREMENT MCore_MKR_DimmingLevelRoof2 "unsigned integer 8bit" UBYTE VW_BCM_CompuMethods_SC_F1_O0_UNoUnit 1 100 0.0 255.0 MAX_REFRESH 4 1 ECU_ADDRESS 0x400E3B34 /end MEASUREMENT
/begin MEASUREMENT MCore_MKR_DimmingLevelRoof3 "unsigned integer 8bit" UBYTE VW_BCM_CompuMethods_SC_F1_O0_UNoUnit 1 100 0.0 255.0 MAX_REFRESH 4 1 ECU_ADDRESS 0x400E3B35 /end MEASUREMENT
/begin MEASUREMENT MCore_MKR_DimmingLevelRoof4 "unsigned integer 8bit" UBYTE VW_BCM_CompuMethods_SC_F1_O0_UNoUnit 1 100 0.0 255.0 MAX_REFRESH 4 1 ECU_ADDRESS 0x400E3B36 /end MEASUREMENT
/begin MEASUREMENT MCore_MKR_DimmingLevelRoof5 "unsigned integer 8bit" UBYTE VW_BCM_CompuMethods_SC_F1_O0_UNoUnit 1 100 0.0 255.0 MAX_REFRESH 4 1 ECU_ADDRESS 0x400E3B37 /end MEASUREMENT
/begin MEASUREMENT MCore_MKR_DimmingLevelRoof6 "unsigned integer 8bit" UBYTE VW_BCM_CompuMethods_SC_F1_O0_UNoUnit 1 100 0.0 255.0 MAX_REFRESH 4 1 ECU_ADDRESS 0x400E3B38 /end MEASUREMENT
/begin MEASUREMENT MCore_DeBatteryVoltageADSample "" UWORD DefaultIdenticalCompu 1 100 0.0 65535.0 MAX_REFRESH 4 1 ECU_ADDRESS 0x5280808A /end MEASUREMENT
/begin MEASUREMENT MCore_tDiagnoseverbotNachStart_0 "unsigned integer 8bit" UBYTE VW_BCM_CompuMethods_SC_F1_O0_USec 1 100 0.0 255.0 MAX_REFRESH 4 1 ECU_ADDRESS 0x5280D39A /end MEASUREMENT
/begin MEASUREMENT MCore_tSpannungsfehler_0 "unsigned integer 8bit" UBYTE VW_BCM_CompuMethods_SC_F1_O0_UNoUnit 1 100 0.0 255.0 MAX_REFRESH 4 1 ECU_ADDRESS 0x5280D39B /end MEASUREMENT
/begin MEASUREMENT MCore_Unconnected_USGSpannung_HighRes "unsigned integer 16bit" UWORD VW_BCM_CompuMethods_SC_F0pt001_O0_UVolt 1 100 0.0 65.535 MAX_REFRESH 4 1 ECU_ADDRESS 0x400E2F48 /end MEASUREMENT
/begin MEASUREMENT MCore_UKl30L "unsigned integer 8bit" UBYTE VW_BCM_CompuMethods_SC_F0pt1_O0_UVolt 1 100 0.0 25.5 MAX_REFRESH 4 1 ECU_ADDRESS 0x400E32AA /end MEASUREMENT
/begin MEASUREMENT MCore_UKl30P "unsigned integer 8bit" UBYTE VW_BCM_CompuMethods_SC_F0pt1_O0_UVolt 1 100 0.0 25.5 MAX_REFRESH 4 1 ECU_ADDRESS 0x400E32AC /end MEASUREMENT
/begin MEASUREMENT MCore_UKl30R "unsigned integer 8bit" UBYTE VW_BCM_CompuMethods_SC_F0pt1_O0_UVolt 1 100 0.0 25.5 MAX_REFRESH 4 1 ECU_ADDRESS 0x400E32AB /end MEASUREMENT
/begin MEASUREMENT MCore_USGSpannung_0 "unsigned integer 8bit" UBYTE VW_BCM_CompuMethods_SC_F0pt1_O0_UVolt 1 100 0.0 25.5 MAX_REFRESH 4 1 ECU_ADDRESS 0x400AB3AC /end MEASUREMENT
/begin MEASUREMENT MCore_bStSGUeberspannung "Boolean" UBYTE Methods_boolean 1 100 0.0 1.0 MAX_REFRESH 4 1 ECU_ADDRESS 0x400E32A7 /end MEASUREMENT
/begin MEASUREMENT MCore_bStSGUeberspannungDiag "Boolean" UBYTE Methods_boolean 1 100 0.0 1.0 MAX_REFRESH 4 1 ECU_ADDRESS 0x400E32A8 /end MEASUREMENT
/begin MEASUREMENT MCore_bStSGUnterspannung "Boolean" UBYTE Methods_boolean 1 100 0.0 1.0 MAX_REFRESH 4 1 ECU_ADDRESS 0x400E32A5 /end MEASUREMENT
/begin MEASUREMENT MCore_bStSGUnterspannungDiag "Boolean" UBYTE Methods_boolean 1 100 0.0 1.0 MAX_REFRESH 4 1 ECU_ADDRESS 0x400E32A6 /end MEASUREMENT
/begin MEASUREMENT MCore_bStSGUnterspannungMotorstart "Boolean" UBYTE Methods_boolean 1 100 0.0 1.0 MAX_REFRESH 4 1 ECU_ADDRESS 0x400AB3AD /end MEASUREMENT
/begin MEASUREMENT MCore_bStVoltageOutOfRange "Boolean" UBYTE Methods_boolean 1 100 0.0 1.0 MAX_REFRESH 4 1 ECU_ADDRESS 0x52800076
 /begin ANNOTATION ANNOTATION_LABEL "Description (coming from AUTOSAR DESC field)" /begin ANNOTATION_TEXT "Voltage out of range\r\n" /end ANNOTATION_TEXT /end ANNOTATION
/end MEASUREMENT
/begin MEASUREMENT MCore_enUKl30LErrSt "unsigned integer 8bit" UBYTE VW_BCM_CompuMethods_CM_TXTenUKl30LErrSt 1 100 0.0 255.0 MAX_REFRESH 4 1 ECU_ADDRESS 0x400AB3AE /end MEASUREMENT
/begin MEASUREMENT MCore_enUKl30PErrSt "unsigned integer 8bit" UBYTE VW_BCM_CompuMethods_CM_TXTenUKl30PErrSt 1 100 0.0 255.0 MAX_REFRESH 4 1 ECU_ADDRESS 0x400AB3AF /end MEASUREMENT
/begin MEASUREMENT MCore_enUKl30RErrSt "unsigned integer 8bit" UBYTE VW_BCM_CompuMethods_CM_TXTenUKl30RErrSt 1 100 0.0 255.0 MAX_REFRESH 4 1 ECU_ADDRESS 0x400AB3B0 /end MEASUREMENT
/begin MEASUREMENT MCore_rSpannungKl30 "unsigned integer 8bit" UBYTE VW_BCM_CompuMethods_SC_F1_O0_UNoUnit 1 100 0.0 255.0 MAX_REFRESH 4 1 ECU_ADDRESS 0x400E32A9 /end MEASUREMENT
/begin MEASUREMENT MCore_Unconnected_bBremslichtschalter "Boolean" UBYTE Methods_boolean 1 100 0.0 1.0 MAX_REFRESH 4 1 ECU_ADDRESS 0x400E32AD /end MEASUREMENT
/begin MEASUREMENT MCore_Unconnected_bStTaster1Hw "Boolean" UBYTE Methods_boolean 1 100 0.0 1.0 MAX_REFRESH 4 1 ECU_ADDRESS 0x400E32AE /end MEASUREMENT
/begin MEASUREMENT MCore_Unconnected_bStTaster2Hw "Boolean" UBYTE Methods_boolean 1 100 0.0 1.0 MAX_REFRESH 4 1 ECU_ADDRESS 0x400E32AF /end MEASUREMENT
/begin MEASUREMENT MCore_Unconnected_bStTaster3Hw "Boolean" UBYTE Methods_boolean 1 100 0.0 1.0 MAX_REFRESH 4 1 ECU_ADDRESS 0x400E32B0 /end MEASUREMENT
/begin MEASUREMENT MCore_Unconnected_bStTaster4Hw "Boolean" UBYTE Methods_boolean 1 100 0.0 1.0 MAX_REFRESH 4 1 ECU_ADDRESS 0x400E32B1 /end MEASUREMENT
/begin MEASUREMENT MCore_Unconnected_rasDataSenH "unsigned integer 16bit" UWORD VW_BCM_CompuMethods_SC_F1_O0_UNoUnit 1 100 0.0 65535.0 MAX_REFRESH 4 1 ECU_ADDRESS 0x400E2F4C /end MEASUREMENT
/begin MEASUREMENT MCore_Unconnected_rawDataSenV "unsigned integer 16bit" UWORD VW_BCM_CompuMethods_SC_F1_O0_UNoUnit 1 100 0.0 65535.0 MAX_REFRESH 4 1 ECU_ADDRESS 0x400E2F4A /end MEASUREMENT
/begin MEASUREMENT MCore_DeElectrochromic_Level "" UWORD DefaultIdenticalCompu 1 100 0.0 65535.0 MAX_REFRESH 4 1 ECU_ADDRESS 0x400E2F4E /end MEASUREMENT
/begin MEASUREMENT MCore_ErrAdcKl30L "unsigned integer 8bit" UBYTE VW_BCM_CompuMethods_SC_F1_O0_UNoUnit 1 100 0.0 255.0 MAX_REFRESH 4 1 ECU_ADDRESS 0x400AB35A /end MEASUREMENT
/begin MEASUREMENT MCore_ErrAdcKl30P "unsigned integer 8bit" UBYTE VW_BCM_CompuMethods_SC_F1_O0_UNoUnit 1 100 0.0 255.0 MAX_REFRESH 4 1 ECU_ADDRESS 0x400AB35B /end MEASUREMENT
/begin MEASUREMENT MCore_ErrAdcKl30R "unsigned integer 8bit" UBYTE VW_BCM_CompuMethods_SC_F1_O0_UNoUnit 1 100 0.0 255.0 MAX_REFRESH 4 1 ECU_ADDRESS 0x400AB35C /end MEASUREMENT
/begin MEASUREMENT MCore_Kl30Dwa "unsigned integer 16bit" UWORD VW_BCM_CompuMethods_SC_F1_O0_UNoUnit 1 100 0.0 65535.0 MAX_REFRESH 4 1 ECU_ADDRESS 0x400E2F88 /end MEASUREMENT
/begin MEASUREMENT MCore_Kl30K "unsigned integer 16bit" UWORD VW_BCM_CompuMethods_SC_F1_O0_UNoUnit 1 100 0.0 65535.0 MAX_REFRESH 4 1 ECU_ADDRESS 0x400D90EC /end MEASUREMENT
/begin MEASUREMENT MCore_Kl30L "unsigned integer 16bit" UWORD VW_BCM_CompuMethods_SC_F1_O0_UNoUnit 1 100 0.0 65535.0 MAX_REFRESH 4 1 ECU_ADDRESS 0x400E2F8A /end MEASUREMENT
/begin MEASUREMENT MCore_Kl30P "unsigned integer 16bit" UWORD VW_BCM_CompuMethods_SC_F1_O0_UNoUnit 1 100 0.0 65535.0 MAX_REFRESH 4 1 ECU_ADDRESS 0x400E2F8C /end MEASUREMENT
/begin MEASUREMENT MCore_Kl30R "unsigned integer 16bit" UWORD VW_BCM_CompuMethods_SC_F1_O0_UNoUnit 1 100 0.0 65535.0 MAX_REFRESH 4 1 ECU_ADDRESS 0x400E2F8E /end MEASUREMENT
/begin MEASUREMENT MCore_Kl30Red "unsigned integer 16bit" UWORD VW_BCM_CompuMethods_SC_F1_O0_UNoUnit 1 100 0.0 65535.0 MAX_REFRESH 4 1 ECU_ADDRESS 0x400D90EE /end MEASUREMENT
/begin MEASUREMENT MCore_Kl30Zv "unsigned integer 16bit" UWORD VW_BCM_CompuMethods_SC_F1_O0_UNoUnit 1 100 0.0 65535.0 MAX_REFRESH 4 1 ECU_ADDRESS 0x400E2F90 /end MEASUREMENT
/begin MEASUREMENT MCore_bKl15_1_zas "Boolean" UBYTE Methods_boolean 1 100 0.0 1.0 MAX_REFRESH 4 1 ECU_ADDRESS 0x5280003D /end MEASUREMENT
/begin MEASUREMENT MCore_bKl15_1_zat "Boolean" UBYTE Methods_boolean 1 100 0.0 1.0 MAX_REFRESH 4 1 ECU_ADDRESS 0x52808182 /end MEASUREMENT
/begin MEASUREMENT MCore_bKl15_2_zas "Boolean" UBYTE Methods_boolean 1 100 0.0 1.0 MAX_REFRESH 4 1 ECU_ADDRESS 0x5280003E /end MEASUREMENT
/begin MEASUREMENT MCore_bKl15_2_zat "Boolean" UBYTE Methods_boolean 1 100 0.0 1.0 MAX_REFRESH 4 1 ECU_ADDRESS 0x52808183 /end MEASUREMENT
/begin MEASUREMENT MCore_bKlS_zas "Boolean" UBYTE Methods_boolean 1 100 0.0 1.0 MAX_REFRESH 4 1 ECU_ADDRESS 0x5280003F /end MEASUREMENT
/begin MEASUREMENT MCore_bStartwunsch_zas "Boolean" UBYTE Methods_boolean 1 100 0.0 1.0 MAX_REFRESH 4 1 ECU_ADDRESS 0x52800040 /end MEASUREMENT
/begin MEASUREMENT MCore_enKl15_1_zasErrSt "unsigned integer 8bit" UBYTE VW_BCM_CompuMethods_CM_TXTenErrStatus 1 100 0.0 255.0 MAX_REFRESH 4 1 ECU_ADDRESS 0x52808184 /end MEASUREMENT
/begin MEASUREMENT MCore_enKl15_1_zatErrSt "unsigned integer 8bit" UBYTE VW_BCM_CompuMethods_CM_TXTenErrStatus 1 100 0.0 255.0 MAX_REFRESH 4 1 ECU_ADDRESS 0x52808185 /end MEASUREMENT
/begin MEASUREMENT MCore_enKl15_2_zasErrSt "unsigned integer 8bit" UBYTE VW_BCM_CompuMethods_CM_TXTenErrStatus 1 100 0.0 255.0 MAX_REFRESH 4 1 ECU_ADDRESS 0x52808186 /end MEASUREMENT
/begin MEASUREMENT MCore_enKl15_2_zatErrSt "unsigned integer 8bit" UBYTE VW_BCM_CompuMethods_CM_TXTenErrStatus 1 100 0.0 255.0 MAX_REFRESH 4 1 ECU_ADDRESS 0x52808187 /end MEASUREMENT
/begin MEASUREMENT MCore_enKlS_zasErrSt "unsigned integer 8bit" UBYTE VW_BCM_CompuMethods_CM_TXTenErrStatus 1 100 0.0 255.0 MAX_REFRESH 4 1 ECU_ADDRESS 0x52808188 /end MEASUREMENT
/begin MEASUREMENT MCore_Unconnected_bStLdsAbblendlichtHW "Boolean" UBYTE Methods_boolean 1 100 0.0 1.0 MAX_REFRESH 4 1 ECU_ADDRESS 0x400E32B4 /end MEASUREMENT
/begin MEASUREMENT MCore_Unconnected_bStLdsAssistenzfahrlichtHW "Boolean" UBYTE Methods_boolean 1 100 0.0 1.0 MAX_REFRESH 4 1 ECU_ADDRESS 0x400E32B5 /end MEASUREMENT
/begin MEASUREMENT MCore_Unconnected_bStLdsNullstellungHW "Boolean" UBYTE Methods_boolean 1 100 0.0 1.0 MAX_REFRESH 4 1 ECU_ADDRESS 0x400E32B2 /end MEASUREMENT
/begin MEASUREMENT MCore_Unconnected_bStLdsStandlichtHW "Boolean" UBYTE Methods_boolean 1 100 0.0 1.0 MAX_REFRESH 4 1 ECU_ADDRESS 0x400E32B3 /end MEASUREMENT
/begin MEASUREMENT MCore_Unconnected_enLdsAbblendlichtHWErrSt "unsigned integer 8bit" UBYTE VW_BCM_CompuMethods_CM_TXTenErrStatus 1 100 0.0 255.0 MAX_REFRESH 4 1 ECU_ADDRESS 0x400E32B9 /end MEASUREMENT
/begin MEASUREMENT MCore_Unconnected_enLdsAssistenzfahrlichtHWErrSt "unsigned integer 8bit" UBYTE VW_BCM_CompuMethods_CM_TXTenErrStatus 1 100 0.0 255.0 MAX_REFRESH 4 1 ECU_ADDRESS 0x400E32BA /end MEASUREMENT
/begin MEASUREMENT MCore_Unconnected_enLdsNullstellungHWErrSt "unsigned integer 8bit" UBYTE VW_BCM_CompuMethods_CM_TXTenErrStatus 1 100 0.0 255.0 MAX_REFRESH 4 1 ECU_ADDRESS 0x400E32B7 /end MEASUREMENT
/begin MEASUREMENT MCore_Unconnected_enLdsRedundanzKontaktHWErrSt "unsigned integer 8bit" UBYTE VW_BCM_CompuMethods_CM_TXTenErrStatus 1 100 0.0 255.0 MAX_REFRESH 4 1 ECU_ADDRESS 0x400E32BB /end MEASUREMENT
/begin MEASUREMENT MCore_Unconnected_enLdsStandlichtHWErrSt "unsigned integer 8bit" UBYTE VW_BCM_CompuMethods_CM_TXTenErrStatus 1 100 0.0 255.0 MAX_REFRESH 4 1 ECU_ADDRESS 0x400E32B8 /end MEASUREMENT
/begin MEASUREMENT MCore_Unconnected_enStLdsRedundanzKontaktHW "unsigned integer 8bit" UBYTE VW_BCM_CompuMethods_SC_F1_O0_UNoUnit 1 100 0.0 2.0 MAX_REFRESH 4 1 ECU_ADDRESS 0x400E32B6 /end MEASUREMENT
/begin MEASUREMENT MCore_Unconnected_bRueckfahrlichtEin "Boolean" UBYTE Methods_boolean 1 100 0.0 1.0 MAX_REFRESH 4 1 ECU_ADDRESS 0x400E32BC /end MEASUREMENT
/begin MEASUREMENT MCore_Unconnected_ULwrSrvSigFb "unsigned integer 16bit" UWORD VW_BCM_CompuMethods_SC_F1_O0_UMiliVolt 1 100 0.0 65535.0 MAX_REFRESH 4 1 ECU_ADDRESS 0x400E2F50 /end MEASUREMENT
/begin MEASUREMENT MCore_Unconnected_ULwrSrvSupFb "unsigned integer 16bit" UWORD VW_BCM_CompuMethods_SC_F1_O0_UMiliVolt 1 100 0.0 65535.0 MAX_REFRESH 4 1 ECU_ADDRESS 0x400E2F52 /end MEASUREMENT
/begin MEASUREMENT MCore_Unconnected_nLwrSrvSigFbRatio "unsigned integer 16bit" UWORD VW_BCM_CompuMethods_SC_F0pt000030517578125_O0_UNoUnit 1 100 0.0 1.99993896484375 MAX_REFRESH 4 1 ECU_ADDRESS 0x400E2F54 /end MEASUREMENT
/begin MEASUREMENT MCore_Unconnected_bMHOffen1 "Boolean" UBYTE VW_BCM_CompuMethods_SC_F1_O0_UNoUnit 1 100 0.0 1.0 MAX_REFRESH 4 1 ECU_ADDRESS 0x400E32BD /end MEASUREMENT
/begin MEASUREMENT MCore_Current_Feedback_Value_mA "unsigned integer 16bit" UWORD VW_BCM_CompuMethods_SC_F1_O0_UNoUnit 1 100 0.0 65535.0 MAX_REFRESH 4 1 ECU_ADDRESS 0x400E2F92 /end MEASUREMENT
/begin MEASUREMENT MCore_HW_AutoEPBPushButton_VDT "Boolean" UBYTE Methods_boolean 1 100 0.0 1.0 MAX_REFRESH 4 1 ECU_ADDRESS 0x400E35EC /end MEASUREMENT
/begin MEASUREMENT MCore_HW_AutoParkPushButton_VDT "Boolean" UBYTE Methods_boolean 1 100 0.0 1.0 MAX_REFRESH 4 1 ECU_ADDRESS 0x400E35ED /end MEASUREMENT
/begin MEASUREMENT MCore_HW_BonnetSwitch_LH "Boolean" UBYTE VW_BCM_CompuMethods_SC_F1_O0_UNoUnit 1 100 0.0 1.0 MAX_REFRESH 4 1 ECU_ADDRESS 0x400E35EE /end MEASUREMENT
/begin MEASUREMENT MCore_HW_BonnetSwitch_RH "Boolean" UBYTE VW_BCM_CompuMethods_SC_F1_O0_UNoUnit 1 100 0.0 1.0 MAX_REFRESH 4 1 ECU_ADDRESS 0x400E35EF /end MEASUREMENT
/begin MEASUREMENT MCore_HW_BrakeLightSwitch "Boolean" UBYTE Methods_boolean 1 100 0.0 1.0 MAX_REFRESH 4 1 ECU_ADDRESS 0x400E35F0 /end MEASUREMENT
/begin MEASUREMENT MCore_DeBrakePadWearSensors "Boolean" UBYTE VW_BCM_CompuMethods_SC_F1_O0_UNoUnit 1 100 0.0 1.0 MAX_REFRESH 4 1 ECU_ADDRESS 0x400E35F1 /end MEASUREMENT
/begin MEASUREMENT MCore_actvLeChdLockBtn "Boolean" UBYTE Methods_boolean 1 100 0.0 1.0 MAX_REFRESH 4 1 ECU_ADDRESS 0x400E35F2 /end MEASUREMENT
/begin MEASUREMENT MCore_actvRiChdLockBtn "Boolean" UBYTE Methods_boolean 1 100 0.0 1.0 MAX_REFRESH 4 1 ECU_ADDRESS 0x400E35F3 /end MEASUREMENT
/begin MEASUREMENT MCore_DeDriverFrontWindowDown "" UBYTE DataType_DataTypeSemantics_DT_DriverFrontWindowDown 1 100 0.0 255.0 MAX_REFRESH 4 1 ECU_ADDRESS 0x52808189 /end MEASUREMENT
/begin MEASUREMENT MCore_DeDriverFrontWindowUp "" UBYTE DataType_DataTypeSemantics_DT_DriverFrontWindowUp 1 100 0.0 255.0 MAX_REFRESH 4 1 ECU_ADDRESS 0x5280818A /end MEASUREMENT
/begin MEASUREMENT MCore_DeExternalLuggageCntrl "" UBYTE DataType_DataTypeSemantics_DT_ExternalLuggageCntrl 1 100 0.0 255.0 MAX_REFRESH 4 1 ECU_ADDRESS 0x400E35F4 /end MEASUREMENT
/begin MEASUREMENT MCore_CloseSwitch "Boolean" UBYTE Methods_boolean 1 100 0.0 1.0 MAX_REFRESH 4 1 ECU_ADDRESS 0x400E35F5 /end MEASUREMENT
/begin MEASUREMENT MCore_OpenSwitch "Boolean" UBYTE Methods_boolean 1 100 0.0 1.0 MAX_REFRESH 4 1 ECU_ADDRESS 0x400E35F6 /end MEASUREMENT
/begin MEASUREMENT MCore_HW_GloveboxOpenButton "Boolean" UBYTE Methods_boolean 1 100 0.0 1.0 MAX_REFRESH 4 1 ECU_ADDRESS 0x400E35F7 /end MEASUREMENT
/begin MEASUREMENT MCore_HW_LockUnlockButton "Boolean" UBYTE Methods_boolean 1 100 0.0 1.0 MAX_REFRESH 4 1 ECU_ADDRESS 0x400E35F8 /end MEASUREMENT
/begin MEASUREMENT MCore_LeftRearSeatFolding "unsigned integer 8bit" UBYTE VW_BCM_CompuMethods_SC_F1_O0_UNoUnit 1 100 0.0 255.0 MAX_REFRESH 4 1 ECU_ADDRESS 0x400E35F9 /end MEASUREMENT
/begin MEASUREMENT MCore_RightRearSeatFolding "unsigned integer 8bit" UBYTE VW_BCM_CompuMethods_SC_F1_O0_UNoUnit 1 100 0.0 255.0 MAX_REFRESH 4 1 ECU_ADDRESS 0x400E35FA /end MEASUREMENT
/begin MEASUREMENT MCore_LeftRearSeatFoldingLatch "unsigned integer 8bit" UBYTE VW_BCM_CompuMethods_SC_F1_O0_UNoUnit 1 100 0.0 255.0 MAX_REFRESH 4 1 ECU_ADDRESS 0x400E35FB /end MEASUREMENT
/begin MEASUREMENT MCore_RightRearSeatFoldingLatch "unsigned integer 8bit" UBYTE VW_BCM_CompuMethods_SC_F1_O0_UNoUnit 1 100 0.0 255.0 MAX_REFRESH 4 1 ECU_ADDRESS 0x400E35FC /end MEASUREMENT
/begin MEASUREMENT MCore_ISP_Kl30gFB "unsigned integer 8bit" UBYTE VW_BCM_CompuMethods_SC_F1_O0_UNoUnit 1 100 0.0 255.0 MAX_REFRESH 4 1 ECU_ADDRESS 0x400E35FD /end MEASUREMENT
/begin MEASUREMENT MCore_DE_IoHwMUWAlrmSig "Boolean" UBYTE VW_BCM_CompuMethods_SC_F1_O0_UNoUnit 1 100 0.0 1.0 MAX_REFRESH 4 1 ECU_ADDRESS 0x400E35FE /end MEASUREMENT
/begin MEASUREMENT MCore_DeLuggageCntrl "" UBYTE DataType_DataTypeSemantics_DT_LuggageCntrl 1 100 0.0 255.0 MAX_REFRESH 4 1 ECU_ADDRESS 0x400E3601 /end MEASUREMENT
/begin MEASUREMENT MCore_DePsngrFrontWindowDown "" UBYTE DataType_DataTypeSemantics_DT_PsngrFrontWindowDown 1 100 0.0 255.0 MAX_REFRESH 4 1 ECU_ADDRESS 0x5280818C /end MEASUREMENT
/begin MEASUREMENT MCore_DePsngrFrontWindowUp "" UBYTE DataType_DataTypeSemantics_DT_PsngrFrontWindowUp 1 100 0.0 255.0 MAX_REFRESH 4 1 ECU_ADDRESS 0x5280818D /end MEASUREMENT
/begin MEASUREMENT MCore_HW_RearCompSwitchDF "Boolean" UBYTE Methods_boolean 1 100 0.0 1.0 MAX_REFRESH 4 1 ECU_ADDRESS 0x400E3602 /end MEASUREMENT
/begin MEASUREMENT MCore_HW_RearCompSwitchSA "Boolean" UBYTE Methods_boolean 1 100 0.0 1.0 MAX_REFRESH 4 1 ECU_ADDRESS 0x400E3603 /end MEASUREMENT
/begin MEASUREMENT MCore_HW_RearCompSwitchSK "Boolean" UBYTE Methods_boolean 1 100 0.0 1.0 MAX_REFRESH 4 1 ECU_ADDRESS 0x400E3604 /end MEASUREMENT
/begin MEASUREMENT MCore_Unconnected_DERearwiperCamsignal "Boolean" UBYTE Methods_boolean 1 100 0.0 1.0 MAX_REFRESH 4 1 ECU_ADDRESS 0x400E32BE /end MEASUREMENT
/begin MEASUREMENT MCore_WasherPumpLiquidLevel "Boolean" UBYTE Methods_boolean 1 100 0.0 1.0 MAX_REFRESH 4 1 ECU_ADDRESS 0x400E3605 /end MEASUREMENT
/begin MEASUREMENT MCore_HW_AlcoholInterlock "Boolean" UBYTE Methods_boolean 1 100 0.0 1.0 MAX_REFRESH 4 1 ECU_ADDRESS 0x400E3606 /end MEASUREMENT
/begin MEASUREMENT MCore_Unconnected_bPverr "Boolean" UBYTE Methods_boolean 1 100 0.0 1.0 MAX_REFRESH 4 1 ECU_ADDRESS 0x400E32BF /end MEASUREMENT
/begin MEASUREMENT MCore_Unconnected_bBremsbelag "unsigned integer 8bit" UBYTE VW_BCM_CompuMethods_SC_F1_O0_UNoUnit 1 100 0.0 2.0 MAX_REFRESH 4 1 ECU_ADDRESS 0x400E32C0 /end MEASUREMENT
/begin MEASUREMENT MCore_Unconnected_bBremsfluessigkeitsStand "unsigned integer 8bit" UBYTE VW_BCM_CompuMethods_SC_F1_O0_UNoUnit 1 100 0.0 2.0 MAX_REFRESH 4 1 ECU_ADDRESS 0x400E32C1 /end MEASUREMENT
/begin MEASUREMENT MCore_Unconnected_RKuehlmittelStand "unsigned integer 16bit" UWORD VW_BCM_CompuMethods_SC_F1_O0_UKiloOhm 1 100 0.0 1000.0 MAX_REFRESH 4 1 ECU_ADDRESS 0x400E2F56 /end MEASUREMENT
/begin MEASUREMENT MCore_Unconnected_TAussen "signed integer 16bit" SWORD VW_BCM_CompuMethods_SC_F0pt00390625_O0_UDegCgrd 1 100 -70.0 100.0 MAX_REFRESH 4 1 ECU_ADDRESS 0x400E2F58 /end MEASUREMENT
/begin MEASUREMENT MCore_Unconnected_TInnen "signed integer 16bit" SWORD VW_BCM_CompuMethods_SC_F0pt00390625_O0_UDegCgrd 1 100 -40.0 125.0 MAX_REFRESH 4 1 ECU_ADDRESS 0x400E2F5A /end MEASUREMENT
/begin MEASUREMENT MCore_Unconnected_UUmgebungshelligkeit "unsigned integer 16bit" UWORD VW_BCM_CompuMethods_SC_F0pt001_O0_UVolt 1 100 0.0 65.535 MAX_REFRESH 4 1 ECU_ADDRESS 0x400E2F5C /end MEASUREMENT
/begin MEASUREMENT MCore_Unconnected_enUmgebungshelligkeitErrSt "unsigned integer 8bit" UBYTE VW_BCM_CompuMethods_CM_TXTenErrStatus 1 100 0.0 255.0 MAX_REFRESH 4 1 ECU_ADDRESS 0x400E32C2 /end MEASUREMENT
/begin MEASUREMENT MCore_Unconnected_RWaschWasserStand "unsigned integer 16bit" UWORD VW_BCM_CompuMethods_SC_F1_O0_UKiloOhm 1 100 0.0 1000.0 MAX_REFRESH 4 1 ECU_ADDRESS 0x400E2F5E /end MEASUREMENT
/begin MEASUREMENT MCore_Unconnected_enSensorversorgungStatus "unsigned integer 8bit" UBYTE VW_BCM_CompuMethods_CM_TXTenSensorversorgungStatus 1 100 0.0 255.0 MAX_REFRESH 4 1 ECU_ADDRESS 0x400D9212 /end MEASUREMENT
/begin MEASUREMENT MCore_Unconnected_bWarnBlkDiskr "Boolean" UBYTE Methods_boolean 1 100 0.0 1.0 MAX_REFRESH 4 1 ECU_ADDRESS 0x400E32C3 /end MEASUREMENT
/begin MEASUREMENT MCore_Unconnected_bFrontwischerEndlagenkontakt "Boolean" UBYTE Methods_boolean 1 100 0.0 1.0 MAX_REFRESH 4 1 ECU_ADDRESS 0x400E32C4 /end MEASUREMENT
/begin MEASUREMENT MCore_Unconnected_bHDHptr "Boolean" UBYTE Methods_boolean 1 100 0.0 1.0 MAX_REFRESH 4 1 ECU_ADDRESS 0x400E32C5 /end MEASUREMENT
/begin MEASUREMENT MCore_Unconnected_bMHOffen "Boolean" UBYTE Methods_boolean 1 100 0.0 1.0 MAX_REFRESH 4 1 ECU_ADDRESS 0x400E32CA /end MEASUREMENT
/begin MEASUREMENT MCore_Unconnected_enHLOffen "Boolean" UBYTE Methods_boolean 1 100 0.0 1.0 MAX_REFRESH 4 1 ECU_ADDRESS 0x400E32C8 /end MEASUREMENT
/begin MEASUREMENT MCore_Unconnected_enHLSchloss "unsigned integer 8bit" UBYTE VW_BCM_CompuMethods_SC_F1_O0_UNoUnit 1 100 0.0 2.0 MAX_REFRESH 4 1 ECU_ADDRESS 0x400E32C6 /end MEASUREMENT
/begin MEASUREMENT MCore_Unconnected_enHRSchloss "unsigned integer 8bit" UBYTE VW_BCM_CompuMethods_SC_F1_O0_UNoUnit 1 100 0.0 2.0 MAX_REFRESH 4 1 ECU_ADDRESS 0x400E32C7 /end MEASUREMENT
/begin MEASUREMENT MCore_Unconnected_enHrOffen "Boolean" UBYTE Methods_boolean 1 100 0.0 1.0 MAX_REFRESH 4 1 ECU_ADDRESS 0x400E32C9 /end MEASUREMENT
/begin MEASUREMENT MCore_Unconnected_bDwaDeac "Boolean" UBYTE Methods_boolean 1 100 0.0 1.0 MAX_REFRESH 4 1 ECU_ADDRESS 0x400E32CC /end MEASUREMENT
/begin MEASUREMENT MCore_Unconnected_enLockOrUnlock "unsigned integer 8bit" UBYTE VW_BCM_CompuMethods_SC_F1_O0_UNoUnit 1 100 0.0 2.0 MAX_REFRESH 4 1 ECU_ADDRESS 0x400E32CB /end MEASUREMENT
/begin MEASUREMENT MCore_ErrKl15 "unsigned integer 8bit" UBYTE VW_BCM_CompuMethods_SC_F1_O0_UNoUnit 1 100 0.0 255.0 MAX_REFRESH 4 1 ECU_ADDRESS 0x528081A0 /end MEASUREMENT
/begin MEASUREMENT MCore_ErrKl15Ffb "unsigned integer 8bit" UBYTE VW_BCM_CompuMethods_SC_F1_O0_UNoUnit 1 100 0.0 255.0 MAX_REFRESH 4 1 ECU_ADDRESS 0x400E32CD /end MEASUREMENT
/begin MEASUREMENT MCore_ErrKlStartwunschSig "unsigned integer 8bit" UBYTE VW_BCM_CompuMethods_SC_F1_O0_UNoUnit 1 100 0.0 255.0 MAX_REFRESH 4 1 ECU_ADDRESS 0x52800043 /end MEASUREMENT
/begin MEASUREMENT MCore_Unconnected_ErrMotHd "unsigned integer 8bit" UBYTE VW_BCM_CompuMethods_SC_F1_O0_UNoUnit 1 100 0.0 255.0 MAX_REFRESH 4 1 ECU_ADDRESS 0x400E32D1 /end MEASUREMENT
/begin MEASUREMENT MCore_Unconnected_ErrMotHl "unsigned integer 8bit" UBYTE VW_BCM_CompuMethods_SC_F1_O0_UNoUnit 1 100 0.0 255.0 MAX_REFRESH 4 1 ECU_ADDRESS 0x400E32CE /end MEASUREMENT
/begin MEASUREMENT MCore_Unconnected_ErrMotHlHrSPos "unsigned integer 8bit" UBYTE VW_BCM_CompuMethods_SC_F1_O0_UNoUnit 1 100 0.0 255.0 MAX_REFRESH 4 1 ECU_ADDRESS 0x400E32D2 /end MEASUREMENT
/begin MEASUREMENT MCore_Unconnected_ErrMotHr "unsigned integer 8bit" UBYTE VW_BCM_CompuMethods_SC_F1_O0_UNoUnit 1 100 0.0 255.0 MAX_REFRESH 4 1 ECU_ADDRESS 0x400E32CF /end MEASUREMENT
/begin MEASUREMENT MCore_Unconnected_ErrMotTkl "unsigned integer 8bit" UBYTE VW_BCM_CompuMethods_SC_F1_O0_UNoUnit 1 100 0.0 255.0 MAX_REFRESH 4 1 ECU_ADDRESS 0x400E32D0 /end MEASUREMENT
/begin MEASUREMENT MCore_cat1 "Boolean" UBYTE Methods_boolean 1 100 0.0 1.0 MAX_REFRESH 4 1 ECU_ADDRESS 0x400E3743 /end MEASUREMENT
/begin MEASUREMENT MCore_cat10[0].fullBridgeState "" UBYTE DefaultIdenticalCompu 1 100 0.0 255.0 ECU_ADDRESS 0x400E2D10 /end MEASUREMENT
/begin MEASUREMENT MCore_cat10[0].valuePwm "" UWORD DefaultIdenticalCompu 1 100 0.0 65535.0 ECU_ADDRESS 0x400E2D12 /end MEASUREMENT
/begin MEASUREMENT MCore_cat11 "" UBYTE Methods_boolean 1 100 0.0 255.0 ARRAY_SIZE 5 ECU_ADDRESS 0x400E3744 /end MEASUREMENT
/begin MEASUREMENT MCore_cat12 "" UBYTE DefaultIdenticalCompu 1 100 0.0 255.0 ARRAY_SIZE 12 ECU_ADDRESS 0x400E2D24 /end MEASUREMENT
/begin MEASUREMENT MCore_cat13 "" UBYTE DefaultIdenticalCompu 1 100 0.0 255.0 ARRAY_SIZE 2 ECU_ADDRESS 0x400E2F9A /end MEASUREMENT
/begin MEASUREMENT MCore_cat2 "" UWORD DefaultIdenticalCompu 1 100 0.0 65535.0 ARRAY_SIZE 54 ECU_ADDRESS 0x400E2D30 /end MEASUREMENT
/begin MEASUREMENT MCore_cat20 "unsigned integer 16bit" UWORD VW_BCM_CompuMethods_SC_F1_O0_UNoUnit 1 100 0.0 1270.0 MAX_REFRESH 4 1 ECU_ADDRESS 0x400E2F9C /end MEASUREMENT
/begin MEASUREMENT MCore_cat3 "" UWORD DefaultIdenticalCompu 1 100 0.0 65535.0 ARRAY_SIZE 2 ECU_ADDRESS 0x400E2D9C /end MEASUREMENT
/begin MEASUREMENT MCore_arrLiFct "" UWORD VW_BCM_CompuMethods_SC_F1_O0_UPerc 1 100 0.0 1270.0 ARRAY_SIZE 53 ECU_ADDRESS 0x1223C10 /end MEASUREMENT
/begin MEASUREMENT MCore_arrLiFctNewFctReq "" UBYTE Methods_boolean 1 100 0.0 1.0 ARRAY_SIZE 53 ECU_ADDRESS 0x400E3749 /end MEASUREMENT
/begin MEASUREMENT MCore_bfAnfFreigSchnellerBrDurchgr "unsigned integer 16bit" UWORD VW_BCM_CompuMethods_SC_F1_O0_UNoUnit 1 100 0.0 1023.0 MAX_REFRESH 4 1 ECU_ADDRESS 0x1223AE4 /end MEASUREMENT
/begin MEASUREMENT MCore_OSC_ErrMonFb "unsigned integer 8bit" UBYTE VW_BCM_CompuMethods_SC_F1_O0_UNoUnit 1 100 0.0 255.0 MAX_REFRESH 4 1 ECU_ADDRESS 0x400E377E /end MEASUREMENT
/begin MEASUREMENT MCore_Kl30G_VPUP_WAKE "unsigned integer 16bit" UWORD VW_BCM_CompuMethods_SC_F1_O0_UNoUnit 1 100 0.0 1270.0 MAX_REFRESH 4 1 ECU_ADDRESS 0x400E2F9E /end MEASUREMENT
/begin MEASUREMENT MCore_OSC_ErrMonFb_0 "unsigned integer 8bit" UBYTE VW_BCM_CompuMethods_SC_F1_O0_UNoUnit 1 100 0.0 255.0 MAX_REFRESH 4 1 ECU_ADDRESS 0x400E377F /end MEASUREMENT
/begin MEASUREMENT MCore_OSC_ErrMonFb_1 "unsigned integer 8bit" UBYTE VW_BCM_CompuMethods_SC_F1_O0_UNoUnit 1 100 0.0 255.0 MAX_REFRESH 4 1 ECU_ADDRESS 0x400E3780 /end MEASUREMENT
/begin MEASUREMENT MCore_OSC_ErrMonFb_2 "unsigned integer 8bit" UBYTE VW_BCM_CompuMethods_SC_F1_O0_UNoUnit 1 100 0.0 255.0 MAX_REFRESH 4 1 ECU_ADDRESS 0x400E3781 /end MEASUREMENT
/begin MEASUREMENT MCore_OSC_ErrMonFb_3 "unsigned integer 8bit" UBYTE VW_BCM_CompuMethods_SC_F1_O0_UNoUnit 1 100 0.0 255.0 MAX_REFRESH 4 1 ECU_ADDRESS 0x400E3782 /end MEASUREMENT
/begin MEASUREMENT MCore_Unconnected_OSC_ErrMonFb_4 "unsigned integer 8bit" UBYTE VW_BCM_CompuMethods_SC_F1_O0_UNoUnit 1 100 0.0 255.0 MAX_REFRESH 4 1 ECU_ADDRESS 0x400E32D3 /end MEASUREMENT
/begin MEASUREMENT MCore_OSC_ErrMonFb_5 "unsigned integer 8bit" UBYTE VW_BCM_CompuMethods_SC_F1_O0_UNoUnit 1 100 0.0 255.0 MAX_REFRESH 4 1 ECU_ADDRESS 0x400E3783 /end MEASUREMENT
/begin MEASUREMENT MCore_OSC_ErrMonFb_6 "unsigned integer 8bit" UBYTE VW_BCM_CompuMethods_SC_F1_O0_UNoUnit 1 100 0.0 255.0 MAX_REFRESH 4 1 ECU_ADDRESS 0x400E3784 /end MEASUREMENT
/begin MEASUREMENT MCore_OSC_ErrMonFb_7 "unsigned integer 8bit" UBYTE VW_BCM_CompuMethods_SC_F1_O0_UNoUnit 1 100 0.0 255.0 MAX_REFRESH 4 1 ECU_ADDRESS 0x400E3785 /end MEASUREMENT
/begin MEASUREMENT MCore_OSC_ErrMonFb_8 "unsigned integer 8bit" UBYTE VW_BCM_CompuMethods_SC_F1_O0_UNoUnit 1 100 0.0 255.0 MAX_REFRESH 4 1 ECU_ADDRESS 0x400E3786 /end MEASUREMENT
/begin MEASUREMENT MCore_OSC_ErrMonFb_9 "unsigned integer 8bit" UBYTE VW_BCM_CompuMethods_SC_F1_O0_UNoUnit 1 100 0.0 255.0 MAX_REFRESH 4 1 ECU_ADDRESS 0x400E3787 /end MEASUREMENT
/begin MEASUREMENT MCore_OSC_ErrMonFb_10 "unsigned integer 8bit" UBYTE VW_BCM_CompuMethods_SC_F1_O0_UNoUnit 1 100 0.0 255.0 MAX_REFRESH 4 1 ECU_ADDRESS 0x400E3788 /end MEASUREMENT
/begin MEASUREMENT MCore_OSC_ErrMonFb_11 "unsigned integer 8bit" UBYTE VW_BCM_CompuMethods_SC_F1_O0_UNoUnit 1 100 0.0 255.0 MAX_REFRESH 4 1 ECU_ADDRESS 0x400E3789 /end MEASUREMENT
/begin MEASUREMENT MCore_OSC_ErrMonFb_12 "unsigned integer 8bit" UBYTE VW_BCM_CompuMethods_SC_F1_O0_UNoUnit 1 100 0.0 255.0 MAX_REFRESH 4 1 ECU_ADDRESS 0x400E378A /end MEASUREMENT
/begin MEASUREMENT MCore_OSC_ErrMonFb_13 "unsigned integer 8bit" UBYTE VW_BCM_CompuMethods_SC_F1_O0_UNoUnit 1 100 0.0 255.0 MAX_REFRESH 4 1 ECU_ADDRESS 0x400E378B /end MEASUREMENT
/begin MEASUREMENT MCore_OSC_ErrMonFb_14 "unsigned integer 8bit" UBYTE VW_BCM_CompuMethods_SC_F1_O0_UNoUnit 1 100 0.0 255.0 MAX_REFRESH 4 1 ECU_ADDRESS 0x400E378C /end MEASUREMENT
/begin MEASUREMENT MCore_Unconnected_OSC_ErrMonFb_15 "unsigned integer 8bit" UBYTE VW_BCM_CompuMethods_SC_F1_O0_UNoUnit 1 100 0.0 255.0 MAX_REFRESH 4 1 ECU_ADDRESS 0x400E32D4 /end MEASUREMENT
/begin MEASUREMENT MCore_OSC_ErrMonFb_16 "unsigned integer 8bit" UBYTE VW_BCM_CompuMethods_SC_F1_O0_UNoUnit 1 100 0.0 255.0 MAX_REFRESH 4 1 ECU_ADDRESS 0x400E378D /end MEASUREMENT
/begin MEASUREMENT MCore_OSC_ErrMonFb_17 "unsigned integer 8bit" UBYTE VW_BCM_CompuMethods_SC_F1_O0_UNoUnit 1 100 0.0 255.0 MAX_REFRESH 4 1 ECU_ADDRESS 0x400E378E /end MEASUREMENT
/begin MEASUREMENT MCore_OSC_ErrMonFb_18 "unsigned integer 8bit" UBYTE VW_BCM_CompuMethods_SC_F1_O0_UNoUnit 1 100 0.0 255.0 MAX_REFRESH 4 1 ECU_ADDRESS 0x400E378F /end MEASUREMENT
/begin MEASUREMENT MCore_OSC_ErrMonFb_19 "unsigned integer 8bit" UBYTE VW_BCM_CompuMethods_SC_F1_O0_UNoUnit 1 100 0.0 255.0 MAX_REFRESH 4 1 ECU_ADDRESS 0x400E3790 /end MEASUREMENT
/begin MEASUREMENT MCore_OSC_ErrMonFb_20 "unsigned integer 8bit" UBYTE VW_BCM_CompuMethods_SC_F1_O0_UNoUnit 1 100 0.0 255.0 MAX_REFRESH 4 1 ECU_ADDRESS 0x400E3791 /end MEASUREMENT
/begin MEASUREMENT MCore_OSC_ErrMonFb_21 "unsigned integer 8bit" UBYTE VW_BCM_CompuMethods_SC_F1_O0_UNoUnit 1 100 0.0 255.0 MAX_REFRESH 4 1 ECU_ADDRESS 0x400E3792 /end MEASUREMENT
/begin MEASUREMENT MCore_OSC_ErrMonFb_22 "unsigned integer 8bit" UBYTE VW_BCM_CompuMethods_SC_F1_O0_UNoUnit 1 100 0.0 255.0 MAX_REFRESH 4 1 ECU_ADDRESS 0x400E3793 /end MEASUREMENT
/begin MEASUREMENT MCore_OSC_ErrMonFb_23 "unsigned integer 8bit" UBYTE VW_BCM_CompuMethods_SC_F1_O0_UNoUnit 1 100 0.0 255.0 MAX_REFRESH 4 1 ECU_ADDRESS 0x400E3794 /end MEASUREMENT
/begin MEASUREMENT MCore_OSC_ErrMonFb_24 "unsigned integer 8bit" UBYTE VW_BCM_CompuMethods_SC_F1_O0_UNoUnit 1 100 0.0 255.0 MAX_REFRESH 4 1 ECU_ADDRESS 0x400E3795 /end MEASUREMENT
/begin MEASUREMENT MCore_OSC_ErrMonFb_25 "unsigned integer 8bit" UBYTE VW_BCM_CompuMethods_SC_F1_O0_UNoUnit 1 100 0.0 255.0 MAX_REFRESH 4 1 ECU_ADDRESS 0x400E3796 /end MEASUREMENT
/begin MEASUREMENT MCore_Unconnected_OSC_ErrMonFb_26 "unsigned integer 8bit" UBYTE VW_BCM_CompuMethods_SC_F1_O0_UNoUnit 1 100 0.0 255.0 MAX_REFRESH 4 1 ECU_ADDRESS 0x400E32D5 /end MEASUREMENT
/begin MEASUREMENT MCore_Unconnected_OSC_ErrMonFb_27 "unsigned integer 8bit" UBYTE VW_BCM_CompuMethods_SC_F1_O0_UNoUnit 1 100 0.0 255.0 MAX_REFRESH 4 1 ECU_ADDRESS 0x400E32D6 /end MEASUREMENT
/begin MEASUREMENT MCore_Unconnected_OSC_ErrMonFb_28 "unsigned integer 8bit" UBYTE VW_BCM_CompuMethods_SC_F1_O0_UNoUnit 1 100 0.0 255.0 MAX_REFRESH 4 1 ECU_ADDRESS 0x400E32D7 /end MEASUREMENT
/begin MEASUREMENT MCore_Unconnected_OSC_ErrMonFb_29 "unsigned integer 8bit" UBYTE VW_BCM_CompuMethods_SC_F1_O0_UNoUnit 1 100 0.0 255.0 MAX_REFRESH 4 1 ECU_ADDRESS 0x400E32D8 /end MEASUREMENT
/begin MEASUREMENT MCore_OSC_ErrMonFb_30 "unsigned integer 8bit" UBYTE VW_BCM_CompuMethods_SC_F1_O0_UNoUnit 1 100 0.0 255.0 MAX_REFRESH 4 1 ECU_ADDRESS 0x400E3797 /end MEASUREMENT
/begin MEASUREMENT MCore_OSC_ErrMonFb_31 "unsigned integer 8bit" UBYTE VW_BCM_CompuMethods_SC_F1_O0_UNoUnit 1 100 0.0 255.0 MAX_REFRESH 4 1 ECU_ADDRESS 0x400E3798 /end MEASUREMENT
/begin MEASUREMENT MCore_OSC_ErrMonFb_32 "unsigned integer 8bit" UBYTE VW_BCM_CompuMethods_SC_F1_O0_UNoUnit 1 100 0.0 255.0 MAX_REFRESH 4 1 ECU_ADDRESS 0x400E3799 /end MEASUREMENT
/begin MEASUREMENT MCore_Unconnected_OSC_ErrMonFb_33 "unsigned integer 8bit" UBYTE VW_BCM_CompuMethods_SC_F1_O0_UNoUnit 1 100 0.0 255.0 MAX_REFRESH 4 1 ECU_ADDRESS 0x400E32D9 /end MEASUREMENT
/begin MEASUREMENT MCore_OSC_ErrMonFb_34 "unsigned integer 8bit" UBYTE VW_BCM_CompuMethods_SC_F1_O0_UNoUnit 1 100 0.0 255.0 MAX_REFRESH 4 1 ECU_ADDRESS 0x400E379A /end MEASUREMENT
/begin MEASUREMENT MCore_OSC_ErrMonFb_35 "unsigned integer 8bit" UBYTE VW_BCM_CompuMethods_SC_F1_O0_UNoUnit 1 100 0.0 255.0 MAX_REFRESH 4 1 ECU_ADDRESS 0x400E379B /end MEASUREMENT
/begin MEASUREMENT MCore_OSC_ErrMonFb_36 "unsigned integer 8bit" UBYTE VW_BCM_CompuMethods_SC_F1_O0_UNoUnit 1 100 0.0 255.0 MAX_REFRESH 4 1 ECU_ADDRESS 0x400E379C /end MEASUREMENT
/begin MEASUREMENT MCore_OSC_ErrMonFb_37 "unsigned integer 8bit" UBYTE VW_BCM_CompuMethods_SC_F1_O0_UNoUnit 1 100 0.0 255.0 MAX_REFRESH 4 1 ECU_ADDRESS 0x400E379D /end MEASUREMENT
/begin MEASUREMENT MCore_OSC_ErrMonFb_38 "unsigned integer 8bit" UBYTE VW_BCM_CompuMethods_SC_F1_O0_UNoUnit 1 100 0.0 255.0 MAX_REFRESH 4 1 ECU_ADDRESS 0x400E379E /end MEASUREMENT
/begin MEASUREMENT MCore_OSC_ErrMonFb_39 "unsigned integer 8bit" UBYTE VW_BCM_CompuMethods_SC_F1_O0_UNoUnit 1 100 0.0 255.0 MAX_REFRESH 4 1 ECU_ADDRESS 0x400E379F /end MEASUREMENT
/begin MEASUREMENT MCore_OSC_ErrMonFb_40 "unsigned integer 8bit" UBYTE VW_BCM_CompuMethods_SC_F1_O0_UNoUnit 1 100 0.0 255.0 MAX_REFRESH 4 1 ECU_ADDRESS 0x400E37A0 /end MEASUREMENT
/begin MEASUREMENT MCore_OSC_ErrMonFb_41 "unsigned integer 8bit" UBYTE VW_BCM_CompuMethods_SC_F1_O0_UNoUnit 1 100 0.0 255.0 MAX_REFRESH 4 1 ECU_ADDRESS 0x400E37A1 /end MEASUREMENT
/begin MEASUREMENT MCore_OSC_ErrMonFb_42 "unsigned integer 8bit" UBYTE VW_BCM_CompuMethods_SC_F1_O0_UNoUnit 1 100 0.0 255.0 MAX_REFRESH 4 1 ECU_ADDRESS 0x400E37A2 /end MEASUREMENT
/begin MEASUREMENT MCore_OSC_ErrMonFb_43 "unsigned integer 8bit" UBYTE VW_BCM_CompuMethods_SC_F1_O0_UNoUnit 1 100 0.0 255.0 MAX_REFRESH 4 1 ECU_ADDRESS 0x400E37A3 /end MEASUREMENT
/begin MEASUREMENT MCore_OSC_ErrMonFb_44 "unsigned integer 8bit" UBYTE VW_BCM_CompuMethods_SC_F1_O0_UNoUnit 1 100 0.0 255.0 MAX_REFRESH 4 1 ECU_ADDRESS 0x400E37A4 /end MEASUREMENT
/begin MEASUREMENT MCore_OSC_ErrMonFb_45 "unsigned integer 8bit" UBYTE VW_BCM_CompuMethods_SC_F1_O0_UNoUnit 1 100 0.0 255.0 MAX_REFRESH 4 1 ECU_ADDRESS 0x400E37A5 /end MEASUREMENT
/begin MEASUREMENT MCore_OSC_ErrMonFb_46 "unsigned integer 8bit" UBYTE VW_BCM_CompuMethods_SC_F1_O0_UNoUnit 1 100 0.0 255.0 MAX_REFRESH 4 1 ECU_ADDRESS 0x400E37A6 /end MEASUREMENT
/begin MEASUREMENT MCore_OSC_ErrMonFb_47 "unsigned integer 8bit" UBYTE VW_BCM_CompuMethods_SC_F1_O0_UNoUnit 1 100 0.0 255.0 MAX_REFRESH 4 1 ECU_ADDRESS 0x400E37A7 /end MEASUREMENT
/begin MEASUREMENT MCore_OSC_ErrMonFb_48 "unsigned integer 8bit" UBYTE VW_BCM_CompuMethods_SC_F1_O0_UNoUnit 1 100 0.0 255.0 MAX_REFRESH 4 1 ECU_ADDRESS 0x400E37A8 /end MEASUREMENT
/begin MEASUREMENT MCore_OSC_ErrMonFb_49 "unsigned integer 8bit" UBYTE VW_BCM_CompuMethods_SC_F1_O0_UNoUnit 1 100 0.0 255.0 MAX_REFRESH 4 1 ECU_ADDRESS 0x400E37A9 /end MEASUREMENT
/begin MEASUREMENT MCore_OSC_ErrMonFb_50 "unsigned integer 8bit" UBYTE VW_BCM_CompuMethods_SC_F1_O0_UNoUnit 1 100 0.0 255.0 MAX_REFRESH 4 1 ECU_ADDRESS 0x400E37AA /end MEASUREMENT
/begin MEASUREMENT MCore_OSC_ErrMonFb_51 "unsigned integer 8bit" UBYTE VW_BCM_CompuMethods_SC_F1_O0_UNoUnit 1 100 0.0 255.0 MAX_REFRESH 4 1 ECU_ADDRESS 0x400E37AB /end MEASUREMENT
/begin MEASUREMENT MCore_OSC_ErrMonFb_52 "unsigned integer 8bit" UBYTE VW_BCM_CompuMethods_SC_F1_O0_UNoUnit 1 100 0.0 255.0 MAX_REFRESH 4 1 ECU_ADDRESS 0x400E37AC /end MEASUREMENT
/begin MEASUREMENT MCore_OSC_ErrMonFb_53 "unsigned integer 8bit" UBYTE VW_BCM_CompuMethods_SC_F1_O0_UNoUnit 1 100 0.0 255.0 MAX_REFRESH 4 1 ECU_ADDRESS 0x400E37AD /end MEASUREMENT
/begin MEASUREMENT MCore_OSC_ErrMonFb_54 "unsigned integer 8bit" UBYTE VW_BCM_CompuMethods_SC_F1_O0_UNoUnit 1 100 0.0 255.0 MAX_REFRESH 4 1 ECU_ADDRESS 0x400E37AE /end MEASUREMENT
/begin MEASUREMENT MCore_OSC_ErrMonFb_55 "unsigned integer 8bit" UBYTE VW_BCM_CompuMethods_SC_F1_O0_UNoUnit 1 100 0.0 255.0 MAX_REFRESH 4 1 ECU_ADDRESS 0x400E37AF /end MEASUREMENT
/begin MEASUREMENT MCore_OSC_ErrMonFb_56 "unsigned integer 8bit" UBYTE VW_BCM_CompuMethods_SC_F1_O0_UNoUnit 1 100 0.0 255.0 MAX_REFRESH 4 1 ECU_ADDRESS 0x400E37B0 /end MEASUREMENT
/begin MEASUREMENT MCore_OSC_ErrMonFb_57 "unsigned integer 8bit" UBYTE VW_BCM_CompuMethods_SC_F1_O0_UNoUnit 1 100 0.0 255.0 MAX_REFRESH 4 1 ECU_ADDRESS 0x400E37B1 /end MEASUREMENT
/begin MEASUREMENT MCore_OSC_ErrMonFb_58 "unsigned integer 8bit" UBYTE VW_BCM_CompuMethods_SC_F1_O0_UNoUnit 1 100 0.0 255.0 MAX_REFRESH 4 1 ECU_ADDRESS 0x400E37B2 /end MEASUREMENT
/begin MEASUREMENT MCore_OSC_ErrMonFb_59 "unsigned integer 8bit" UBYTE VW_BCM_CompuMethods_SC_F1_O0_UNoUnit 1 100 0.0 255.0 MAX_REFRESH 4 1 ECU_ADDRESS 0x400E37B3 /end MEASUREMENT
/begin MEASUREMENT MCore_OSC_ErrMonFb_60 "unsigned integer 8bit" UBYTE VW_BCM_CompuMethods_SC_F1_O0_UNoUnit 1 100 0.0 255.0 MAX_REFRESH 4 1 ECU_ADDRESS 0x400E37B4 /end MEASUREMENT
/begin MEASUREMENT MCore_Unconnected_OSC_ErrMonFb_61 "unsigned integer 8bit" UBYTE VW_BCM_CompuMethods_SC_F1_O0_UNoUnit 1 100 0.0 255.0 MAX_REFRESH 4 1 ECU_ADDRESS 0x400E32DA /end MEASUREMENT
/begin MEASUREMENT MCore_Unconnected_OSC_ErrMonFb_62 "unsigned integer 8bit" UBYTE VW_BCM_CompuMethods_SC_F1_O0_UNoUnit 1 100 0.0 255.0 MAX_REFRESH 4 1 ECU_ADDRESS 0x400E32DB /end MEASUREMENT
/begin MEASUREMENT MCore_OSC_ErrMonFb_63 "unsigned integer 8bit" UBYTE VW_BCM_CompuMethods_SC_F1_O0_UNoUnit 1 100 0.0 255.0 MAX_REFRESH 4 1 ECU_ADDRESS 0x400E37B5 /end MEASUREMENT
/begin MEASUREMENT MCore_Unconnected_OSC_ErrMonFb_64 "unsigned integer 8bit" UBYTE VW_BCM_CompuMethods_SC_F1_O0_UNoUnit 1 100 0.0 255.0 MAX_REFRESH 4 1 ECU_ADDRESS 0x400E32DC /end MEASUREMENT
/begin MEASUREMENT MCore_OSC_ErrMonFb_65 "unsigned integer 8bit" UBYTE VW_BCM_CompuMethods_SC_F1_O0_UNoUnit 1 100 0.0 255.0 MAX_REFRESH 4 1 ECU_ADDRESS 0x400E37B6 /end MEASUREMENT
/begin MEASUREMENT MCore_OSC_ErrMonFb_66 "unsigned integer 8bit" UBYTE VW_BCM_CompuMethods_SC_F1_O0_UNoUnit 1 100 0.0 255.0 MAX_REFRESH 4 1 ECU_ADDRESS 0x400E37B7 /end MEASUREMENT
/begin MEASUREMENT MCore_OSC_ErrMonFb_67 "unsigned integer 8bit" UBYTE VW_BCM_CompuMethods_SC_F1_O0_UNoUnit 1 100 0.0 255.0 MAX_REFRESH 4 1 ECU_ADDRESS 0x400E37B8 /end MEASUREMENT
/begin MEASUREMENT MCore_RequestActive "Boolean" UBYTE Methods_boolean 1 100 0.0 1.0 MAX_REFRESH 4 1 ECU_ADDRESS 0x400E37B9 /end MEASUREMENT
/begin MEASUREMENT MCore_RequestValue_u8 "unsigned integer 8bit" UBYTE VW_BCM_CompuMethods_SC_F1_O0_UNoUnit 1 100 0.0 255.0 MAX_REFRESH 4 1 ECU_ADDRESS 0x400E37BA /end MEASUREMENT
/begin MEASUREMENT MCore_Unconnected_TesterValue_u8 "unsigned integer 8bit" UBYTE VW_BCM_CompuMethods_SC_F1_O0_UNoUnit 1 100 0.0 255.0 MAX_REFRESH 4 1 ECU_ADDRESS 0x400E32DD /end MEASUREMENT
/begin MEASUREMENT MCore_Unconnected_TesterValue_u8_0 "unsigned integer 8bit" UBYTE VW_BCM_CompuMethods_SC_F1_O0_UNoUnit 1 100 0.0 255.0 MAX_REFRESH 4 1 ECU_ADDRESS 0x400E32DE /end MEASUREMENT
/begin MEASUREMENT MCore_OSC_ErrMonFb_68 "unsigned integer 8bit" UBYTE VW_BCM_CompuMethods_SC_F1_O0_UNoUnit 1 100 0.0 255.0 MAX_REFRESH 4 1 ECU_ADDRESS 0x400E37BB /end MEASUREMENT
/begin MEASUREMENT MCore_OSC_ErrMonFb_69 "unsigned integer 8bit" UBYTE VW_BCM_CompuMethods_SC_F1_O0_UNoUnit 1 100 0.0 255.0 MAX_REFRESH 4 1 ECU_ADDRESS 0x400E37BC /end MEASUREMENT
/begin MEASUREMENT MCore_DeRearwiperactivationsignal "Boolean" UBYTE Methods_boolean 1 100 0.0 1.0 MAX_REFRESH 4 1 ECU_ADDRESS 0x400E37BD /end MEASUREMENT
/begin MEASUREMENT MCore_DeWindscreenWasherPumpSignalOn "Boolean" UBYTE Methods_boolean 1 100 0.0 1.0 MAX_REFRESH 4 1 ECU_ADDRESS 0x400E37BE /end MEASUREMENT
/begin MEASUREMENT MCore_DeRearButtonFeedbackLed "Boolean" UBYTE Methods_boolean 1 100 0.0 1.0 MAX_REFRESH 4 1 ECU_ADDRESS 0x400E37BF /end MEASUREMENT
/begin MEASUREMENT MCore_RequestActive_0 "Boolean" UBYTE Methods_boolean 1 100 0.0 1.0 MAX_REFRESH 4 1 ECU_ADDRESS 0x400E37C0 /end MEASUREMENT
/begin MEASUREMENT MCore_RequestValue_u8_0 "unsigned integer 8bit" UBYTE VW_BCM_CompuMethods_SC_F1_O0_UNoUnit 1 100 0.0 255.0 MAX_REFRESH 4 1 ECU_ADDRESS 0x400E37C1 /end MEASUREMENT
/begin MEASUREMENT MCore_RequestActive_1 "Boolean" UBYTE Methods_boolean 1 100 0.0 1.0 MAX_REFRESH 4 1 ECU_ADDRESS 0x400E37C2 /end MEASUREMENT
/begin MEASUREMENT MCore_RequestValue_u8_1 "unsigned integer 8bit" UBYTE VW_BCM_CompuMethods_SC_F1_O0_UNoUnit 1 100 0.0 255.0 MAX_REFRESH 4 1 ECU_ADDRESS 0x400E37C3 /end MEASUREMENT
/begin MEASUREMENT MCore_rPwm1 "unsigned integer 16bit" UWORD VW_BCM_CompuMethods_SC_F1_O0_UNoUnit 1 100 0.0 1270.0 MAX_REFRESH 4 1 ECU_ADDRESS 0x400E2FA0 /end MEASUREMENT
/begin MEASUREMENT MCore_rPwm2 "unsigned integer 16bit" UWORD VW_BCM_CompuMethods_SC_F1_O0_UNoUnit 1 100 0.0 1270.0 MAX_REFRESH 4 1 ECU_ADDRESS 0x400E2FA2 /end MEASUREMENT
/begin MEASUREMENT MCore_ErrMotHd_0 "unsigned integer 8bit" UBYTE VW_BCM_CompuMethods_SC_F1_O0_UNoUnit 1 100 0.0 255.0 MAX_REFRESH 4 1 ECU_ADDRESS 0x400E37C4 /end MEASUREMENT
/begin MEASUREMENT MCore_ErrMotHlHrSPos_0 "unsigned integer 8bit" UBYTE VW_BCM_CompuMethods_SC_F1_O0_UNoUnit 1 100 0.0 255.0 MAX_REFRESH 4 1 ECU_ADDRESS 0x400E37C5 /end MEASUREMENT
/begin MEASUREMENT MCore_ErrMotTkl_0 "unsigned integer 8bit" UBYTE VW_BCM_CompuMethods_SC_F1_O0_UNoUnit 1 100 0.0 255.0 MAX_REFRESH 4 1 ECU_ADDRESS 0x400E37C6 /end MEASUREMENT
/begin MEASUREMENT MCore_enMotHd "Boolean" UBYTE Methods_boolean 1 100 0.0 1.0 MAX_REFRESH 4 1 ECU_ADDRESS 0x400E37C7 /end MEASUREMENT
/begin MEASUREMENT MCore_enMotHl "unsigned integer 8bit" UBYTE VW_BCM_CompuMethods_SC_F1_O0_UNoUnit 1 100 0.0 4.0 MAX_REFRESH 4 1 ECU_ADDRESS 0x400E37C8 /end MEASUREMENT
/begin MEASUREMENT MCore_enMotHlHrSPos "unsigned integer 8bit" UBYTE VW_BCM_CompuMethods_SC_F1_O0_UNoUnit 1 100 0.0 2.0 MAX_REFRESH 4 1 ECU_ADDRESS 0x400E37C9 /end MEASUREMENT
/begin MEASUREMENT MCore_enMotHr "unsigned integer 8bit" UBYTE VW_BCM_CompuMethods_SC_F1_O0_UNoUnit 1 100 0.0 4.0 MAX_REFRESH 4 1 ECU_ADDRESS 0x400E37CA /end MEASUREMENT
/begin MEASUREMENT MCore_enMotTkl "unsigned integer 8bit" UBYTE VW_BCM_CompuMethods_SC_F1_O0_UNoUnit 1 100 0.0 4.0 MAX_REFRESH 4 1 ECU_ADDRESS 0x400E37CB /end MEASUREMENT
/begin MEASUREMENT MCore_newFctReqMotHd "Boolean" UBYTE Methods_boolean 1 100 0.0 1.0 MAX_REFRESH 4 1 ECU_ADDRESS 0x400E37CC /end MEASUREMENT
/begin MEASUREMENT MCore_newFctReqMotHl "Boolean" UBYTE Methods_boolean 1 100 0.0 1.0 MAX_REFRESH 4 1 ECU_ADDRESS 0x400E37CD /end MEASUREMENT
/begin MEASUREMENT MCore_newFctReqMotHlHrSPos "Boolean" UBYTE Methods_boolean 1 100 0.0 1.0 MAX_REFRESH 4 1 ECU_ADDRESS 0x400E37CE /end MEASUREMENT
/begin MEASUREMENT MCore_newFctReqMotHr "Boolean" UBYTE Methods_boolean 1 100 0.0 1.0 MAX_REFRESH 4 1 ECU_ADDRESS 0x400E37CF /end MEASUREMENT
/begin MEASUREMENT MCore_newFctReqMotTkl "Boolean" UBYTE Methods_boolean 1 100 0.0 1.0 MAX_REFRESH 4 1 ECU_ADDRESS 0x400E37D0 /end MEASUREMENT
/begin MEASUREMENT MCore_functionRequestStatusOfAllHWOutp "" UBYTE DefaultIdenticalCompu 1 100 0.0 255.0 ARRAY_SIZE 75 ECU_ADDRESS 0x400E37D1 /end MEASUREMENT
/begin MEASUREMENT MCore_RequestActive_2 "Boolean" UBYTE Methods_boolean 1 100 0.0 1.0 MAX_REFRESH 1000 1 ECU_ADDRESS 0x400E381C /end MEASUREMENT
/begin MEASUREMENT MCore_RequestValue "Boolean" UBYTE Methods_boolean 1 100 0.0 1.0 MAX_REFRESH 1000 1 ECU_ADDRESS 0x400E381D /end MEASUREMENT
/begin MEASUREMENT MCore_RequestActive_3 "Boolean" UBYTE Methods_boolean 1 100 0.0 1.0 MAX_REFRESH 1000 1 ECU_ADDRESS 0x400E381E /end MEASUREMENT
/begin MEASUREMENT MCore_RequestValue_0 "Boolean" UBYTE Methods_boolean 1 100 0.0 1.0 MAX_REFRESH 1000 1 ECU_ADDRESS 0x400E381F /end MEASUREMENT
/begin MEASUREMENT MCore_RequestActive_4 "Boolean" UBYTE Methods_boolean 1 100 0.0 1.0 MAX_REFRESH 1000 1 ECU_ADDRESS 0x400E3820 /end MEASUREMENT
/begin MEASUREMENT MCore_RequestValue_1 "Boolean" UBYTE Methods_boolean 1 100 0.0 1.0 MAX_REFRESH 1000 1 ECU_ADDRESS 0x400E3821 /end MEASUREMENT
/begin MEASUREMENT MCore_RequestActive_5 "Boolean" UBYTE Methods_boolean 1 100 0.0 1.0 MAX_REFRESH 1000 1 ECU_ADDRESS 0x400E3822 /end MEASUREMENT
/begin MEASUREMENT MCore_RequestValue_2 "Boolean" UBYTE Methods_boolean 1 100 0.0 1.0 MAX_REFRESH 1000 1 ECU_ADDRESS 0x400E3823 /end MEASUREMENT
/begin MEASUREMENT MCore_RequestActive_6 "Boolean" UBYTE Methods_boolean 1 100 0.0 1.0 MAX_REFRESH 1000 1 ECU_ADDRESS 0x400E3824 /end MEASUREMENT
/begin MEASUREMENT MCore_RequestValue_3 "Boolean" UBYTE Methods_boolean 1 100 0.0 1.0 MAX_REFRESH 1000 1 ECU_ADDRESS 0x400E3825 /end MEASUREMENT
/begin MEASUREMENT MCore_RequestActive_7 "Boolean" UBYTE Methods_boolean 1 100 0.0 1.0 MAX_REFRESH 1000 1 ECU_ADDRESS 0x400E3826 /end MEASUREMENT
/begin MEASUREMENT MCore_RequestValue_4 "Boolean" UBYTE Methods_boolean 1 100 0.0 1.0 MAX_REFRESH 1000 1 ECU_ADDRESS 0x400E3827 /end MEASUREMENT
/begin MEASUREMENT MCore_RequestActive_8 "Boolean" UBYTE Methods_boolean 1 100 0.0 1.0 MAX_REFRESH 1000 1 ECU_ADDRESS 0x400E3828 /end MEASUREMENT
/begin MEASUREMENT MCore_RequestValue_5 "Boolean" UBYTE Methods_boolean 1 100 0.0 1.0 MAX_REFRESH 1000 1 ECU_ADDRESS 0x400E3829 /end MEASUREMENT
/begin MEASUREMENT MCore_RequestActive_9 "Boolean" UBYTE Methods_boolean 1 100 0.0 1.0 MAX_REFRESH 1000 1 ECU_ADDRESS 0x400E382A /end MEASUREMENT
/begin MEASUREMENT MCore_RequestValue_6 "Boolean" UBYTE Methods_boolean 1 100 0.0 1.0 MAX_REFRESH 1000 1 ECU_ADDRESS 0x400E382B /end MEASUREMENT
/begin MEASUREMENT MCore_RequestActive_10 "Boolean" UBYTE Methods_boolean 1 100 0.0 1.0 MAX_REFRESH 1000 1 ECU_ADDRESS 0x400E382C /end MEASUREMENT
/begin MEASUREMENT MCore_RequestValue_7 "Boolean" UBYTE Methods_boolean 1 100 0.0 1.0 MAX_REFRESH 1000 1 ECU_ADDRESS 0x400E382D /end MEASUREMENT
/begin MEASUREMENT MCore_RequestActive_11 "Boolean" UBYTE Methods_boolean 1 100 0.0 1.0 MAX_REFRESH 1000 1 ECU_ADDRESS 0x400E382E /end MEASUREMENT
/begin MEASUREMENT MCore_RequestValue_8 "Boolean" UBYTE Methods_boolean 1 100 0.0 1.0 MAX_REFRESH 1000 1 ECU_ADDRESS 0x400E382F /end MEASUREMENT
/begin MEASUREMENT MCore_RequestActive_12 "Boolean" UBYTE Methods_boolean 1 100 0.0 1.0 MAX_REFRESH 1000 1 ECU_ADDRESS 0x400E3830 /end MEASUREMENT
/begin MEASUREMENT MCore_RequestValue_9 "Boolean" UBYTE Methods_boolean 1 100 0.0 1.0 MAX_REFRESH 1000 1 ECU_ADDRESS 0x400E3831 /end MEASUREMENT
/begin MEASUREMENT MCore_RequestActive_13 "Boolean" UBYTE Methods_boolean 1 100 0.0 1.0 MAX_REFRESH 1000 1 ECU_ADDRESS 0x400E3832 /end MEASUREMENT
/begin MEASUREMENT MCore_RequestValue_10 "Boolean" UBYTE Methods_boolean 1 100 0.0 1.0 MAX_REFRESH 1000 1 ECU_ADDRESS 0x400E3833 /end MEASUREMENT
/begin MEASUREMENT MCore_RequestActive_14 "Boolean" UBYTE Methods_boolean 1 100 0.0 1.0 MAX_REFRESH 1000 1 ECU_ADDRESS 0x400E3834 /end MEASUREMENT
/begin MEASUREMENT MCore_RequestValue_11 "Boolean" UBYTE Methods_boolean 1 100 0.0 1.0 MAX_REFRESH 1000 1 ECU_ADDRESS 0x400E3835 /end MEASUREMENT
/begin MEASUREMENT MCore_RequestActive_15 "Boolean" UBYTE Methods_boolean 1 100 0.0 1.0 MAX_REFRESH 1000 1 ECU_ADDRESS 0x400E3836 /end MEASUREMENT
/begin MEASUREMENT MCore_RequestValue_12 "Boolean" UBYTE Methods_boolean 1 100 0.0 1.0 MAX_REFRESH 1000 1 ECU_ADDRESS 0x400E3837 /end MEASUREMENT
/begin MEASUREMENT MCore_RequestActive_16 "Boolean" UBYTE Methods_boolean 1 100 0.0 1.0 MAX_REFRESH 1000 1 ECU_ADDRESS 0x400E3838 /end MEASUREMENT
/begin MEASUREMENT MCore_RequestValue_13 "Boolean" UBYTE Methods_boolean 1 100 0.0 1.0 MAX_REFRESH 1000 1 ECU_ADDRESS 0x400E3839 /end MEASUREMENT
/begin MEASUREMENT MCore_RequestActive_17 "Boolean" UBYTE Methods_boolean 1 100 0.0 1.0 MAX_REFRESH 1000 1 ECU_ADDRESS 0x400E383A /end MEASUREMENT
/begin MEASUREMENT MCore_RequestValue_14 "Boolean" UBYTE Methods_boolean 1 100 0.0 1.0 MAX_REFRESH 1000 1 ECU_ADDRESS 0x400E383B /end MEASUREMENT
/begin MEASUREMENT MCore_RequestActive_18 "Boolean" UBYTE Methods_boolean 1 100 0.0 1.0 MAX_REFRESH 1000 1 ECU_ADDRESS 0x400E383C /end MEASUREMENT
/begin MEASUREMENT MCore_RequestValue_15 "Boolean" UBYTE Methods_boolean 1 100 0.0 1.0 MAX_REFRESH 1000 1 ECU_ADDRESS 0x400E383D /end MEASUREMENT
/begin MEASUREMENT MCore_RequestActive_19 "Boolean" UBYTE Methods_boolean 1 100 0.0 1.0 MAX_REFRESH 1000 1 ECU_ADDRESS 0x400E383E /end MEASUREMENT
/begin MEASUREMENT MCore_RequestValue_16 "Boolean" UBYTE Methods_boolean 1 100 0.0 1.0 MAX_REFRESH 1000 1 ECU_ADDRESS 0x400E383F /end MEASUREMENT
/begin MEASUREMENT MCore_RequestActive_20 "Boolean" UBYTE Methods_boolean 1 100 0.0 1.0 MAX_REFRESH 1000 1 ECU_ADDRESS 0x400E3840 /end MEASUREMENT
/begin MEASUREMENT MCore_RequestValue_17 "Boolean" UBYTE Methods_boolean 1 100 0.0 1.0 MAX_REFRESH 1000 1 ECU_ADDRESS 0x400E3841 /end MEASUREMENT
/begin MEASUREMENT MCore_RequestActive_21 "Boolean" UBYTE Methods_boolean 1 100 0.0 1.0 MAX_REFRESH 1000 1 ECU_ADDRESS 0x400E3842 /end MEASUREMENT
/begin MEASUREMENT MCore_RequestValue_18 "Boolean" UBYTE Methods_boolean 1 100 0.0 1.0 MAX_REFRESH 1000 1 ECU_ADDRESS 0x400E3843 /end MEASUREMENT
/begin MEASUREMENT MCore_RequestActive_22 "Boolean" UBYTE Methods_boolean 1 100 0.0 1.0 MAX_REFRESH 1000 1 ECU_ADDRESS 0x400E3844 /end MEASUREMENT
/begin MEASUREMENT MCore_RequestValue_19 "Boolean" UBYTE Methods_boolean 1 100 0.0 1.0 MAX_REFRESH 1000 1 ECU_ADDRESS 0x400E3845 /end MEASUREMENT
/begin MEASUREMENT MCore_RequestActive_23 "Boolean" UBYTE Methods_boolean 1 100 0.0 1.0 MAX_REFRESH 1000 1 ECU_ADDRESS 0x400E3846 /end MEASUREMENT
/begin MEASUREMENT MCore_RequestValue_20 "Boolean" UBYTE Methods_boolean 1 100 0.0 1.0 MAX_REFRESH 1000 1 ECU_ADDRESS 0x400E3847 /end MEASUREMENT
/begin MEASUREMENT MCore_RequestActive_24 "Boolean" UBYTE Methods_boolean 1 100 0.0 1.0 MAX_REFRESH 1000 1 ECU_ADDRESS 0x400E3848 /end MEASUREMENT
/begin MEASUREMENT MCore_RequestValue_21 "Boolean" UBYTE Methods_boolean 1 100 0.0 1.0 MAX_REFRESH 1000 1 ECU_ADDRESS 0x400E3849 /end MEASUREMENT
/begin MEASUREMENT MCore_RequestActive_25 "Boolean" UBYTE Methods_boolean 1 100 0.0 1.0 MAX_REFRESH 1000 1 ECU_ADDRESS 0x400E384A /end MEASUREMENT
/begin MEASUREMENT MCore_RequestValue_22 "Boolean" UBYTE Methods_boolean 1 100 0.0 1.0 MAX_REFRESH 1000 1 ECU_ADDRESS 0x400E384B /end MEASUREMENT
/begin MEASUREMENT MCore_RequestActive_26 "Boolean" UBYTE Methods_boolean 1 100 0.0 1.0 MAX_REFRESH 1000 1 ECU_ADDRESS 0x400E384C /end MEASUREMENT
/begin MEASUREMENT MCore_RequestValue_23 "Boolean" UBYTE Methods_boolean 1 100 0.0 1.0 MAX_REFRESH 1000 1 ECU_ADDRESS 0x400E384D /end MEASUREMENT
/begin MEASUREMENT MCore_RequestActive_27 "Boolean" UBYTE Methods_boolean 1 100 0.0 1.0 MAX_REFRESH 1000 1 ECU_ADDRESS 0x400E384E /end MEASUREMENT
/begin MEASUREMENT MCore_RequestValue_24 "Boolean" UBYTE Methods_boolean 1 100 0.0 1.0 MAX_REFRESH 1000 1 ECU_ADDRESS 0x400E384F /end MEASUREMENT
/begin MEASUREMENT MCore_RequestActive_28 "Boolean" UBYTE Methods_boolean 1 100 0.0 1.0 MAX_REFRESH 1000 1 ECU_ADDRESS 0x400E3850 /end MEASUREMENT
/begin MEASUREMENT MCore_RequestValue_25 "Boolean" UBYTE Methods_boolean 1 100 0.0 1.0 MAX_REFRESH 1000 1 ECU_ADDRESS 0x400E3851 /end MEASUREMENT
/begin MEASUREMENT MCore_RequestActive_29 "Boolean" UBYTE Methods_boolean 1 100 0.0 1.0 MAX_REFRESH 1000 1 ECU_ADDRESS 0x400E3852 /end MEASUREMENT
/begin MEASUREMENT MCore_RequestValue_26 "Boolean" UBYTE Methods_boolean 1 100 0.0 1.0 MAX_REFRESH 1000 1 ECU_ADDRESS 0x400E3853 /end MEASUREMENT
/begin MEASUREMENT MCore_RequestActive_30 "Boolean" UBYTE Methods_boolean 1 100 0.0 1.0 MAX_REFRESH 1000 1 ECU_ADDRESS 0x400E3854 /end MEASUREMENT
/begin MEASUREMENT MCore_RequestValue_27 "Boolean" UBYTE Methods_boolean 1 100 0.0 1.0 MAX_REFRESH 1000 1 ECU_ADDRESS 0x400E3855 /end MEASUREMENT
/begin MEASUREMENT MCore_RequestActive_31 "Boolean" UBYTE Methods_boolean 1 100 0.0 1.0 MAX_REFRESH 1000 1 ECU_ADDRESS 0x400E3856 /end MEASUREMENT
/begin MEASUREMENT MCore_RequestValue_28 "Boolean" UBYTE Methods_boolean 1 100 0.0 1.0 MAX_REFRESH 1000 1 ECU_ADDRESS 0x400E3857 /end MEASUREMENT
/begin MEASUREMENT MCore_RequestActive_32 "Boolean" UBYTE Methods_boolean 1 100 0.0 1.0 MAX_REFRESH 1000 1 ECU_ADDRESS 0x400E3858 /end MEASUREMENT
/begin MEASUREMENT MCore_RequestValue_29 "Boolean" UBYTE Methods_boolean 1 100 0.0 1.0 MAX_REFRESH 1000 1 ECU_ADDRESS 0x400E3859 /end MEASUREMENT
/begin MEASUREMENT MCore_RequestActive_33 "Boolean" UBYTE Methods_boolean 1 100 0.0 1.0 MAX_REFRESH 1000 1 ECU_ADDRESS 0x400E385A /end MEASUREMENT
/begin MEASUREMENT MCore_RequestValue_30 "Boolean" UBYTE Methods_boolean 1 100 0.0 1.0 MAX_REFRESH 1000 1 ECU_ADDRESS 0x400E385B /end MEASUREMENT
/begin MEASUREMENT MCore_RequestActive_34 "Boolean" UBYTE Methods_boolean 1 100 0.0 1.0 MAX_REFRESH 1000 1 ECU_ADDRESS 0x400E385C /end MEASUREMENT
/begin MEASUREMENT MCore_RequestValue_31 "Boolean" UBYTE Methods_boolean 1 100 0.0 1.0 MAX_REFRESH 1000 1 ECU_ADDRESS 0x400E385D /end MEASUREMENT
/begin MEASUREMENT MCore_RequestActive_35 "Boolean" UBYTE Methods_boolean 1 100 0.0 1.0 MAX_REFRESH 1000 1 ECU_ADDRESS 0x400E385E /end MEASUREMENT
/begin MEASUREMENT MCore_RequestValue_32 "Boolean" UBYTE Methods_boolean 1 100 0.0 1.0 MAX_REFRESH 1000 1 ECU_ADDRESS 0x400E385F /end MEASUREMENT
/begin MEASUREMENT MCore_RequestActive_36 "Boolean" UBYTE Methods_boolean 1 100 0.0 1.0 MAX_REFRESH 1000 1 ECU_ADDRESS 0x400E3860 /end MEASUREMENT
/begin MEASUREMENT MCore_RequestValue_33 "Boolean" UBYTE Methods_boolean 1 100 0.0 1.0 MAX_REFRESH 1000 1 ECU_ADDRESS 0x400E3861 /end MEASUREMENT
/begin MEASUREMENT MCore_RequestActive_37 "Boolean" UBYTE Methods_boolean 1 100 0.0 1.0 MAX_REFRESH 1000 1 ECU_ADDRESS 0x400E3862 /end MEASUREMENT
/begin MEASUREMENT MCore_RequestValue_34 "Boolean" UBYTE Methods_boolean 1 100 0.0 1.0 MAX_REFRESH 1000 1 ECU_ADDRESS 0x400E3863 /end MEASUREMENT
/begin MEASUREMENT MCore_RequestActive_38 "Boolean" UBYTE Methods_boolean 1 100 0.0 1.0 MAX_REFRESH 1000 1 ECU_ADDRESS 0x400E3864 /end MEASUREMENT
/begin MEASUREMENT MCore_RequestValue_35 "Boolean" UBYTE Methods_boolean 1 100 0.0 1.0 MAX_REFRESH 1000 1 ECU_ADDRESS 0x400E3865 /end MEASUREMENT
/begin MEASUREMENT MCore_RequestActive_39 "Boolean" UBYTE Methods_boolean 1 100 0.0 1.0 MAX_REFRESH 1000 1 ECU_ADDRESS 0x400E3866 /end MEASUREMENT
/begin MEASUREMENT MCore_RequestValue_36 "Boolean" UBYTE Methods_boolean 1 100 0.0 1.0 MAX_REFRESH 1000 1 ECU_ADDRESS 0x400E3867 /end MEASUREMENT
/begin MEASUREMENT MCore_RequestActive_40 "Boolean" UBYTE Methods_boolean 1 100 0.0 1.0 MAX_REFRESH 1000 1 ECU_ADDRESS 0x400E3868 /end MEASUREMENT
/begin MEASUREMENT MCore_RequestValue_37 "Boolean" UBYTE Methods_boolean 1 100 0.0 1.0 MAX_REFRESH 1000 1 ECU_ADDRESS 0x400E3869 /end MEASUREMENT
/begin MEASUREMENT MCore_RequestActive_41 "Boolean" UBYTE Methods_boolean 1 100 0.0 1.0 MAX_REFRESH 1000 1 ECU_ADDRESS 0x400E386A /end MEASUREMENT
/begin MEASUREMENT MCore_RequestValue_38 "Boolean" UBYTE Methods_boolean 1 100 0.0 1.0 MAX_REFRESH 1000 1 ECU_ADDRESS 0x400E386B /end MEASUREMENT
/begin MEASUREMENT MCore_RequestActive_42 "Boolean" UBYTE Methods_boolean 1 100 0.0 1.0 MAX_REFRESH 1000 1 ECU_ADDRESS 0x400E386C /end MEASUREMENT
/begin MEASUREMENT MCore_RequestValue_39 "Boolean" UBYTE Methods_boolean 1 100 0.0 1.0 MAX_REFRESH 1000 1 ECU_ADDRESS 0x400E386D /end MEASUREMENT
/begin MEASUREMENT MCore_RequestActive_43 "Boolean" UBYTE Methods_boolean 1 100 0.0 1.0 MAX_REFRESH 1000 1 ECU_ADDRESS 0x400E386E /end MEASUREMENT
/begin MEASUREMENT MCore_RequestValue_40 "Boolean" UBYTE Methods_boolean 1 100 0.0 1.0 MAX_REFRESH 1000 1 ECU_ADDRESS 0x400E386F /end MEASUREMENT
/begin MEASUREMENT MCore_RequestActive_44 "Boolean" UBYTE Methods_boolean 1 100 0.0 1.0 MAX_REFRESH 1000 1 ECU_ADDRESS 0x400E3870 /end MEASUREMENT
/begin MEASUREMENT MCore_RequestValue_41 "Boolean" UBYTE Methods_boolean 1 100 0.0 1.0 MAX_REFRESH 1000 1 ECU_ADDRESS 0x400E3871 /end MEASUREMENT
/begin MEASUREMENT MCore_RequestActive_45 "Boolean" UBYTE Methods_boolean 1 100 0.0 1.0 MAX_REFRESH 1000 1 ECU_ADDRESS 0x400E3872 /end MEASUREMENT
/begin MEASUREMENT MCore_RequestValue_42 "Boolean" UBYTE Methods_boolean 1 100 0.0 1.0 MAX_REFRESH 1000 1 ECU_ADDRESS 0x400E3873 /end MEASUREMENT
/begin MEASUREMENT MCore_RequestActive_46 "Boolean" UBYTE Methods_boolean 1 100 0.0 1.0 MAX_REFRESH 1000 1 ECU_ADDRESS 0x400E3874 /end MEASUREMENT
/begin MEASUREMENT MCore_RequestValue_43 "Boolean" UBYTE Methods_boolean 1 100 0.0 1.0 MAX_REFRESH 1000 1 ECU_ADDRESS 0x400E3875 /end MEASUREMENT
/begin MEASUREMENT MCore_RequestActive_47 "Boolean" UBYTE Methods_boolean 1 100 0.0 1.0 MAX_REFRESH 1000 1 ECU_ADDRESS 0x400E3876 /end MEASUREMENT
/begin MEASUREMENT MCore_RequestValue_44 "Boolean" UBYTE Methods_boolean 1 100 0.0 1.0 MAX_REFRESH 1000 1 ECU_ADDRESS 0x400E3877 /end MEASUREMENT
/begin MEASUREMENT MCore_RequestActive_48 "Boolean" UBYTE Methods_boolean 1 100 0.0 1.0 MAX_REFRESH 1000 1 ECU_ADDRESS 0x400E3878 /end MEASUREMENT
/begin MEASUREMENT MCore_RequestValue_45 "Boolean" UBYTE Methods_boolean 1 100 0.0 1.0 MAX_REFRESH 1000 1 ECU_ADDRESS 0x400E3879 /end MEASUREMENT
/begin MEASUREMENT MCore_RequestActive_49 "Boolean" UBYTE Methods_boolean 1 100 0.0 1.0 MAX_REFRESH 1000 1 ECU_ADDRESS 0x400E387A /end MEASUREMENT
/begin MEASUREMENT MCore_RequestValue_u8_2 "unsigned integer 8bit" UBYTE VW_BCM_CompuMethods_SC_F1_O0_UNoUnit 1 100 0.0 255.0 MAX_REFRESH 1000 1 ECU_ADDRESS 0x400E387B /end MEASUREMENT
/begin MEASUREMENT MCore_RequestActive_50 "Boolean" UBYTE Methods_boolean 1 100 0.0 1.0 MAX_REFRESH 1000 1 ECU_ADDRESS 0x400E387C /end MEASUREMENT
/begin MEASUREMENT MCore_RequestValue_u8_3 "unsigned integer 8bit" UBYTE VW_BCM_CompuMethods_SC_F1_O0_UNoUnit 1 100 0.0 255.0 MAX_REFRESH 1000 1 ECU_ADDRESS 0x400E387D /end MEASUREMENT
/begin MEASUREMENT MCore_RequestActive_51 "Boolean" UBYTE Methods_boolean 1 100 0.0 1.0 MAX_REFRESH 1000 1 ECU_ADDRESS 0x400E387E /end MEASUREMENT
/begin MEASUREMENT MCore_RequestValue_u8_4 "unsigned integer 8bit" UBYTE VW_BCM_CompuMethods_SC_F1_O0_UNoUnit 1 100 0.0 255.0 MAX_REFRESH 1000 1 ECU_ADDRESS 0x400E387F /end MEASUREMENT
/begin MEASUREMENT MCore_RequestActive_52 "Boolean" UBYTE Methods_boolean 1 100 0.0 1.0 MAX_REFRESH 1000 1 ECU_ADDRESS 0x400E3880 /end MEASUREMENT
/begin MEASUREMENT MCore_RequestValue_u8_5 "unsigned integer 8bit" UBYTE VW_BCM_CompuMethods_SC_F1_O0_UNoUnit 1 100 0.0 255.0 MAX_REFRESH 1000 1 ECU_ADDRESS 0x400E3881 /end MEASUREMENT
/begin MEASUREMENT MCore_rbd_Tc_numKlemme15Zas "" UBYTE VOID_SCALING 1 100 0 255 BYTE_ORDER MSB_LAST ECU_ADDRESS 0x400D96B8 /end MEASUREMENT
/begin MEASUREMENT MCore_rbd_Tc_numKlemme15ZasInv "" UBYTE VOID_SCALING 1 100 0 255 BYTE_ORDER MSB_LAST ECU_ADDRESS 0x400D96B9 /end MEASUREMENT
/begin MEASUREMENT MCore_rbd_Tc_numKlemmenfreigabeWfs "" UBYTE VOID_SCALING 1 100 0 255 BYTE_ORDER MSB_LAST ECU_ADDRESS 0x400D96C0 /end MEASUREMENT
/begin MEASUREMENT MCore_rbd_Tc_numKlemmenfreigabeWfsInv "" UBYTE VOID_SCALING 1 100 0 255 BYTE_ORDER MSB_LAST ECU_ADDRESS 0x400D96C1 /end MEASUREMENT
/begin MEASUREMENT MCore_rbd_Tc_numKlemmeStartwunschZas "" UBYTE VOID_SCALING 1 100 0 255 BYTE_ORDER MSB_LAST ECU_ADDRESS 0x400D96BE /end MEASUREMENT
/begin MEASUREMENT MCore_rbd_Tc_numKlemmeStartwunschZasInv "" UBYTE VOID_SCALING 1 100 0 255 BYTE_ORDER MSB_LAST ECU_ADDRESS 0x400D96BF /end MEASUREMENT
/begin MEASUREMENT MCore_rbd_Tc_numKlemmeSZas "" UBYTE VOID_SCALING 1 100 0 255 BYTE_ORDER MSB_LAST ECU_ADDRESS 0x400D96BA /end MEASUREMENT
/begin MEASUREMENT MCore_rbd_Tc_numKlemmeSZasEingang "" UBYTE VOID_SCALING 1 100 0 255 BYTE_ORDER MSB_LAST ECU_ADDRESS 0x400D96BB /end MEASUREMENT
/begin MEASUREMENT MCore_rbd_Tc_numKlemmeSZasEingangInv "" UBYTE VOID_SCALING 1 100 0 255 BYTE_ORDER MSB_LAST ECU_ADDRESS 0x400D96BC /end MEASUREMENT
/begin MEASUREMENT MCore_rbd_Tc_numKlemmeSZasInv "" UBYTE VOID_SCALING 1 100 0 255 BYTE_ORDER MSB_LAST ECU_ADDRESS 0x400D96BD /end MEASUREMENT
/begin MEASUREMENT MCore_rbd_Tc_s_ComModeChanged_TerminalCtrl "" UBYTE VOID_SCALING_a 1 100 0 1 BYTE_ORDER MSB_LAST ECU_ADDRESS 0x400D96C2 /end MEASUREMENT
/begin MEASUREMENT MCore_rbd_Tc_s_ComModeReq_TerminalCtrl "" UBYTE ComM_ModeType 1 100 0 2 BYTE_ORDER MSB_LAST ECU_ADDRESS 0x400D96C3 /end MEASUREMENT
/begin MEASUREMENT MCore_rbd_Tc_s_ERR_KL_15 "" UBYTE VOID_SCALING_a 1 100 0 1 BYTE_ORDER MSB_LAST ECU_ADDRESS 0x400D96C4 /end MEASUREMENT
/begin MEASUREMENT MCore_rbd_Tc_s_ERR_KL_75_typ "" UBYTE VOID_SCALING_a 1 100 0 1 BYTE_ORDER MSB_LAST ECU_ADDRESS 0x400D96DA /end MEASUREMENT
/begin MEASUREMENT MCore_rbd_Tc_s_ERR_KL_75a_typ "" UBYTE VOID_SCALING_a 1 100 0 1 BYTE_ORDER MSB_LAST ECU_ADDRESS 0x400D96DB /end MEASUREMENT
/begin MEASUREMENT MCore_rbd_Tc_s_ERR_KL_S "" UBYTE VOID_SCALING_a 1 100 0 1 BYTE_ORDER MSB_LAST ECU_ADDRESS 0x400D96C5 /end MEASUREMENT
/begin MEASUREMENT MCore_rbd_Tc_s_Fahrbereitschaft "" UBYTE VOID_SCALING_a 1 100 0 1 BYTE_ORDER MSB_LAST ECU_ADDRESS 0x528083C7 /end MEASUREMENT
/begin MEASUREMENT MCore_rbd_Tc_s_Fahrzeugbewegung "" UBYTE VOID_SCALING_a 1 100 0 1 BYTE_ORDER MSB_LAST ECU_ADDRESS 0x528083C8 /end MEASUREMENT
/begin MEASUREMENT MCore_rbd_Tc_s_fahrzeuggeschwindigkeit_E2E "" UWORD SC_F0pt01_O0_Ukmh 1 100 0 655.35 BYTE_ORDER MSB_LAST ECU_ADDRESS 0x400D96B2 /end MEASUREMENT
/begin MEASUREMENT MCore_rbd_Tc_s_fahrzeuggeschwindigkeit_E2E_valid "" UBYTE VOID_SCALING_a 1 100 0 1 BYTE_ORDER MSB_LAST ECU_ADDRESS 0x400D96D6 /end MEASUREMENT
/begin MEASUREMENT MCore_rbd_Tc_s_fahrzeuggeschwindigkeit_QM "" UWORD SC_F0pt01_O0_Ukmh 1 100 0 655.35 BYTE_ORDER MSB_LAST ECU_ADDRESS 0x400D96B4 /end MEASUREMENT
/begin MEASUREMENT MCore_rbd_Tc_s_fahrzeuggeschwindigkeit_valid_QM "" UBYTE VOID_SCALING_a 1 100 0 1 BYTE_ORDER MSB_LAST ECU_ADDRESS 0x400D96D7 /end MEASUREMENT
/begin MEASUREMENT MCore_rbd_Tc_s_KL_15 "" UBYTE VOID_SCALING_a 1 100 0 1 BYTE_ORDER MSB_LAST ECU_ADDRESS 0x400D96DC /end MEASUREMENT
/begin MEASUREMENT MCore_rbd_Tc_s_KL_15_JustChanged "" UBYTE VOID_SCALING_a 1 100 0 1 BYTE_ORDER MSB_LAST ECU_ADDRESS 0x400D96C6 /end MEASUREMENT
/begin MEASUREMENT MCore_rbd_Tc_s_KL_15_JustOn "" UBYTE VOID_SCALING_a 1 100 0 1 BYTE_ORDER MSB_LAST ECU_ADDRESS 0x400D96C7 /end MEASUREMENT
/begin MEASUREMENT MCore_rbd_Tc_s_KL_15_vfzg "" UBYTE VOID_SCALING_a 1 100 0 1 BYTE_ORDER MSB_LAST ECU_ADDRESS 0x400D96DD /end MEASUREMENT
/begin MEASUREMENT MCore_rbd_Tc_s_KL_15_vfzg_S "" UBYTE VOID_SCALING_a 1 100 0 1 BYTE_ORDER MSB_LAST ECU_ADDRESS 0x528083C9 /end MEASUREMENT
/begin MEASUREMENT MCore_rbd_Tc_s_KL_15_zas "" UBYTE VOID_SCALING_a 1 100 0 1 BYTE_ORDER MSB_LAST ECU_ADDRESS 0x528083CA /end MEASUREMENT
/begin MEASUREMENT MCore_rbd_Tc_s_KL_15_zas_INIT "" UBYTE VOID_SCALING_a 1 100 0 1 BYTE_ORDER MSB_LAST ECU_ADDRESS 0x400D96C8 /end MEASUREMENT
/begin MEASUREMENT MCore_rbd_Tc_s_KL_50 "" UBYTE VOID_SCALING_a 1 100 0 1 BYTE_ORDER MSB_LAST ECU_ADDRESS 0x400D96DE /end MEASUREMENT
/begin MEASUREMENT MCore_rbd_Tc_s_KL_50_5s "" UBYTE VOID_SCALING_a 1 100 0 1 BYTE_ORDER MSB_LAST ECU_ADDRESS 0x528083CB /end MEASUREMENT
/begin MEASUREMENT MCore_rbd_Tc_s_KL_75 "" UBYTE VOID_SCALING_a 1 100 0 1 BYTE_ORDER MSB_LAST ECU_ADDRESS 0x400D96DF /end MEASUREMENT
/begin MEASUREMENT MCore_rbd_Tc_s_KL_75_vfzg "" UBYTE VOID_SCALING_a 1 100 0 1 BYTE_ORDER MSB_LAST ECU_ADDRESS 0x400D96E0 /end MEASUREMENT
/begin MEASUREMENT MCore_rbd_Tc_s_KL_75a "" UBYTE VOID_SCALING_a 1 100 0 1 BYTE_ORDER MSB_LAST ECU_ADDRESS 0x400D96E1 /end MEASUREMENT
/begin MEASUREMENT MCore_rbd_Tc_s_KL_75a_vfzg "" UBYTE VOID_SCALING_a 1 100 0 1 BYTE_ORDER MSB_LAST ECU_ADDRESS 0x400D96E2 /end MEASUREMENT
/begin MEASUREMENT MCore_rbd_Tc_s_KL_S "" UBYTE VOID_SCALING_a 1 100 0 1 BYTE_ORDER MSB_LAST ECU_ADDRESS 0x400D96E3 /end MEASUREMENT
/begin MEASUREMENT MCore_rbd_Tc_s_KL_S_zas "" UBYTE VOID_SCALING_a 1 100 0 1 BYTE_ORDER MSB_LAST ECU_ADDRESS 0x400D96E4 /end MEASUREMENT
/begin MEASUREMENT MCore_rbd_Tc_s_KL_S_zas_INIT "" UBYTE VOID_SCALING_a 1 100 0 1 BYTE_ORDER MSB_LAST ECU_ADDRESS 0x400D96C9 /end MEASUREMENT
/begin MEASUREMENT MCore_rbd_Tc_s_kl_s_zas_mM_db_INIT "" UBYTE VOID_SCALING_a 1 100 0 1 BYTE_ORDER MSB_LAST ECU_ADDRESS 0x400D96D8 /end MEASUREMENT
/begin MEASUREMENT MCore_rbd_Tc_s_KL_S_zas_wfs "" UBYTE VOID_SCALING_a 1 100 0 1 BYTE_ORDER MSB_LAST ECU_ADDRESS 0x528083CC /end MEASUREMENT
/begin MEASUREMENT MCore_rbd_Tc_s_KL_Startwunsch "" UBYTE VOID_SCALING_a 1 100 0 1 BYTE_ORDER MSB_LAST ECU_ADDRESS 0x400D96E5 /end MEASUREMENT
/begin MEASUREMENT MCore_rbd_Tc_s_KL_Startwunsch_zas_INIT "" UBYTE VOID_SCALING_a 1 100 0 1 BYTE_ORDER MSB_LAST ECU_ADDRESS 0x400D96CA /end MEASUREMENT
/begin MEASUREMENT MCore_rbd_Tc_s_Klemme15Zas_NIR_valid "" UBYTE VOID_SCALING_a 1 100 0 1 BYTE_ORDER MSB_LAST ECU_ADDRESS 0x400D96CC /end MEASUREMENT
/begin MEASUREMENT MCore_rbd_Tc_s_KlemmenfreigabeWfs_INIT "" UBYTE VOID_SCALING_a 1 100 0 1 BYTE_ORDER MSB_LAST ECU_ADDRESS 0x400D96D0 /end MEASUREMENT
/begin MEASUREMENT MCore_rbd_Tc_s_KlemmenfreigabeWfs_NIR_valid "" UBYTE VOID_SCALING_a 1 100 0 1 BYTE_ORDER MSB_LAST ECU_ADDRESS 0x400D96D1 /end MEASUREMENT
/begin MEASUREMENT MCore_rbd_Tc_s_KlemmeStartwunschZas_NIR_valid "" UBYTE VOID_SCALING_a 1 100 0 1 BYTE_ORDER MSB_LAST ECU_ADDRESS 0x400D96CF /end MEASUREMENT
/begin MEASUREMENT MCore_rbd_Tc_s_KlemmeSZas_NIR_valid "" UBYTE VOID_SCALING_a 1 100 0 1 BYTE_ORDER MSB_LAST ECU_ADDRESS 0x400D96CE /end MEASUREMENT
/begin MEASUREMENT MCore_rbd_Tc_s_KlemmeSZasEingang_NIR_valid "" UBYTE VOID_SCALING_a 1 100 0 1 BYTE_ORDER MSB_LAST ECU_ADDRESS 0x400D96CD /end MEASUREMENT
/begin MEASUREMENT MCore_rbd_Tc_s_KST_Warn_P2_ZST_def "" UBYTE VOID_SCALING_a 1 100 0 1 BYTE_ORDER MSB_LAST ECU_ADDRESS 0x400D96CB /end MEASUREMENT
/begin MEASUREMENT MCore_rbd_Tc_s_KST_Zuendungswarnung "" UBYTE VOID_SCALING 1 100 0 255 BYTE_ORDER MSB_LAST ECU_ADDRESS 0x528083CD /end MEASUREMENT
/begin MEASUREMENT MCore_rbd_Tc_s_KST_Zuendungswarnung_INIT "" UBYTE VOID_SCALING 1 100 0 255 BYTE_ORDER MSB_LAST ECU_ADDRESS 0x528083CE /end MEASUREMENT
/begin MEASUREMENT MCore_rbd_Tc_s_KST_Zuendungswarnung_NVM_IN "" UBYTE VOID_SCALING 1 100 0 255 BYTE_ORDER MSB_LAST ECU_ADDRESS 0x400D96E6 /end MEASUREMENT
/begin MEASUREMENT MCore_rbd_Tc_s_KST_Zuendungswarnung_NVM_OUT "" UBYTE VOID_SCALING 1 100 0 255 BYTE_ORDER MSB_LAST ECU_ADDRESS 0x400D96E7 /end MEASUREMENT
/begin MEASUREMENT MCore_rbd_Tc_s_MO_Kl_75_can1 "" UBYTE VOID_SCALING_a 1 100 0 1 BYTE_ORDER MSB_LAST ECU_ADDRESS 0x400D96E8 /end MEASUREMENT
/begin MEASUREMENT MCore_rbd_Tc_s_MO_StartStopp_Wiederstart_can1 "" UBYTE VOID_SCALING_a 1 100 0 1 BYTE_ORDER MSB_LAST ECU_ADDRESS 0x400D96E9 /end MEASUREMENT
/begin MEASUREMENT MCore_rbd_Tc_s_Motor_14_ErrStatus "" UBYTE VOID_SCALING 1 100 0 255 BYTE_ORDER MSB_LAST ECU_ADDRESS 0x400D96D2 /end MEASUREMENT
/begin MEASUREMENT MCore_rbd_Tc_s_motor_lief "" UBYTE VOID_SCALING_a 1 100 0 1 BYTE_ORDER MSB_LAST ECU_ADDRESS 0x528083CF /end MEASUREMENT
/begin MEASUREMENT MCore_rbd_Tc_s_NoIniRamValid_INIT "" UBYTE VOID_SCALING_a 1 100 0 1 BYTE_ORDER MSB_LAST ECU_ADDRESS 0x400D96D3 /end MEASUREMENT
/begin MEASUREMENT MCore_rbd_Tc_s_RequestFullComm_TerminalCtrl "" UBYTE VOID_SCALING_a 1 100 0 1 BYTE_ORDER MSB_LAST ECU_ADDRESS 0x400D96D4 /end MEASUREMENT
/begin MEASUREMENT MCore_rbd_Tc_s_timer_KL15_active_sec "" UWORD VOID_SCALING_b 1 100 0 65535 BYTE_ORDER MSB_LAST ECU_ADDRESS 0x400D96B6 /end MEASUREMENT
/begin MEASUREMENT MCore_rbd_Tc_s_VRollEnd "" UBYTE VOID_SCALING_a 1 100 0 1 BYTE_ORDER MSB_LAST ECU_ADDRESS 0x400D96EA /end MEASUREMENT
/begin MEASUREMENT MCore_rbd_Tc_s_VRollEnd_QM "" UBYTE VOID_SCALING_a 1 100 0 1 BYTE_ORDER MSB_LAST ECU_ADDRESS 0x400D96EB /end MEASUREMENT
/begin MEASUREMENT MCore_rbd_Tc_s_WakeupReason_TerminalCtrl "" UBYTE VOID_SCALING 1 100 0 255 BYTE_ORDER MSB_LAST ECU_ADDRESS 0x400D96D5 /end MEASUREMENT
/begin MEASUREMENT MCore_rbd_SpnSen_CounterZat1_NIR_valid "" UBYTE VOID_SCALING_a 1 100 0 1 BYTE_ORDER MSB_LAST ECU_ADDRESS 0x400D95E2 /end MEASUREMENT
/begin MEASUREMENT MCore_rbd_SpnSen_CounterZat2_NIR_valid "" UBYTE VOID_SCALING_a 1 100 0 1 BYTE_ORDER MSB_LAST ECU_ADDRESS 0x400D95E3 /end MEASUREMENT
/begin MEASUREMENT MCore_rbd_SpnSen_Klemme15Zat_NIR_valid "" UBYTE VOID_SCALING_a 1 100 0 1 BYTE_ORDER MSB_LAST ECU_ADDRESS 0x400D95E4 /end MEASUREMENT
/begin MEASUREMENT MCore_rbd_SpnSen_KlemmeStartwunschZat_NIR_valid "" UBYTE VOID_SCALING_a 1 100 0 1 BYTE_ORDER MSB_LAST ECU_ADDRESS 0x400D95E6 /end MEASUREMENT
/begin MEASUREMENT MCore_rbd_SpnSen_KlemmeSZat_NIR_valid "" UBYTE VOID_SCALING_a 1 100 0 1 BYTE_ORDER MSB_LAST ECU_ADDRESS 0x400D95E5 /end MEASUREMENT
/begin MEASUREMENT MCore_rbd_SpnSen_KurzschlussZat1Zat2_NIR_valid "" UBYTE VOID_SCALING_a 1 100 0 1 BYTE_ORDER MSB_LAST ECU_ADDRESS 0x400D95E7 /end MEASUREMENT
/begin MEASUREMENT MCore_rbd_SpnSen_numCounterZat1_NIR "" UBYTE VOID_SCALING 1 100 0 255 BYTE_ORDER MSB_LAST ECU_ADDRESS 0x400D95EB /end MEASUREMENT
/begin MEASUREMENT MCore_rbd_SpnSen_numCounterZat1Inv_NIR "" UBYTE VOID_SCALING 1 100 0 255 BYTE_ORDER MSB_LAST ECU_ADDRESS 0x400D95EA /end MEASUREMENT
/begin MEASUREMENT MCore_rbd_SpnSen_numCounterZat2_NIR "" UBYTE VOID_SCALING 1 100 0 255 BYTE_ORDER MSB_LAST ECU_ADDRESS 0x400D95ED /end MEASUREMENT
/begin MEASUREMENT MCore_rbd_SpnSen_numCounterZat2Inv_NIR "" UBYTE VOID_SCALING 1 100 0 255 BYTE_ORDER MSB_LAST ECU_ADDRESS 0x400D95EC /end MEASUREMENT
/begin MEASUREMENT MCore_rbd_SpnSen_numKlemme15Zat_NIR "" UBYTE VOID_SCALING 1 100 0 255 BYTE_ORDER MSB_LAST ECU_ADDRESS 0x400D95EF /end MEASUREMENT
/begin MEASUREMENT MCore_rbd_SpnSen_numKlemme15ZatInv_NIR "" UBYTE VOID_SCALING 1 100 0 255 BYTE_ORDER MSB_LAST ECU_ADDRESS 0x400D95EE /end MEASUREMENT
/begin MEASUREMENT MCore_rbd_SpnSen_numKlemmeStartwunschZat_NIR "" UBYTE VOID_SCALING 1 100 0 255 BYTE_ORDER MSB_LAST ECU_ADDRESS 0x400D95F3 /end MEASUREMENT
/begin MEASUREMENT MCore_rbd_SpnSen_numKlemmeStartwunschZatInv_NIR "" UBYTE VOID_SCALING 1 100 0 255 BYTE_ORDER MSB_LAST ECU_ADDRESS 0x400D95F2 /end MEASUREMENT
/begin MEASUREMENT MCore_rbd_SpnSen_numKlemmeSZat_NIR "" UBYTE VOID_SCALING 1 100 0 255 BYTE_ORDER MSB_LAST ECU_ADDRESS 0x400D95F1 /end MEASUREMENT
/begin MEASUREMENT MCore_rbd_SpnSen_numKlemmeSZatInv_NIR "" UBYTE VOID_SCALING 1 100 0 255 BYTE_ORDER MSB_LAST ECU_ADDRESS 0x400D95F0 /end MEASUREMENT
/begin MEASUREMENT MCore_rbd_SpnSen_numKurzschlussZat1Zat2_NIR "" UBYTE VOID_SCALING 1 100 0 255 BYTE_ORDER MSB_LAST ECU_ADDRESS 0x400D95F5 /end MEASUREMENT
/begin MEASUREMENT MCore_rbd_SpnSen_numKurzschlussZat1Zat2Inv_NIR "" UBYTE VOID_SCALING 1 100 0 255 BYTE_ORDER MSB_LAST ECU_ADDRESS 0x400D95F4 /end MEASUREMENT
/begin MEASUREMENT MCore_rbd_SpnSen_numPowerOnErkannt_NIR "" UBYTE VOID_SCALING 1 100 0 255 BYTE_ORDER MSB_LAST ECU_ADDRESS 0x400D95F7 /end MEASUREMENT
/begin MEASUREMENT MCore_rbd_SpnSen_numPowerOnErkanntInv_NIR "" UBYTE VOID_SCALING 1 100 0 255 BYTE_ORDER MSB_LAST ECU_ADDRESS 0x400D95F6 /end MEASUREMENT
/begin MEASUREMENT MCore_rbd_SpnSen_numZatBetaetigt_NIR "" UBYTE VOID_SCALING 1 100 0 255 BYTE_ORDER MSB_LAST ECU_ADDRESS 0x400D95F9 /end MEASUREMENT
/begin MEASUREMENT MCore_rbd_SpnSen_numZatBetaetigtInv_NIR "" UBYTE VOID_SCALING 1 100 0 255 BYTE_ORDER MSB_LAST ECU_ADDRESS 0x400D95F8 /end MEASUREMENT
/begin MEASUREMENT MCore_rbd_SpnSen_p_dtc_set_s_ERR_ElvRelease_IMPLAUS "" UBYTE VOID_SCALING 1 100 0 255 BYTE_ORDER MSB_LAST ECU_ADDRESS 0x400D95FA /end MEASUREMENT
/begin MEASUREMENT MCore_rbd_SpnSen_p_dtc_set_s_ERR_WfsCoding_IMPLAUS "" UBYTE VOID_SCALING 1 100 0 255 BYTE_ORDER MSB_LAST ECU_ADDRESS 0x400D95FB /end MEASUREMENT
/begin MEASUREMENT MCore_rbd_SpnSen_p_dtc_set_s_ERR_ZAT_1_NO_SIG "" UBYTE VOID_SCALING 1 100 0 255 BYTE_ORDER MSB_LAST ECU_ADDRESS 0x400D95FC /end MEASUREMENT
/begin MEASUREMENT MCore_rbd_SpnSen_p_dtc_set_s_ERR_ZAT_1_SC_GND "" UBYTE VOID_SCALING 1 100 0 255 BYTE_ORDER MSB_LAST ECU_ADDRESS 0x400D95FD /end MEASUREMENT
/begin MEASUREMENT MCore_rbd_SpnSen_p_dtc_set_s_ERR_ZAT_2_NO_SIG "" UBYTE VOID_SCALING 1 100 0 255 BYTE_ORDER MSB_LAST ECU_ADDRESS 0x400D95FE /end MEASUREMENT
/begin MEASUREMENT MCore_rbd_SpnSen_p_dtc_set_s_ERR_ZAT_2_SC_GND "" UBYTE VOID_SCALING 1 100 0 255 BYTE_ORDER MSB_LAST ECU_ADDRESS 0x400D95FF /end MEASUREMENT
/begin MEASUREMENT MCore_rbd_SpnSen_p_mwb_status_fzggeschw_signalzust "" UBYTE VOID_SCALING 1 100 0 255 BYTE_ORDER MSB_LAST ECU_ADDRESS 0x400D9612 /end MEASUREMENT
/begin MEASUREMENT MCore_rbd_SpnSen_p_mwb_status_timer_Freigabe_der_Klemme "" UWORD VOID_SCALING_d 1 100 0 65535 BYTE_ORDER MSB_LAST ECU_ADDRESS 0x528082CC /end MEASUREMENT
/begin MEASUREMENT MCore_rbd_SpnSen_p_mwb_status_timer_klemme_s_timeout_sec "" ULONG VOID_SCALING_c 1 100 0 4294967295 BYTE_ORDER MSB_LAST ECU_ADDRESS 0x528082C8 /end MEASUREMENT
/begin MEASUREMENT MCore_rbd_SpnSen_PowerOnErkannt_NIR_valid "" UBYTE VOID_SCALING_a 1 100 0 1 BYTE_ORDER MSB_LAST ECU_ADDRESS 0x400D95E8 /end MEASUREMENT
/begin MEASUREMENT MCore_rbd_SpnSen_s_anf_KL15_by_KL30_justOn "" UBYTE VOID_SCALING_a 1 100 0 1 BYTE_ORDER MSB_LAST ECU_ADDRESS 0x528082D7 /end MEASUREMENT
/begin MEASUREMENT MCore_rbd_SpnSen_s_anf_KL15_OFF_diag_justOn "" UBYTE VOID_SCALING_a 1 100 0 1 BYTE_ORDER MSB_LAST ECU_ADDRESS 0x528082D5 /end MEASUREMENT
/begin MEASUREMENT MCore_rbd_SpnSen_s_anf_KL15_ON_diag_justOn "" UBYTE VOID_SCALING_a 1 100 0 1 BYTE_ORDER MSB_LAST ECU_ADDRESS 0x528082D6 /end MEASUREMENT
/begin MEASUREMENT MCore_rbd_SpnSen_s_anf_klemme_startwunsch "" UBYTE VOID_SCALING_a 1 100 0 1 BYTE_ORDER MSB_LAST ECU_ADDRESS 0x528082D8 /end MEASUREMENT
/begin MEASUREMENT MCore_rbd_SpnSen_s_anf_klemmenfreigabe_elv "" UBYTE VOID_SCALING_a 1 100 0 1 BYTE_ORDER MSB_LAST ECU_ADDRESS 0x528082D9 /end MEASUREMENT
/begin MEASUREMENT MCore_rbd_SpnSen_s_anf_klemmenfreigabe_wfs "" UBYTE VOID_SCALING_a 1 100 0 1 BYTE_ORDER MSB_LAST ECU_ADDRESS 0x528082DA /end MEASUREMENT
/begin MEASUREMENT MCore_rbd_SpnSen_s_antriebsstrangaktivierung_erlauben_wfs "" UBYTE VOID_SCALING_a 1 100 0 1 BYTE_ORDER MSB_LAST ECU_ADDRESS 0x400D961A /end MEASUREMENT
/begin MEASUREMENT MCore_rbd_SpnSen_s_antriebsstrangaktivierung_verhindern_pmode "" UBYTE VOID_SCALING_a 1 100 0 1 BYTE_ORDER MSB_LAST ECU_ADDRESS 0x400D961B /end MEASUREMENT
/begin MEASUREMENT MCore_rbd_SpnSen_s_ComModeReq_SpnSen "" UBYTE ComM_ModeType 1 100 0 2 BYTE_ORDER MSB_LAST ECU_ADDRESS 0x400D9600 /end MEASUREMENT
/begin MEASUREMENT MCore_rbd_SpnSen_s_counter_kl15_zat_1_actuations "" UBYTE VOID_SCALING 1 100 0 255 BYTE_ORDER MSB_LAST ECU_ADDRESS 0x400D961C /end MEASUREMENT
/begin MEASUREMENT MCore_rbd_SpnSen_s_counter_kl15_zat_1_actuations_INIT "" UBYTE VOID_SCALING 1 100 0 255 BYTE_ORDER MSB_LAST ECU_ADDRESS 0x400D960A /end MEASUREMENT
/begin MEASUREMENT MCore_rbd_SpnSen_s_counter_kl15_zat_2_actuations "" UBYTE VOID_SCALING 1 100 0 255 BYTE_ORDER MSB_LAST ECU_ADDRESS 0x400D961D /end MEASUREMENT
/begin MEASUREMENT MCore_rbd_SpnSen_s_counter_kl15_zat_2_actuations_INIT "" UBYTE VOID_SCALING 1 100 0 255 BYTE_ORDER MSB_LAST ECU_ADDRESS 0x400D960B /end MEASUREMENT
/begin MEASUREMENT MCore_rbd_SpnSen_s_counter_zat_actuations "" UBYTE VOID_SCALING 1 100 0 255 BYTE_ORDER MSB_LAST ECU_ADDRESS 0x528082DB /end MEASUREMENT
/begin MEASUREMENT MCore_rbd_SpnSen_s_elv_detected_intern "" UBYTE VOID_SCALING 1 100 0 255 BYTE_ORDER MSB_LAST ECU_ADDRESS 0x528082DC /end MEASUREMENT
/begin MEASUREMENT MCore_rbd_SpnSen_s_elv_entriegelt "" UBYTE VOID_SCALING_a 1 100 0 1 BYTE_ORDER MSB_LAST ECU_ADDRESS 0x400D961E /end MEASUREMENT
/begin MEASUREMENT MCore_rbd_SpnSen_s_ERR_ElvRelease_IMPLAUS "" UBYTE VOID_SCALING_a 1 100 0 1 BYTE_ORDER MSB_LAST ECU_ADDRESS 0x400D9601 /end MEASUREMENT
/begin MEASUREMENT MCore_rbd_SpnSen_s_ERR_SC_ZAT1_ZAT2 "" UBYTE VOID_SCALING_a 1 100 0 1 BYTE_ORDER MSB_LAST ECU_ADDRESS 0x528082CE /end MEASUREMENT
/begin MEASUREMENT MCore_rbd_SpnSen_s_ERR_WfsCoding_IMPLAUS "" UBYTE VOID_SCALING_a 1 100 0 1 BYTE_ORDER MSB_LAST ECU_ADDRESS 0x400D9602 /end MEASUREMENT
/begin MEASUREMENT MCore_rbd_SpnSen_s_ERR_ZAT_1_NO_SIG "" UBYTE VOID_SCALING_a 1 100 0 1 BYTE_ORDER MSB_LAST ECU_ADDRESS 0x400D9613 /end MEASUREMENT
/begin MEASUREMENT MCore_rbd_SpnSen_s_ERR_ZAT_1_SC_GND "" UBYTE VOID_SCALING_a 1 100 0 1 BYTE_ORDER MSB_LAST ECU_ADDRESS 0x400D9614 /end MEASUREMENT
/begin MEASUREMENT MCore_rbd_SpnSen_s_ERR_ZAT_2_NO_SIG "" UBYTE VOID_SCALING_a 1 100 0 1 BYTE_ORDER MSB_LAST ECU_ADDRESS 0x400D9615 /end MEASUREMENT
/begin MEASUREMENT MCore_rbd_SpnSen_s_ERR_ZAT_2_SC_GND "" UBYTE VOID_SCALING_a 1 100 0 1 BYTE_ORDER MSB_LAST ECU_ADDRESS 0x400D9616 /end MEASUREMENT
/begin MEASUREMENT MCore_rbd_SpnSen_s_esp_wecken "" UBYTE VOID_SCALING_a 1 100 0 1 BYTE_ORDER MSB_LAST ECU_ADDRESS 0x400D960C /end MEASUREMENT
/begin MEASUREMENT MCore_rbd_SpnSen_s_fahrzeuggeschwindigkeit_E2E "" UWORD SC_F0pt01_O0_Ukmh 1 100 0 655.35 BYTE_ORDER MSB_LAST ECU_ADDRESS 0x400D95E0 /end MEASUREMENT
/begin MEASUREMENT MCore_rbd_SpnSen_s_fahrzeuggeschwindigkeit_E2E_valid "" UBYTE EQ_LSB_1_b 1 100 0 1 BYTE_ORDER MSB_LAST ECU_ADDRESS 0x400D961F /end MEASUREMENT
/begin MEASUREMENT MCore_rbd_SpnSen_s_hinweis_notabschaltung "" UBYTE VOID_SCALING_a 1 100 0 1 BYTE_ORDER MSB_LAST ECU_ADDRESS 0x400D960D /end MEASUREMENT
/begin MEASUREMENT MCore_rbd_SpnSen_s_KL_15_emergency_deactivation "" UBYTE VOID_SCALING_a 1 100 0 1 BYTE_ORDER MSB_LAST ECU_ADDRESS 0x528082CF /end MEASUREMENT
/begin MEASUREMENT MCore_rbd_SpnSen_s_KL_15_emergency_deactivation_zat_lang_justOn "" UBYTE VOID_SCALING_a 1 100 0 1 BYTE_ORDER MSB_LAST ECU_ADDRESS 0x528082D0 /end MEASUREMENT
/begin MEASUREMENT MCore_rbd_SpnSen_s_KL_15_emergency_deactivation_zat_multi_justOn "" UBYTE VOID_SCALING_a 1 100 0 1 BYTE_ORDER MSB_LAST ECU_ADDRESS 0x528082D1 /end MEASUREMENT
/begin MEASUREMENT MCore_rbd_SpnSen_s_KL_15_zat "" UBYTE VOID_SCALING_a 1 100 0 1 BYTE_ORDER MSB_LAST ECU_ADDRESS 0x528082D2 /end MEASUREMENT
/begin MEASUREMENT MCore_rbd_SpnSen_s_KL_15_zat_INIT "" UBYTE VOID_SCALING_a 1 100 0 1 BYTE_ORDER MSB_LAST ECU_ADDRESS 0x400D9603 /end MEASUREMENT
/begin MEASUREMENT MCore_rbd_SpnSen_s_KL_S_zat "" UBYTE VOID_SCALING_a 1 100 0 1 BYTE_ORDER MSB_LAST ECU_ADDRESS 0x528082D3 /end MEASUREMENT
/begin MEASUREMENT MCore_rbd_SpnSen_s_KL_S_zat_INIT "" UBYTE VOID_SCALING_a 1 100 0 1 BYTE_ORDER MSB_LAST ECU_ADDRESS 0x400D9604 /end MEASUREMENT
/begin MEASUREMENT MCore_rbd_SpnSen_s_KL_Startwunsch_zat_INIT "" UBYTE VOID_SCALING_a 1 100 0 1 BYTE_ORDER MSB_LAST ECU_ADDRESS 0x400D9605 /end MEASUREMENT
/begin MEASUREMENT MCore_rbd_SpnSen_s_kl15_zat1_mM_db "" UBYTE VOID_SCALING_a 1 100 0 1 BYTE_ORDER MSB_LAST ECU_ADDRESS 0x400D9620 /end MEASUREMENT
/begin MEASUREMENT MCore_rbd_SpnSen_s_kl15_zat1_mM_suspend "" UBYTE VOID_SCALING_a 1 100 0 1 BYTE_ORDER MSB_LAST ECU_ADDRESS 0x400D9621 /end MEASUREMENT
/begin MEASUREMENT MCore_rbd_SpnSen_s_kl15_zat2_mM_db "" UBYTE VOID_SCALING_a 1 100 0 1 BYTE_ORDER MSB_LAST ECU_ADDRESS 0x400D9622 /end MEASUREMENT
/begin MEASUREMENT MCore_rbd_SpnSen_s_kl15_zat2_mM_suspend "" UBYTE VOID_SCALING_a 1 100 0 1 BYTE_ORDER MSB_LAST ECU_ADDRESS 0x400D9623 /end MEASUREMENT
/begin MEASUREMENT MCore_rbd_SpnSen_s_klemmen_hochschalten_sperren "" UBYTE VOID_SCALING_a 1 100 0 1 BYTE_ORDER MSB_LAST ECU_ADDRESS 0x400D9624 /end MEASUREMENT
/begin MEASUREMENT MCore_rbd_SpnSen_s_klemmenfreigabe_wfs_intern "" UBYTE VOID_SCALING_a 1 100 0 1 BYTE_ORDER MSB_LAST ECU_ADDRESS 0x400D9625 /end MEASUREMENT
/begin MEASUREMENT MCore_rbd_SpnSen_s_kurzschluss_zat1_zat2_INIT "" UBYTE VOID_SCALING_a 1 100 0 1 BYTE_ORDER MSB_LAST ECU_ADDRESS 0x400D960E /end MEASUREMENT
/begin MEASUREMENT MCore_rbd_SpnSen_s_motor_drehzahl_ungueltig "" UBYTE VOID_SCALING_a 1 100 0 1 BYTE_ORDER MSB_LAST ECU_ADDRESS 0x400D9626 /end MEASUREMENT
/begin MEASUREMENT MCore_rbd_SpnSen_s_motor_drehzahl_veraltet "" UBYTE VOID_SCALING_a 1 100 0 1 BYTE_ORDER MSB_LAST ECU_ADDRESS 0x400D9627 /end MEASUREMENT
/begin MEASUREMENT MCore_rbd_SpnSen_s_motor_laeuft "" UBYTE VOID_SCALING_a 1 100 0 1 BYTE_ORDER MSB_LAST ECU_ADDRESS 0x400D9628 /end MEASUREMENT
/begin MEASUREMENT MCore_rbd_SpnSen_s_NoIniRamValid_INIT "" UBYTE VOID_SCALING_a 1 100 0 1 BYTE_ORDER MSB_LAST ECU_ADDRESS 0x400D9606 /end MEASUREMENT
/begin MEASUREMENT MCore_rbd_SpnSen_s_Pattern_KL15enableKL30 "" UBYTE VOID_SCALING 1 100 0 255 BYTE_ORDER MSB_LAST ECU_ADDRESS 0x400D9617 /end MEASUREMENT
/begin MEASUREMENT MCore_rbd_SpnSen_s_Pattern_KL15enableKL30_NVM_IN "" UBYTE VOID_SCALING 1 100 0 255 BYTE_ORDER MSB_LAST ECU_ADDRESS 0x400D9618 /end MEASUREMENT
/begin MEASUREMENT MCore_rbd_SpnSen_s_Pattern_KL15enableKL30_NVM_OUT "" UBYTE VOID_SCALING 1 100 0 255 BYTE_ORDER MSB_LAST ECU_ADDRESS 0x400D9619 /end MEASUREMENT
/begin MEASUREMENT MCore_rbd_SpnSen_s_PowerOnErkannt "" UBYTE VOID_SCALING_a 1 100 0 1 BYTE_ORDER MSB_LAST ECU_ADDRESS 0x528082D4 /end MEASUREMENT
/begin MEASUREMENT MCore_rbd_SpnSen_s_PowerOnErkannt_INIT "" UBYTE VOID_SCALING_a 1 100 0 1 BYTE_ORDER MSB_LAST ECU_ADDRESS 0x400D9607 /end MEASUREMENT
/begin MEASUREMENT MCore_rbd_SpnSen_s_RequestFullComm_SpnSen "" UBYTE VOID_SCALING_a 1 100 0 1 BYTE_ORDER MSB_LAST ECU_ADDRESS 0x400D9608 /end MEASUREMENT
/begin MEASUREMENT MCore_rbd_SpnSen_s_spn_anzeige_fehlermode2 "" UBYTE VOID_SCALING_a 1 100 0 1 BYTE_ORDER MSB_LAST ECU_ADDRESS 0x400D960F /end MEASUREMENT
/begin MEASUREMENT MCore_rbd_SpnSen_s_spn_fehlermode2_aktiv "" UBYTE VOID_SCALING_a 1 100 0 1 BYTE_ORDER MSB_LAST ECU_ADDRESS 0x400D9629 /end MEASUREMENT
/begin MEASUREMENT MCore_rbd_SpnSen_s_startwunsch "" UBYTE VOID_SCALING_a 1 100 0 1 BYTE_ORDER MSB_LAST ECU_ADDRESS 0x400D962A /end MEASUREMENT
/begin MEASUREMENT MCore_rbd_SpnSen_s_stopp_mode_aktiv "" UBYTE VOID_SCALING_a 1 100 0 1 BYTE_ORDER MSB_LAST ECU_ADDRESS 0x400D962B /end MEASUREMENT
/begin MEASUREMENT MCore_rbd_SpnSen_s_undervoltage_spn "" UBYTE EQ_LSB_1 1 100 0 1 BYTE_ORDER MSB_LAST ECU_ADDRESS 0x528082DD /end MEASUREMENT
/begin MEASUREMENT MCore_rbd_SpnSen_s_vehicle_standstill "" UBYTE VOID_SCALING_a 1 100 0 1 BYTE_ORDER MSB_LAST ECU_ADDRESS 0x400D962C /end MEASUREMENT
/begin MEASUREMENT MCore_rbd_SpnSen_s_WakeupReason_SpnSen "" UBYTE VOID_SCALING 1 100 0 255 BYTE_ORDER MSB_LAST ECU_ADDRESS 0x400D9609 /end MEASUREMENT
/begin MEASUREMENT MCore_rbd_SpnSen_s_zat_betaetigt "" UBYTE VOID_SCALING_a 1 100 0 1 BYTE_ORDER MSB_LAST ECU_ADDRESS 0x528082DE /end MEASUREMENT
/begin MEASUREMENT MCore_rbd_SpnSen_s_zat_betaetigt_INIT "" UBYTE VOID_SCALING_a 1 100 0 1 BYTE_ORDER MSB_LAST ECU_ADDRESS 0x400D9610 /end MEASUREMENT
/begin MEASUREMENT MCore_rbd_SpnSen_so_Klemmen_Steuerung_01_KST_Anf_Klemme_15_can1 "" UBYTE VOID_SCALING_a 1 100 0 1 BYTE_ORDER MSB_LAST ECU_ADDRESS 0x400D962D /end MEASUREMENT
/begin MEASUREMENT MCore_rbd_SpnSen_so_Klemmen_Steuerung_01_KST_Anf_Klemme_S_can1 "" UBYTE VOID_SCALING_a 1 100 0 1 BYTE_ORDER MSB_LAST ECU_ADDRESS 0x400D962E /end MEASUREMENT
/begin MEASUREMENT MCore_rbd_SpnSen_so_Klemmen_Steuerung_01_KST_Anf_Klemmenfreigabe_ELV_can1 "" UBYTE VOID_SCALING_a 1 100 0 1 BYTE_ORDER MSB_LAST ECU_ADDRESS 0x400D962F /end MEASUREMENT
/begin MEASUREMENT MCore_rbd_SpnSen_so_Klemmen_Steuerung_01_KST_Anf_Klemmenfreigabe_WFS_can1 "" UBYTE VOID_SCALING_a 1 100 0 1 BYTE_ORDER MSB_LAST ECU_ADDRESS 0x400D9630 /end MEASUREMENT
/begin MEASUREMENT MCore_rbd_SpnSen_so_Klemmen_Steuerung_01_KST_Txt_Panikabschaltung_can1 "" UBYTE VOID_SCALING_a 1 100 0 1 BYTE_ORDER MSB_LAST ECU_ADDRESS 0x400D9631 /end MEASUREMENT
/begin MEASUREMENT MCore_rbd_SpnSen_so_Klemmen_Steuerung_01_KST_Txt_Werkstatt_can1 "" UBYTE VOID_SCALING_a 1 100 0 1 BYTE_ORDER MSB_LAST ECU_ADDRESS 0x400D9632 /end MEASUREMENT
/begin MEASUREMENT MCore_rbd_SpnSen_so_Klemmen_Steuerung_01_KST_ZAT_betaetigt_can1 "" UBYTE VOID_SCALING_a 1 100 0 1 BYTE_ORDER MSB_LAST ECU_ADDRESS 0x400D9633 /end MEASUREMENT
/begin MEASUREMENT MCore_rbd_SpnSen_ZatBetaetigt_NIR_valid "" UBYTE VOID_SCALING_a 1 100 0 1 BYTE_ORDER MSB_LAST ECU_ADDRESS 0x400D95E9 /end MEASUREMENT
/begin MEASUREMENT MCore_rbd_TcAct_DTC_ERR_KL15SIG_SCG_PreFailed "" UBYTE VOID_SCALING_a 1 100 0 255 BYTE_ORDER MSB_LAST ECU_ADDRESS 0x400D9700 /end MEASUREMENT
/begin MEASUREMENT MCore_rbd_TcAct_DTC_ERR_KL15SIG_SCUB_OL_PreFailed "" UBYTE VOID_SCALING_a 1 100 0 255 BYTE_ORDER MSB_LAST ECU_ADDRESS 0x400D9701 /end MEASUREMENT
/begin MEASUREMENT MCore_rbd_TcAct_DTC_Terminal_50_SCG_PreFailed "" UBYTE VOID_SCALING_a 1 100 0 255 BYTE_ORDER MSB_LAST ECU_ADDRESS 0x400D9702 /end MEASUREMENT
/begin MEASUREMENT MCore_rbd_TcAct_DTC_Terminal_50_SCUB_PreFailed "" UBYTE VOID_SCALING_a 1 100 0 255 BYTE_ORDER MSB_LAST ECU_ADDRESS 0x400D9703 /end MEASUREMENT
/begin MEASUREMENT MCore_rbd_TcAct_Klemme_15 "" UBYTE VOID_SCALING 1 100 0 1 BYTE_ORDER MSB_LAST ECU_ADDRESS 0x400D96EE /end MEASUREMENT
/begin MEASUREMENT MCore_rbd_TcAct_Klemme_15_INIT "" UBYTE VOID_SCALING 1 100 0 1 BYTE_ORDER MSB_LAST ECU_ADDRESS 0x400D96EF /end MEASUREMENT
/begin MEASUREMENT MCore_rbd_TcAct_Klemme_X "" UBYTE VOID_SCALING 1 100 0 1 BYTE_ORDER MSB_LAST ECU_ADDRESS 0x400D96F0 /end MEASUREMENT
/begin MEASUREMENT MCore_rbd_TcAct_KST_Anf_Klemme_50 "" UBYTE VOID_SCALING 1 100 0 1 BYTE_ORDER MSB_LAST ECU_ADDRESS 0x400D96EC /end MEASUREMENT
/begin MEASUREMENT MCore_rbd_TcAct_KST_Anf_Klemme_50_INIT "" UBYTE VOID_SCALING 1 100 0 1 BYTE_ORDER MSB_LAST ECU_ADDRESS 0x400D96ED /end MEASUREMENT
/begin MEASUREMENT MCore_rbd_TcAct_p_mwb_status_KL_15_can1 "" UBYTE VOID_SCALING_a 1 100 0 255 BYTE_ORDER MSB_LAST ECU_ADDRESS 0x400D96F6 /end MEASUREMENT
/begin MEASUREMENT MCore_rbd_TcAct_p_mwb_status_KL_15_rel "" UBYTE VOID_SCALING_a 1 100 0 255 BYTE_ORDER MSB_LAST ECU_ADDRESS 0x400D96F7 /end MEASUREMENT
/begin MEASUREMENT MCore_rbd_TcAct_p_mwb_status_KL_S_can1 "" UBYTE VOID_SCALING_a 1 100 0 255 BYTE_ORDER MSB_LAST ECU_ADDRESS 0x400D96F8 /end MEASUREMENT
/begin MEASUREMENT MCore_rbd_TcAct_p_mwb_status_KL_Startwunsch_can1 "" UBYTE VOID_SCALING_a 1 100 0 255 BYTE_ORDER MSB_LAST ECU_ADDRESS 0x400D96F9 /end MEASUREMENT
/begin MEASUREMENT MCore_rbd_TcAct_p_mwb_status_KL_Startwunsch_sig "" UBYTE VOID_SCALING_a 1 100 0 255 BYTE_ORDER MSB_LAST ECU_ADDRESS 0x400D96FA /end MEASUREMENT
/begin MEASUREMENT MCore_rbd_TcAct_s_KL_15_db "" UBYTE VOID_SCALING 1 100 0 1 BYTE_ORDER MSB_LAST ECU_ADDRESS 0x400D96FB /end MEASUREMENT
/begin MEASUREMENT MCore_rbd_TcAct_s_kl_Startwunsch_sig_mM "" UBYTE VOID_SCALING 1 100 0 1 BYTE_ORDER MSB_LAST ECU_ADDRESS 0x400D96FE /end MEASUREMENT
/begin MEASUREMENT MCore_rbd_TcAct_s_kl_Startwunsch_sig_mM_INIT "" UBYTE VOID_SCALING 1 100 0 1 BYTE_ORDER MSB_LAST ECU_ADDRESS 0x400D96FF /end MEASUREMENT
/begin MEASUREMENT MCore_rbd_TcAct_s_kl15_sig_mM "" UBYTE VOID_SCALING 1 100 0 1 BYTE_ORDER MSB_LAST ECU_ADDRESS 0x400D96FC /end MEASUREMENT
/begin MEASUREMENT MCore_rbd_TcAct_s_kl15_sig_mM_INIT "" UBYTE VOID_SCALING 1 100 0 1 BYTE_ORDER MSB_LAST ECU_ADDRESS 0x400D96FD /end MEASUREMENT
/begin MEASUREMENT MCore_rbd_TcAct_ZAS_Kl_15 "" UBYTE VOID_SCALING 1 100 0 1 BYTE_ORDER MSB_LAST ECU_ADDRESS 0x400D96F1 /end MEASUREMENT
/begin MEASUREMENT MCore_rbd_TcAct_ZAS_Kl_15_INIT "" UBYTE VOID_SCALING 1 100 0 1 BYTE_ORDER MSB_LAST ECU_ADDRESS 0x400D96F2 /end MEASUREMENT
/begin MEASUREMENT MCore_rbd_TcAct_ZAS_Kl_S "" UBYTE VOID_SCALING 1 100 0 1 BYTE_ORDER MSB_LAST ECU_ADDRESS 0x400D96F3 /end MEASUREMENT
/begin MEASUREMENT MCore_rbd_TcAct_ZAS_Kl_S_INIT "" UBYTE VOID_SCALING 1 100 0 1 BYTE_ORDER MSB_LAST ECU_ADDRESS 0x400D96F4 /end MEASUREMENT
/begin MEASUREMENT MCore_rbd_TcAct_ZAS_Kl_X "" UBYTE VOID_SCALING 1 100 0 1 BYTE_ORDER MSB_LAST ECU_ADDRESS 0x400D96F5 /end MEASUREMENT
/begin MEASUREMENT MCore_rbd_TcSen_numKlemme151Zas_NIR "" UBYTE VOID_SCALING_a 1 100 0 255 BYTE_ORDER MSB_LAST ECU_ADDRESS 0x400D9731 /end MEASUREMENT
/begin MEASUREMENT MCore_rbd_TcSen_numKlemme151Zas_NIR_valid "" UBYTE VOID_SCALING 1 100 0 1 BYTE_ORDER MSB_LAST ECU_ADDRESS 0x400D9732 /end MEASUREMENT
/begin MEASUREMENT MCore_rbd_TcSen_numKlemme151ZasInv_NIR "" UBYTE VOID_SCALING_a 1 100 0 255 BYTE_ORDER MSB_LAST ECU_ADDRESS 0x400D9730 /end MEASUREMENT
/begin MEASUREMENT MCore_rbd_TcSen_numKlemme152Zas_NIR "" UBYTE VOID_SCALING_a 1 100 0 255 BYTE_ORDER MSB_LAST ECU_ADDRESS 0x400D9734 /end MEASUREMENT
/begin MEASUREMENT MCore_rbd_TcSen_numKlemme152Zas_NIR_valid "" UBYTE VOID_SCALING 1 100 0 1 BYTE_ORDER MSB_LAST ECU_ADDRESS 0x400D9735 /end MEASUREMENT
/begin MEASUREMENT MCore_rbd_TcSen_numKlemme152ZasInv_NIR "" UBYTE VOID_SCALING_a 1 100 0 255 BYTE_ORDER MSB_LAST ECU_ADDRESS 0x400D9733 /end MEASUREMENT
/begin MEASUREMENT MCore_rbd_TcSen_numKlemmeStartwunschZas_NIR "" UBYTE VOID_SCALING_a 1 100 0 255 BYTE_ORDER MSB_LAST ECU_ADDRESS 0x400D973A /end MEASUREMENT
/begin MEASUREMENT MCore_rbd_TcSen_numKlemmeStartwunschZas_NIR_valid "" UBYTE VOID_SCALING 1 100 0 1 BYTE_ORDER MSB_LAST ECU_ADDRESS 0x400D973B /end MEASUREMENT
/begin MEASUREMENT MCore_rbd_TcSen_numKlemmeStartwunschZasInv_NIR "" UBYTE VOID_SCALING_a 1 100 0 255 BYTE_ORDER MSB_LAST ECU_ADDRESS 0x400D9739 /end MEASUREMENT
/begin MEASUREMENT MCore_rbd_TcSen_numKlemmeSZas_NIR "" UBYTE VOID_SCALING_a 1 100 0 255 BYTE_ORDER MSB_LAST ECU_ADDRESS 0x400D9737 /end MEASUREMENT
/begin MEASUREMENT MCore_rbd_TcSen_numKlemmeSZas_NIR_valid "" UBYTE VOID_SCALING 1 100 0 1 BYTE_ORDER MSB_LAST ECU_ADDRESS 0x400D9738 /end MEASUREMENT
/begin MEASUREMENT MCore_rbd_TcSen_numKlemmeSZasInv_NIR "" UBYTE VOID_SCALING_a 1 100 0 255 BYTE_ORDER MSB_LAST ECU_ADDRESS 0x400D9736 /end MEASUREMENT
/begin MEASUREMENT MCore_rbd_TcSen_p_dtc_set_s_ECU_Terminal_Signals_ZAS_defect "" UBYTE VOID_SCALING_a 1 100 0 255 BYTE_ORDER MSB_LAST ECU_ADDRESS 0x52808447 /end MEASUREMENT
/begin MEASUREMENT MCore_rbd_TcSen_p_dtc_set_s_ERR_KL_15_1_SCGND "" UBYTE VOID_SCALING_a 1 100 0 255 BYTE_ORDER MSB_LAST ECU_ADDRESS 0x52808448 /end MEASUREMENT
/begin MEASUREMENT MCore_rbd_TcSen_p_dtc_set_s_ERR_KL_15_1_SCUB_OL "" UBYTE VOID_SCALING_a 1 100 0 255 BYTE_ORDER MSB_LAST ECU_ADDRESS 0x52808449 /end MEASUREMENT
/begin MEASUREMENT MCore_rbd_TcSen_p_dtc_set_s_ERR_KL_15_2_SCGND "" UBYTE VOID_SCALING_a 1 100 0 255 BYTE_ORDER MSB_LAST ECU_ADDRESS 0x5280844A /end MEASUREMENT
/begin MEASUREMENT MCore_rbd_TcSen_p_dtc_set_s_ERR_KL_15_2_SCUB_OL "" UBYTE VOID_SCALING_a 1 100 0 255 BYTE_ORDER MSB_LAST ECU_ADDRESS 0x5280844B /end MEASUREMENT
/begin MEASUREMENT MCore_rbd_TcSen_p_dtc_set_s_ERR_KL_S_SCGND "" UBYTE VOID_SCALING_a 1 100 0 255 BYTE_ORDER MSB_LAST ECU_ADDRESS 0x5280844C /end MEASUREMENT
/begin MEASUREMENT MCore_rbd_TcSen_p_dtc_set_s_ERR_KL_S_SCUB_OL "" UBYTE VOID_SCALING_a 1 100 0 255 BYTE_ORDER MSB_LAST ECU_ADDRESS 0x5280844D /end MEASUREMENT
/begin MEASUREMENT MCore_rbd_TcSen_p_dtc_status_KLEMME_15_1_SCG_failed "" UBYTE VOID_SCALING 1 100 0 1 BYTE_ORDER MSB_LAST ECU_ADDRESS 0x400D9759 /end MEASUREMENT
/begin MEASUREMENT MCore_rbd_TcSen_p_dtc_status_KLEMME_15_1_SCUB_OL_failed "" UBYTE VOID_SCALING 1 100 0 1 BYTE_ORDER MSB_LAST ECU_ADDRESS 0x400D975A /end MEASUREMENT
/begin MEASUREMENT MCore_rbd_TcSen_p_dtc_status_KLEMME_15_2_SCG_failed "" UBYTE VOID_SCALING 1 100 0 1 BYTE_ORDER MSB_LAST ECU_ADDRESS 0x400D975B /end MEASUREMENT
/begin MEASUREMENT MCore_rbd_TcSen_p_dtc_status_KLEMME_15_2_SCUB_OL_failed "" UBYTE VOID_SCALING 1 100 0 1 BYTE_ORDER MSB_LAST ECU_ADDRESS 0x400D975C /end MEASUREMENT
/begin MEASUREMENT MCore_rbd_TcSen_p_dtc_status_KLEMME_S_SCG_failed "" UBYTE VOID_SCALING 1 100 0 1 BYTE_ORDER MSB_LAST ECU_ADDRESS 0x400D975D /end MEASUREMENT
/begin MEASUREMENT MCore_rbd_TcSen_p_dtc_status_KLEMME_S_SCUB_OL_failed "" UBYTE VOID_SCALING 1 100 0 1 BYTE_ORDER MSB_LAST ECU_ADDRESS 0x400D975E /end MEASUREMENT
/begin MEASUREMENT MCore_rbd_TcSen_p_dtc_status_s_ERR_KL_15_SIG_GND_failed "" UBYTE VOID_SCALING 1 100 0 1 BYTE_ORDER MSB_LAST ECU_ADDRESS 0x400D975F /end MEASUREMENT
/begin MEASUREMENT MCore_rbd_TcSen_p_dtc_status_s_ERR_KL_15_SIG_PLUS_failed "" UBYTE VOID_SCALING 1 100 0 1 BYTE_ORDER MSB_LAST ECU_ADDRESS 0x400D9760 /end MEASUREMENT
/begin MEASUREMENT MCore_rbd_TcSen_p_mwb_status_DTC_zas "" UBYTE VOID_SCALING_a 1 100 0 255 BYTE_ORDER MSB_LAST ECU_ADDRESS 0x5280844E /end MEASUREMENT
/begin MEASUREMENT MCore_rbd_TcSen_p_mwb_status_kl_startwunsch_zas "" UBYTE VOID_SCALING_a 1 100 0 255 BYTE_ORDER MSB_LAST ECU_ADDRESS 0x400D9763 /end MEASUREMENT
/begin MEASUREMENT MCore_rbd_TcSen_p_mwb_status_MO_kl_50_can "" UBYTE VOID_SCALING_a 1 100 0 255 BYTE_ORDER MSB_LAST ECU_ADDRESS 0x400D9761 /end MEASUREMENT
/begin MEASUREMENT MCore_rbd_TcSen_p_mwb_status_MO_kl_75_can "" UBYTE VOID_SCALING_a 1 100 0 255 BYTE_ORDER MSB_LAST ECU_ADDRESS 0x400D9762 /end MEASUREMENT
/begin MEASUREMENT MCore_rbd_TcSen_p_mwb_status_s_kl_15_zas1 "" UBYTE VOID_SCALING_a 1 100 0 255 BYTE_ORDER MSB_LAST ECU_ADDRESS 0x400D9764 /end MEASUREMENT
/begin MEASUREMENT MCore_rbd_TcSen_p_mwb_status_s_kl_15_zas2 "" UBYTE VOID_SCALING_a 1 100 0 255 BYTE_ORDER MSB_LAST ECU_ADDRESS 0x400D9765 /end MEASUREMENT
/begin MEASUREMENT MCore_rbd_TcSen_p_mwb_status_s_kl_15_zat1 "" UBYTE VOID_SCALING_a 1 100 0 255 BYTE_ORDER MSB_LAST ECU_ADDRESS 0x400D9766 /end MEASUREMENT
/begin MEASUREMENT MCore_rbd_TcSen_p_mwb_status_s_kl_15_zat2 "" UBYTE VOID_SCALING_a 1 100 0 255 BYTE_ORDER MSB_LAST ECU_ADDRESS 0x400D9767 /end MEASUREMENT
/begin MEASUREMENT MCore_rbd_TcSen_p_mwb_status_s_kl_s_zas "" UBYTE VOID_SCALING_a 1 100 0 255 BYTE_ORDER MSB_LAST ECU_ADDRESS 0x400D9768 /end MEASUREMENT
/begin MEASUREMENT MCore_rbd_TcSen_s_ERR_KL_15_1 "" UBYTE VOID_SCALING 1 100 0 1 BYTE_ORDER MSB_LAST ECU_ADDRESS 0x400D973C /end MEASUREMENT
/begin MEASUREMENT MCore_rbd_TcSen_s_ERR_KL_15_1_NOT_PLAUS "" UBYTE VOID_SCALING 1 100 0 1 BYTE_ORDER MSB_LAST ECU_ADDRESS 0x400D973D /end MEASUREMENT
/begin MEASUREMENT MCore_rbd_TcSen_s_ERR_KL_15_1_SCGND "" UBYTE VOID_SCALING 1 100 0 1 BYTE_ORDER MSB_LAST ECU_ADDRESS 0x400D973E /end MEASUREMENT
/begin MEASUREMENT MCore_rbd_TcSen_s_ERR_KL_15_1_SCUB_OL "" UBYTE VOID_SCALING 1 100 0 1 BYTE_ORDER MSB_LAST ECU_ADDRESS 0x400D973F /end MEASUREMENT
/begin MEASUREMENT MCore_rbd_TcSen_s_ERR_KL_15_2 "" UBYTE VOID_SCALING 1 100 0 1 BYTE_ORDER MSB_LAST ECU_ADDRESS 0x400D9740 /end MEASUREMENT
/begin MEASUREMENT MCore_rbd_TcSen_s_ERR_KL_15_2_NOT_PLAUS "" UBYTE VOID_SCALING 1 100 0 1 BYTE_ORDER MSB_LAST ECU_ADDRESS 0x400D9741 /end MEASUREMENT
/begin MEASUREMENT MCore_rbd_TcSen_s_ERR_KL_15_2_SCGND "" UBYTE VOID_SCALING 1 100 0 1 BYTE_ORDER MSB_LAST ECU_ADDRESS 0x400D9742 /end MEASUREMENT
/begin MEASUREMENT MCore_rbd_TcSen_s_ERR_KL_15_2_SCUB_OL "" UBYTE VOID_SCALING 1 100 0 1 BYTE_ORDER MSB_LAST ECU_ADDRESS 0x400D9743 /end MEASUREMENT
/begin MEASUREMENT MCore_rbd_TcSen_s_ERR_KL_S "" UBYTE VOID_SCALING 1 100 0 1 BYTE_ORDER MSB_LAST ECU_ADDRESS 0x400D9744 /end MEASUREMENT
/begin MEASUREMENT MCore_rbd_TcSen_s_ERR_KL_S_NOT_PLAUS "" UBYTE VOID_SCALING 1 100 0 1 BYTE_ORDER MSB_LAST ECU_ADDRESS 0x400D9745 /end MEASUREMENT
/begin MEASUREMENT MCore_rbd_TcSen_s_ERR_KL_S_SCGND "" UBYTE VOID_SCALING 1 100 0 1 BYTE_ORDER MSB_LAST ECU_ADDRESS 0x400D9746 /end MEASUREMENT
/begin MEASUREMENT MCore_rbd_TcSen_s_ERR_KL_S_SCUB_OL "" UBYTE VOID_SCALING 1 100 0 1 BYTE_ORDER MSB_LAST ECU_ADDRESS 0x400D9747 /end MEASUREMENT
/begin MEASUREMENT MCore_rbd_TcSen_s_hidden_fault_kl_s_zas "" UBYTE VOID_SCALING 1 100 0 1 BYTE_ORDER MSB_LAST ECU_ADDRESS 0x400D976B /end MEASUREMENT
/begin MEASUREMENT MCore_rbd_TcSen_s_hidden_fault_kl15_zas1 "" UBYTE VOID_SCALING 1 100 0 1 BYTE_ORDER MSB_LAST ECU_ADDRESS 0x400D9769 /end MEASUREMENT
/begin MEASUREMENT MCore_rbd_TcSen_s_hidden_fault_kl15_zas2 "" UBYTE VOID_SCALING 1 100 0 1 BYTE_ORDER MSB_LAST ECU_ADDRESS 0x400D976A /end MEASUREMENT
/begin MEASUREMENT MCore_rbd_TcSen_s_HybFahrbereitschaftCan "" UBYTE VOID_SCALING 1 100 0 1 BYTE_ORDER MSB_LAST ECU_ADDRESS 0x5280844F /end MEASUREMENT
/begin MEASUREMENT MCore_rbd_TcSen_s_KL_15_zas_intern "" UBYTE VOID_SCALING 1 100 0 1 BYTE_ORDER MSB_LAST ECU_ADDRESS 0x400D9748 /end MEASUREMENT
/begin MEASUREMENT MCore_rbd_TcSen_s_kl_s_zas_INIT "" UBYTE VOID_SCALING 1 100 0 1 BYTE_ORDER MSB_LAST ECU_ADDRESS 0x400D974F /end MEASUREMENT
/begin MEASUREMENT MCore_rbd_TcSen_s_KL_S_zas_intern "" UBYTE VOID_SCALING 1 100 0 1 BYTE_ORDER MSB_LAST ECU_ADDRESS 0x400D9749 /end MEASUREMENT
/begin MEASUREMENT MCore_rbd_TcSen_s_kl_s_zas_mM_db "" UBYTE VOID_SCALING 1 100 0 1 BYTE_ORDER MSB_LAST ECU_ADDRESS 0x400D9771 /end MEASUREMENT
/begin MEASUREMENT MCore_rbd_TcSen_s_kl_s_zas_SPI_eM_db "" UBYTE VOID_SCALING 1 100 0 1 BYTE_ORDER MSB_LAST ECU_ADDRESS 0x400D9770 /end MEASUREMENT
/begin MEASUREMENT MCore_rbd_TcSen_s_kl_startwunsch_zas_INIT "" UBYTE VOID_SCALING 1 100 0 1 BYTE_ORDER MSB_LAST ECU_ADDRESS 0x400D9750 /end MEASUREMENT
/begin MEASUREMENT MCore_rbd_TcSen_s_KL_Startwunsch_zas_intern "" UBYTE VOID_SCALING 1 100 0 1 BYTE_ORDER MSB_LAST ECU_ADDRESS 0x400D974A /end MEASUREMENT
/begin MEASUREMENT MCore_rbd_TcSen_s_kl_startwunsch_zas_mM_db "" UBYTE VOID_SCALING 1 100 0 1 BYTE_ORDER MSB_LAST ECU_ADDRESS 0x400D9772 /end MEASUREMENT
/begin MEASUREMENT MCore_rbd_TcSen_s_kl15_zas1_INIT "" UBYTE VOID_SCALING 1 100 0 1 BYTE_ORDER MSB_LAST ECU_ADDRESS 0x400D974D /end MEASUREMENT
/begin MEASUREMENT MCore_rbd_TcSen_s_kl15_zas1_mM_db "" UBYTE VOID_SCALING 1 100 0 1 BYTE_ORDER MSB_LAST ECU_ADDRESS 0x400D976D /end MEASUREMENT
/begin MEASUREMENT MCore_rbd_TcSen_s_kl15_zas1_SPI_eM_db "" UBYTE VOID_SCALING 1 100 0 1 BYTE_ORDER MSB_LAST ECU_ADDRESS 0x400D976C /end MEASUREMENT
/begin MEASUREMENT MCore_rbd_TcSen_s_kl15_zas2_INIT "" UBYTE VOID_SCALING 1 100 0 1 BYTE_ORDER MSB_LAST ECU_ADDRESS 0x400D974E /end MEASUREMENT
/begin MEASUREMENT MCore_rbd_TcSen_s_kl15_zas2_mM_db "" UBYTE VOID_SCALING 1 100 0 1 BYTE_ORDER MSB_LAST ECU_ADDRESS 0x400D976F /end MEASUREMENT
/begin MEASUREMENT MCore_rbd_TcSen_s_kl15_zas2_SPI_eM_db "" UBYTE VOID_SCALING 1 100 0 1 BYTE_ORDER MSB_LAST ECU_ADDRESS 0x400D976E /end MEASUREMENT
/begin MEASUREMENT MCore_rbd_TcSen_s_Klemme50Can "" UBYTE VOID_SCALING 1 100 0 1 BYTE_ORDER MSB_LAST ECU_ADDRESS 0x52808450 /end MEASUREMENT
/begin MEASUREMENT MCore_rbd_TcSen_s_NoIniRamValid_INIT "" UBYTE VOID_SCALING 1 100 0 1 BYTE_ORDER MSB_LAST ECU_ADDRESS 0x400D974B /end MEASUREMENT
/begin MEASUREMENT MCore_rbd_TcSen_s_t_Diagnoseverbot_nach_Start "" UBYTE VOID_SCALING 1 100 0 1 BYTE_ORDER MSB_LAST ECU_ADDRESS 0x52808451 /end MEASUREMENT
/begin MEASUREMENT MCore_rbd_TcSen_s_WfsKeyNr "" UBYTE VOID_SCALING_a 1 100 0 255 BYTE_ORDER MSB_LAST ECU_ADDRESS 0x400D974C /end MEASUREMENT
/begin MEASUREMENT MCore_StateOfAlarmSystem "" UBYTE DataType_DataTypeSemantics_CM_StateOfAlarmSystem 1 100 0.0 255.0 MAX_REFRESH 4 1 ECU_ADDRESS 0x52808C5E /end MEASUREMENT
/begin MEASUREMENT MCore_Rte_CPim_VF087_PIM_NV_AlarmMemory "" UBYTE DefaultIdenticalCompu 1 100 0.0 255.0 ARRAY_SIZE 25 ECU_ADDRESS 0x400E3114 /end MEASUREMENT
/begin MEASUREMENT MCore_Rte_CPim_VF087_PIM_NV_AlarmState "" UBYTE Methods_boolean 1 100 0.0 1.0 ARRAY_SIZE 17 ECU_ADDRESS 0x400E2EA4 /end MEASUREMENT
/begin MEASUREMENT MCore_Par_AutoRestoringWarningForGuarded_VF087 "" UBYTE Methods_boolean 1 100 0.0 255.0 MAX_REFRESH 4 1 ECU_ADDRESS 0x52808C50 /end MEASUREMENT
/begin MEASUREMENT MCore_Par_PassiveSelfArmingEnabling_VF087 "" UBYTE Methods_boolean 1 100 0.0 255.0 MAX_REFRESH 4 1 ECU_ADDRESS 0x52808C57 /end MEASUREMENT
/begin MEASUREMENT MCore_Par_SelfArmingUponLastDoor_VF087 "" UBYTE Methods_boolean 1 100 0.0 255.0 MAX_REFRESH 4 1 ECU_ADDRESS 0x52808C5B /end MEASUREMENT
/begin MEASUREMENT MCore_Par_SelfArmingTimeOut_VF087 "" UBYTE Methods_boolean 1 100 0.0 255.0 MAX_REFRESH 4 1 ECU_ADDRESS 0x52808C5A /end MEASUREMENT
/begin MEASUREMENT MCore_Par_SelfArmingAntiTiltSurveilliance_VF087 "" UBYTE Methods_boolean 1 100 0.0 255.0 MAX_REFRESH 4 1 ECU_ADDRESS 0x52808C59 /end MEASUREMENT
/begin MEASUREMENT MCore_Par_SelfArmingVolumetricSurveillance_VF087 "" UBYTE Methods_boolean 1 100 0.0 255.0 MAX_REFRESH 4 1 ECU_ADDRESS 0x52808C5C /end MEASUREMENT
/begin MEASUREMENT MCore_Par_ArmingDisarmingBlinkerGeneration_VF087 "" UBYTE Methods_boolean 1 100 0.0 255.0 MAX_REFRESH 4 1 ECU_ADDRESS 0x52808C4F /end MEASUREMENT
/begin MEASUREMENT MCore_Par_ArmingDisarmingBeepGeneration_VF087 "" UBYTE Methods_boolean 1 100 0.0 255.0 MAX_REFRESH 4 1 ECU_ADDRESS 0x52808C4E /end MEASUREMENT
/begin MEASUREMENT MCore_Par_BlinkerDuringSelfArming_VF087 "" UBYTE Methods_boolean 1 100 0.0 255.0 MAX_REFRESH 4 1 ECU_ADDRESS 0x52808C51 /end MEASUREMENT
/begin MEASUREMENT MCore_Par_NumberOfCyclesDoors_VF087 "" UBYTE Methods_boolean 1 100 0.0 255.0 MAX_REFRESH 4 1 ECU_ADDRESS 0x52808C54 /end MEASUREMENT
/begin MEASUREMENT MCore_Par_NumberOfCyclesVolAntiTiltSens_VF087 "" UBYTE Methods_boolean 1 100 0.0 255.0 MAX_REFRESH 4 1 ECU_ADDRESS 0x52808C55 /end MEASUREMENT
/begin MEASUREMENT MCore_Par_NumberOfCyclesWireCut_VF087 "" UBYTE Methods_boolean 1 100 0.0 255.0 MAX_REFRESH 4 1 ECU_ADDRESS 0x52808C56 /end MEASUREMENT
/begin MEASUREMENT MCore_Par_NumberOfBlinkAdditionalCycles_VF087 "" UBYTE Methods_boolean 1 100 0.0 255.0 MAX_REFRESH 4 1 ECU_ADDRESS 0x52808C53 /end MEASUREMENT
/begin MEASUREMENT MCore_Par_DurationTimeOfCycleActivation_VF087 "" UBYTE Methods_boolean 1 100 0.0 255.0 MAX_REFRESH 4 1 ECU_ADDRESS 0x52808C52 /end MEASUREMENT
/begin MEASUREMENT MCore_Par_PauseBetweenAlarmCycles_VF087 "" UBYTE Methods_boolean 1 100 0.0 255.0 MAX_REFRESH 4 1 ECU_ADDRESS 0x52808C58 /end MEASUREMENT
/begin MEASUREMENT MCore_Par_TotNumberOfAlarmCycles_VF087 "" UBYTE Methods_boolean 1 100 0.0 255.0 MAX_REFRESH 4 1 ECU_ADDRESS 0x52808C5D /end MEASUREMENT
/begin MEASUREMENT MCore_SelfArmingRunningSt_VF087 "" UBYTE Methods_boolean 1 100 0.0 255.0 MAX_REFRESH 4 1 ECU_ADDRESS 0x52808B86 /end MEASUREMENT
/begin MEASUREMENT MCore_BcmSts_VF087 "" UBYTE DataType_DataTypeSemantics_DT_VERS_BcmSts 1 100 0.0 255.0 MAX_REFRESH 4 1 ECU_ADDRESS 0x400D9958 /end MEASUREMENT
/begin MEASUREMENT MCore_VF087TransponderAuthentReq "" UBYTE DataType_DataTypeSemantics_DT_VF087_TransponderAuthenticationReq 1 100 0.0 255.0 MAX_REFRESH 4 1 ECU_ADDRESS 0x52808C5F /end MEASUREMENT
/begin MEASUREMENT MCore_LIN_SlotSchedule_VF087 "" UWORD NO_COMPU_METHOD 0 0 0 65535 MAX_REFRESH 4 1 ECU_ADDRESS 0x52808C4D /end MEASUREMENT
/begin MEASUREMENT MCore_ModeM_EcuM_LcyAdapter_ActivePostRunReqUsers_Bitfield "" A_UINT64 NO_COMPU_METHOD 0 0 0 1.84467440737e+019 ECU_ADDRESS 0x400D32E0 /end MEASUREMENT
/begin MEASUREMENT MCore_ModeM_EcuM_LcyAdapter_ActiveRunReqUsers_Bitfield "" A_UINT64 NO_COMPU_METHOD 0 0 0 1.84467440737e+019 ECU_ADDRESS 0x400D32D8 /end MEASUREMENT
/begin MEASUREMENT MCore_ModeM_ComMRequestHndlr_ActiveCommUsers_BH_Bitfield "" A_UINT64 NO_COMPU_METHOD 0 0 0 1.84467440737e+019 ECU_ADDRESS 0x400D31E8 /end MEASUREMENT
/begin MEASUREMENT MCore_NmApp_keyOnStatemachineState "" UBYTE NO_COMPU_METHOD 0 0 0 255 ECU_ADDRESS 0x5280CE89 /end MEASUREMENT
/begin MEASUREMENT MCore_NmApp_keyOffStatemachineState "" UBYTE NO_COMPU_METHOD 0 0 0 255 ECU_ADDRESS 0x5280CE88 /end MEASUREMENT
/begin MEASUREMENT MCore_Dem_AllEventsState "" UBYTE NO_COMPU_METHOD 0 0 0 255 ECU_ADDRESS 0x400AC76C /end MEASUREMENT
/begin MEASUREMENT MCore_Dem_AllEventsState[9].state "" UBYTE NO_COMPU_METHOD 0 0 0 255 ECU_ADDRESS 0x400AC790 /end MEASUREMENT
/begin MEASUREMENT MCore_rb_RxE2E_GeneralConfig "" UBYTE NO_COMPU_METHOD 0 0 0 255 ECU_ADDRESS 0x1213794 /end MEASUREMENT
/begin MEASUREMENT MCore_rb_RxE2E_GeneralConfig[0].threshold_f "" UBYTE NO_COMPU_METHOD 0 0 0 255 ECU_ADDRESS 0x12137AD /end MEASUREMENT
/begin MEASUREMENT MCore_rb_RxE2E_GeneralConfig[1].threshold_f "" UBYTE NO_COMPU_METHOD 0 0 0 255 ECU_ADDRESS 0x12137E1 /end MEASUREMENT
/begin MEASUREMENT MCore_rb_RxE2E_GeneralConfig[2].threshold_f "" UBYTE NO_COMPU_METHOD 0 0 0 255 ECU_ADDRESS 0x1213815 /end MEASUREMENT
/begin MEASUREMENT MCore_rb_RxE2E_GeneralConfig[3].threshold_f "" UBYTE NO_COMPU_METHOD 0 0 0 255 ECU_ADDRESS 0x1213849 /end MEASUREMENT
/begin MEASUREMENT MCore_rb_RxE2E_GeneralConfig[4].threshold_f "" UBYTE NO_COMPU_METHOD 0 0 0 255 ECU_ADDRESS 0x121387D /end MEASUREMENT
/begin MEASUREMENT MCore_rb_RxE2E_GeneralConfig[5].threshold_f "" UBYTE NO_COMPU_METHOD 0 0 0 255 ECU_ADDRESS 0x12138B1 /end MEASUREMENT
/begin MEASUREMENT MCore_rb_RxE2E_GeneralConfig[6].threshold_f "" UBYTE NO_COMPU_METHOD 0 0 0 255 ECU_ADDRESS 0x12138E5 /end MEASUREMENT
/begin MEASUREMENT MCore_rb_RxE2E_GeneralCtrlSPDU "" UBYTE NO_COMPU_METHOD 0 0 0 255 ECU_ADDRESS 0x400D37DC /end MEASUREMENT
/begin MEASUREMENT MCore_rb_RxE2E_GeneralCtrlSPDU[0].me "" ULONG NO_COMPU_METHOD 0 0 0 4294967295 ECU_ADDRESS 0x400D381C /end MEASUREMENT
/begin MEASUREMENT MCore_rb_RxE2E_GeneralCtrlSPDU[0].state "" SBYTE rb_RxE2E_State_enumTag 0 0 -128 127 ECU_ADDRESS 0x400D380E /end MEASUREMENT
/begin MEASUREMENT MCore_rb_RxE2E_GeneralCtrlSPDU[0].te "" ULONG NO_COMPU_METHOD 0 0 0 4294967295 ECU_ADDRESS 0x400D3820 /end MEASUREMENT
/begin MEASUREMENT MCore_rb_RxE2E_GeneralCtrlSPDU[1].me "" ULONG NO_COMPU_METHOD 0 0 0 4294967295 ECU_ADDRESS 0x400D386C /end MEASUREMENT
/begin MEASUREMENT MCore_rb_RxE2E_GeneralCtrlSPDU[1].state "" SBYTE rb_RxE2E_State_enumTag 0 0 -128 127 ECU_ADDRESS 0x400D385E /end MEASUREMENT
/begin MEASUREMENT MCore_rb_RxE2E_GeneralCtrlSPDU[1].te "" ULONG NO_COMPU_METHOD 0 0 0 4294967295 ECU_ADDRESS 0x400D3870 /end MEASUREMENT
/begin MEASUREMENT MCore_rb_RxE2E_GeneralCtrlSPDU[2].me "" ULONG NO_COMPU_METHOD 0 0 0 4294967295 ECU_ADDRESS 0x400D38BC /end MEASUREMENT
/begin MEASUREMENT MCore_rb_RxE2E_GeneralCtrlSPDU[2].state "" SBYTE rb_RxE2E_State_enumTag 0 0 -128 127 ECU_ADDRESS 0x400D38AE /end MEASUREMENT
/begin MEASUREMENT MCore_rb_RxE2E_GeneralCtrlSPDU[2].te "" ULONG NO_COMPU_METHOD 0 0 0 4294967295 ECU_ADDRESS 0x400D38C0 /end MEASUREMENT
/begin MEASUREMENT MCore_rb_RxE2E_GeneralCtrlSPDU[3].me "" ULONG NO_COMPU_METHOD 0 0 0 4294967295 ECU_ADDRESS 0x400D390C /end MEASUREMENT
/begin MEASUREMENT MCore_rb_RxE2E_GeneralCtrlSPDU[3].state "" SBYTE rb_RxE2E_State_enumTag 0 0 -128 127 ECU_ADDRESS 0x400D38FE /end MEASUREMENT
/begin MEASUREMENT MCore_rb_RxE2E_GeneralCtrlSPDU[3].te "" ULONG NO_COMPU_METHOD 0 0 0 4294967295 ECU_ADDRESS 0x400D3910 /end MEASUREMENT
/begin MEASUREMENT MCore_rb_RxE2E_GeneralCtrlSPDU[4].me "" ULONG NO_COMPU_METHOD 0 0 0 4294967295 ECU_ADDRESS 0x400D395C /end MEASUREMENT
/begin MEASUREMENT MCore_rb_RxE2E_GeneralCtrlSPDU[4].state "" SBYTE rb_RxE2E_State_enumTag 0 0 -128 127 ECU_ADDRESS 0x400D394E /end MEASUREMENT
/begin MEASUREMENT MCore_rb_RxE2E_GeneralCtrlSPDU[4].te "" ULONG NO_COMPU_METHOD 0 0 0 4294967295 ECU_ADDRESS 0x400D3960 /end MEASUREMENT
/begin MEASUREMENT MCore_rb_RxE2E_GeneralCtrlSPDU[5].me "" ULONG NO_COMPU_METHOD 0 0 0 4294967295 ECU_ADDRESS 0x400D39AC /end MEASUREMENT
/begin MEASUREMENT MCore_rb_RxE2E_GeneralCtrlSPDU[5].state "" SBYTE rb_RxE2E_State_enumTag 0 0 -128 127 ECU_ADDRESS 0x400D399E /end MEASUREMENT
/begin MEASUREMENT MCore_rb_RxE2E_GeneralCtrlSPDU[5].te "" ULONG NO_COMPU_METHOD 0 0 0 4294967295 ECU_ADDRESS 0x400D39B0 /end MEASUREMENT
/begin MEASUREMENT MCore_rb_RxE2E_GeneralCtrlSPDU[6].me "" ULONG NO_COMPU_METHOD 0 0 0 4294967295 ECU_ADDRESS 0x400D39FC /end MEASUREMENT
/begin MEASUREMENT MCore_rb_RxE2E_GeneralCtrlSPDU[6].state "" SBYTE rb_RxE2E_State_enumTag 0 0 -128 127 ECU_ADDRESS 0x400D39EE /end MEASUREMENT
/begin MEASUREMENT MCore_rb_RxE2E_GeneralCtrlSPDU[6].te "" ULONG NO_COMPU_METHOD 0 0 0 4294967295 ECU_ADDRESS 0x400D3A00 /end MEASUREMENT
/begin MEASUREMENT MCore_rb_RxE2E_GeneralCtrlSPDU[7].me "" ULONG NO_COMPU_METHOD 0 0 0 4294967295 ECU_ADDRESS 0x400D3A4C /end MEASUREMENT
/begin MEASUREMENT MCore_rb_RxE2E_GeneralCtrlSPDU[7].state "" SBYTE rb_RxE2E_State_enumTag 0 0 -128 127 ECU_ADDRESS 0x400D3A3E /end MEASUREMENT
/begin MEASUREMENT MCore_rb_RxE2E_GeneralCtrlSPDU[7].te "" ULONG NO_COMPU_METHOD 0 0 0 4294967295 ECU_ADDRESS 0x400D3A50 /end MEASUREMENT
/begin MEASUREMENT MCore_rb_RxE2E_GeneralCtrlSPDU[8].me "" ULONG NO_COMPU_METHOD 0 0 0 4294967295 ECU_ADDRESS 0x400D3A9C /end MEASUREMENT
/begin MEASUREMENT MCore_rb_RxE2E_GeneralCtrlSPDU[8].state "" SBYTE rb_RxE2E_State_enumTag 0 0 -128 127 ECU_ADDRESS 0x400D3A8E /end MEASUREMENT
/begin MEASUREMENT MCore_rb_RxE2E_GeneralCtrlSPDU[8].te "" ULONG NO_COMPU_METHOD 0 0 0 4294967295 ECU_ADDRESS 0x400D3AA0 /end MEASUREMENT
/begin MEASUREMENT MCore_rb_RxE2E_GeneralCtrlSPDU[9].me "" ULONG NO_COMPU_METHOD 0 0 0 4294967295 ECU_ADDRESS 0x400D3AEC /end MEASUREMENT
/begin MEASUREMENT MCore_rb_RxE2E_GeneralCtrlSPDU[9].state "" SBYTE rb_RxE2E_State_enumTag 0 0 -128 127 ECU_ADDRESS 0x400D3ADE /end MEASUREMENT
/begin MEASUREMENT MCore_rb_RxE2E_GeneralCtrlSPDU[9].te "" ULONG NO_COMPU_METHOD 0 0 0 4294967295 ECU_ADDRESS 0x400D3AF0 /end MEASUREMENT
/begin MEASUREMENT MCore_rb_Sbc_Uja113x_Config_u8 "" UBYTE NO_COMPU_METHOD 0 0 0 255 ECU_ADDRESS 0x5280B9EF /end MEASUREMENT
/begin MEASUREMENT MCore_rb_Sbc_Uja113x_OUT_Cmd "" UBYTE NO_COMPU_METHOD 0 0 0 255 ECU_ADDRESS 0x5280B9F0 /end MEASUREMENT
/begin MEASUREMENT MCore_rb_os_IdleTime_LastMeasuredIdleTime "" ULONG NO_COMPU_METHOD 0 0 0 4294967295 ECU_ADDRESS 0x5280CA4C /end MEASUREMENT
/begin MEASUREMENT MCore_rb_os_IdleTime_WorstMeasuredIdleTime "" ULONG NO_COMPU_METHOD 0 0 0 4294967295 ECU_ADDRESS 0x400A8110 /end MEASUREMENT
/begin MEASUREMENT MCore_rb_Pwmx_EsaSpiStuckCounter "" ULONG NO_COMPU_METHOD 0 0 0 4294967295 ECU_ADDRESS 0x5280B948 /end MEASUREMENT
/begin MEASUREMENT MCore_rb_Pwmx_EsaCyclicOverrunCounter "" ULONG NO_COMPU_METHOD 0 0 0 4294967295 ECU_ADDRESS 0x5280B94C /end MEASUREMENT
/begin MEASUREMENT MCore_rb_Pwmx_EsaDmaStuckCounter "" ULONG NO_COMPU_METHOD 0 0 0 4294967295 ECU_ADDRESS 0x5280B950 /end MEASUREMENT
/begin MEASUREMENT MCore_rba_Runtime_IntCorrHelper_ast "" UBYTE NO_COMPU_METHOD 0 0 0 255 ECU_ADDRESS 0x400E1AB0 /end MEASUREMENT
/begin MEASUREMENT MCore_rba_Runtime_IntCorrHelper_ast[0].nothing_u32 "" ULONG NO_COMPU_METHOD 0 0 0 4294967295 ECU_ADDRESS 0x400E1AB0 /end MEASUREMENT
/begin MEASUREMENT MCore_rba_Runtime_IntCorrHelper_ast[0].postStartTimeStamp_u32 "" ULONG NO_COMPU_METHOD 0 0 0 4294967295 ECU_ADDRESS 0x400E1AB8 /end MEASUREMENT
/begin MEASUREMENT MCore_rba_Runtime_IntCorrHelper_ast[0].preEndTimeStamp_u32 "" ULONG NO_COMPU_METHOD 0 0 0 4294967295 ECU_ADDRESS 0x400E1AB4 /end MEASUREMENT
/begin MEASUREMENT MCore_rba_Runtime_IntCorrHelper_cast "" UBYTE NO_COMPU_METHOD 0 0 0 255 ECU_ADDRESS 0x1222FA4 /end MEASUREMENT
/begin MEASUREMENT MCore_rba_Runtime_IntCorrHelper_cast[0].nothing_u32 "" ULONG NO_COMPU_METHOD 0 0 0 4294967295 ECU_ADDRESS 0x1222FA4 /end MEASUREMENT
/begin MEASUREMENT MCore_rba_Runtime_IntCorrStates_ast "" UBYTE NO_COMPU_METHOD 0 0 0 255 ECU_ADDRESS 0x400E1990 /end MEASUREMENT
/begin MEASUREMENT MCore_rba_Runtime_IntCorrStates_ast[0].tiActValue_u32 "" ULONG NO_COMPU_METHOD 0 0 0 4294967295 ECU_ADDRESS 0x400E1990 /end MEASUREMENT
/begin MEASUREMENT MCore_rba_Runtime_IntCorrStates_ast[0].tiCalibPost_u32 "" ULONG NO_COMPU_METHOD 0 0 0 4294967295 ECU_ADDRESS 0x400E199C /end MEASUREMENT
/begin MEASUREMENT MCore_rba_Runtime_IntCorrStates_ast[0].tiCalibPre_u32 "" ULONG NO_COMPU_METHOD 0 0 0 4294967295 ECU_ADDRESS 0x400E1998 /end MEASUREMENT
/begin MEASUREMENT MCore_rba_Runtime_IntCorrStates_ast[0].tiCorr_u32 "" ULONG NO_COMPU_METHOD 0 0 0 4294967295 ECU_ADDRESS 0x400E1994 /end MEASUREMENT
/begin MEASUREMENT MCore_rba_Runtime_IntCorrTableCrossCoreInt_ast "" UBYTE NO_COMPU_METHOD 0 0 0 255 ECU_ADDRESS 0x400E1A30 /end MEASUREMENT
/begin MEASUREMENT MCore_rba_Runtime_IntCorrTableCrossCoreInt_ast[0].tiValue_u32 "" ULONG NO_COMPU_METHOD 0 0 0 4294967295 ECU_ADDRESS 0x400E1A30 /end MEASUREMENT
/begin MEASUREMENT MCore_rba_Runtime_IntCorrTableIsr_ast "" UBYTE NO_COMPU_METHOD 0 0 0 255 ECU_ADDRESS 0x400E19A0 /end MEASUREMENT
/begin MEASUREMENT MCore_rba_Runtime_IntCorrTableIsr_ast[0].tiValue_u32 "" ULONG NO_COMPU_METHOD 0 0 0 4294967295 ECU_ADDRESS 0x400E19A0 /end MEASUREMENT
/begin MEASUREMENT MCore_rba_Runtime_IntCorrTableTask_ast "" UBYTE NO_COMPU_METHOD 0 0 0 255 ECU_ADDRESS 0x400E1A34 /end MEASUREMENT
/begin MEASUREMENT MCore_rba_Runtime_IntCorrTableTask_ast[0].tiValue_u32 "" ULONG NO_COMPU_METHOD 0 0 0 4294967295 ECU_ADDRESS 0x400E1A34 /end MEASUREMENT
/begin MEASUREMENT MCore_rba_Runtime_IntCorrTableTask_ast[1].tiValue_u32 "" ULONG NO_COMPU_METHOD 0 0 0 4294967295 ECU_ADDRESS 0x400E1A38 /end MEASUREMENT
/begin MEASUREMENT MCore_rba_Runtime_IntCorrTableTask_ast[2].tiValue_u32 "" ULONG NO_COMPU_METHOD 0 0 0 4294967295 ECU_ADDRESS 0x400E1A3C /end MEASUREMENT
/begin MEASUREMENT MCore_rba_Runtime_IntCorrTableTask_ast[3].tiValue_u32 "" ULONG NO_COMPU_METHOD 0 0 0 4294967295 ECU_ADDRESS 0x400E1A40 /end MEASUREMENT
/begin MEASUREMENT MCore_rba_Runtime_IntCorrTableTask_ast[4].tiValue_u32 "" ULONG NO_COMPU_METHOD 0 0 0 4294967295 ECU_ADDRESS 0x400E1A44 /end MEASUREMENT
/begin MEASUREMENT MCore_rba_Runtime_IntCorrTableTask_ast[5].tiValue_u32 "" ULONG NO_COMPU_METHOD 0 0 0 4294967295 ECU_ADDRESS 0x400E1A48 /end MEASUREMENT
/begin MEASUREMENT MCore_rba_Runtime_IntCorrTableTask_ast[6].tiValue_u32 "" ULONG NO_COMPU_METHOD 0 0 0 4294967295 ECU_ADDRESS 0x400E1A4C /end MEASUREMENT
/begin MEASUREMENT MCore_rba_Runtime_IntCorrTableTask_ast[7].tiValue_u32 "" ULONG NO_COMPU_METHOD 0 0 0 4294967295 ECU_ADDRESS 0x400E1A50 /end MEASUREMENT
/begin MEASUREMENT MCore_rba_Runtime_IntCorrTableTask_ast[8].tiValue_u32 "" ULONG NO_COMPU_METHOD 0 0 0 4294967295 ECU_ADDRESS 0x400E1A54 /end MEASUREMENT
/begin MEASUREMENT MCore_rba_Runtime_MTCalibrate_u32 "" ULONG NO_COMPU_METHOD 0 0 0 4294967295 ECU_ADDRESS 0x400E1ABC /end MEASUREMENT
/begin MEASUREMENT MCore_rba_Runtime_MonIsrList_ast "" UBYTE NO_COMPU_METHOD 0 0 0 255 ECU_ADDRESS 0x122301C /end MEASUREMENT
/begin MEASUREMENT MCore_rba_Runtime_MonIsrLookupTable_au8 "" UBYTE NO_COMPU_METHOD 0 0 0 255 ECU_ADDRESS 0x400E1ACA /end MEASUREMENT
/begin MEASUREMENT MCore_rba_Runtime_MonIsr_ast "" UBYTE NO_COMPU_METHOD 0 0 0 255 ECU_ADDRESS 0x400E1B10 /end MEASUREMENT
/begin MEASUREMENT MCore_rba_Runtime_MonIsr_ast[0].ctCallsTotal_u32 "" ULONG NO_COMPU_METHOD 0 0 0 4294967295 ECU_ADDRESS 0x400E1B1C /end MEASUREMENT
/begin MEASUREMENT MCore_rba_Runtime_MonIsr_ast[0].ctCalls_u32 "" ULONG NO_COMPU_METHOD 0 0 0 4294967295 ECU_ADDRESS 0x400E1B24 /end MEASUREMENT
/begin MEASUREMENT MCore_rba_Runtime_MonIsr_ast[0].ctSampleProcessed_u8 "" UBYTE NO_COMPU_METHOD 0 0 0 255 ECU_ADDRESS 0x400E1B36 /end MEASUREMENT
/begin MEASUREMENT MCore_rba_Runtime_MonIsr_ast[0].internal_st "" UBYTE NO_COMPU_METHOD 0 0 0 255 ECU_ADDRESS 0x400E1B28 /end MEASUREMENT
/begin MEASUREMENT MCore_rba_Runtime_MonIsr_ast[0].internal_st.ctBeginCalls_u32 "" ULONG NO_COMPU_METHOD 0 0 0 4294967295 ECU_ADDRESS 0x400E1B2C /end MEASUREMENT
/begin MEASUREMENT MCore_rba_Runtime_MonIsr_ast[0].internal_st.tiAccuRT_u32 "" ULONG NO_COMPU_METHOD 0 0 0 4294967295 ECU_ADDRESS 0x400E1B28 /end MEASUREMENT
/begin MEASUREMENT MCore_rba_Runtime_MonIsr_ast[0].internal_st.tiBeginFree_u32 "" ULONG NO_COMPU_METHOD 0 0 0 4294967295 ECU_ADDRESS 0x400E1B30 /end MEASUREMENT
/begin MEASUREMENT MCore_rba_Runtime_MonIsr_ast[0].loadPer64k_u16 "" UWORD NO_COMPU_METHOD 0 0 0 65535 ECU_ADDRESS 0x400E1B34 /end MEASUREMENT
/begin MEASUREMENT MCore_rba_Runtime_MonIsr_ast[0].tiAvrgRT_u32 "" ULONG NO_COMPU_METHOD 0 0 0 4294967295 ECU_ADDRESS 0x400E1B20 /end MEASUREMENT
/begin MEASUREMENT MCore_rba_Runtime_MonIsr_ast[0].tiCurRT_u32 "" ULONG NO_COMPU_METHOD 0 0 0 4294967295 ECU_ADDRESS 0x400E1B10 /end MEASUREMENT
/begin MEASUREMENT MCore_rba_Runtime_MonIsr_ast[0].tiMaxRT_u32 "" ULONG NO_COMPU_METHOD 0 0 0 4294967295 ECU_ADDRESS 0x400E1B18 /end MEASUREMENT
/begin MEASUREMENT MCore_rba_Runtime_MonIsr_ast[0].tiMinRT_u32 "" ULONG NO_COMPU_METHOD 0 0 0 4294967295 ECU_ADDRESS 0x400E1B14 /end MEASUREMENT
/begin MEASUREMENT MCore_rba_Runtime_MonSample_u8 "" UBYTE NO_COMPU_METHOD 0 0 0 255 ECU_ADDRESS 0x400E20D6 /end MEASUREMENT
/begin MEASUREMENT MCore_rba_Runtime_MonSystemLoadInitFlag_u8 "" UBYTE NO_COMPU_METHOD 0 0 0 255 ECU_ADDRESS 0x400E1AC9 /end MEASUREMENT
/begin MEASUREMENT MCore_rba_Runtime_MonSystemLoadPer64k_au16 "" UBYTE NO_COMPU_METHOD 0 0 0 255 ECU_ADDRESS 0x400E20D4 /end MEASUREMENT
/begin MEASUREMENT MCore_rba_Runtime_MonTaskList_ast "" UBYTE NO_COMPU_METHOD 0 0 0 255 ECU_ADDRESS 0x1222FAC /end MEASUREMENT
/begin MEASUREMENT MCore_rba_Runtime_MonTaskLookupTable_au8 "" UBYTE NO_COMPU_METHOD 0 0 0 255 ECU_ADDRESS 0x400E1AEE /end MEASUREMENT
/begin MEASUREMENT MCore_rba_Runtime_MonTask_ast "" UBYTE NO_COMPU_METHOD 0 0 0 255 ECU_ADDRESS 0x400E1E30 /end MEASUREMENT
/begin MEASUREMENT MCore_rba_Runtime_MonTask_ast[0].ctCallsTotal_u32 "" ULONG NO_COMPU_METHOD 0 0 0 4294967295 ECU_ADDRESS 0x400E1E48 /end MEASUREMENT
/begin MEASUREMENT MCore_rba_Runtime_MonTask_ast[0].ctCalls_u32 "" ULONG NO_COMPU_METHOD 0 0 0 4294967295 ECU_ADDRESS 0x400E1E50 /end MEASUREMENT
/begin MEASUREMENT MCore_rba_Runtime_MonTask_ast[0].ctSampleProcessed_u8 "" UBYTE NO_COMPU_METHOD 0 0 0 255 ECU_ADDRESS 0x400E1E62 /end MEASUREMENT
/begin MEASUREMENT MCore_rba_Runtime_MonTask_ast[0].internal_st "" UBYTE NO_COMPU_METHOD 0 0 0 255 ECU_ADDRESS 0x400E1E54 /end MEASUREMENT
/begin MEASUREMENT MCore_rba_Runtime_MonTask_ast[0].internal_st.ctBeginCalls_u32 "" ULONG NO_COMPU_METHOD 0 0 0 4294967295 ECU_ADDRESS 0x400E1E58 /end MEASUREMENT
/begin MEASUREMENT MCore_rba_Runtime_MonTask_ast[0].internal_st.tiAccuRT_u32 "" ULONG NO_COMPU_METHOD 0 0 0 4294967295 ECU_ADDRESS 0x400E1E54 /end MEASUREMENT
/begin MEASUREMENT MCore_rba_Runtime_MonTask_ast[0].internal_st.tiBeginFree_u32 "" ULONG NO_COMPU_METHOD 0 0 0 4294967295 ECU_ADDRESS 0x400E1E5C /end MEASUREMENT
/begin MEASUREMENT MCore_rba_Runtime_MonTask_ast[0].loadPer64k_u16 "" UWORD NO_COMPU_METHOD 0 0 0 65535 ECU_ADDRESS 0x400E1E60 /end MEASUREMENT
/begin MEASUREMENT MCore_rba_Runtime_MonTask_ast[0].tiAvrgRT_u32 "" ULONG NO_COMPU_METHOD 0 0 0 4294967295 ECU_ADDRESS 0x400E1E4C /end MEASUREMENT
/begin MEASUREMENT MCore_rba_Runtime_MonTask_ast[0].tiCurRT_u32 "" ULONG NO_COMPU_METHOD 0 0 0 4294967295 ECU_ADDRESS 0x400E1E30 /end MEASUREMENT
/begin MEASUREMENT MCore_rba_Runtime_MonTask_ast[0].tiCurResponseT_u32 "" ULONG NO_COMPU_METHOD 0 0 0 4294967295 ECU_ADDRESS 0x400E1E3C /end MEASUREMENT
/begin MEASUREMENT MCore_rba_Runtime_MonTask_ast[0].tiMaxRT_u32 "" ULONG NO_COMPU_METHOD 0 0 0 4294967295 ECU_ADDRESS 0x400E1E38 /end MEASUREMENT
/begin MEASUREMENT MCore_rba_Runtime_MonTask_ast[0].tiMaxResponseT_u32 "" ULONG NO_COMPU_METHOD 0 0 0 4294967295 ECU_ADDRESS 0x400E1E44 /end MEASUREMENT
/begin MEASUREMENT MCore_rba_Runtime_MonTask_ast[0].tiMinRT_u32 "" ULONG NO_COMPU_METHOD 0 0 0 4294967295 ECU_ADDRESS 0x400E1E34 /end MEASUREMENT
/begin MEASUREMENT MCore_rba_Runtime_MonTask_ast[0].tiMinResponseT_u32 "" ULONG NO_COMPU_METHOD 0 0 0 4294967295 ECU_ADDRESS 0x400E1E40 /end MEASUREMENT
/begin MEASUREMENT MCore_rba_Runtime_MonTask_ast[1].ctCallsTotal_u32 "" ULONG NO_COMPU_METHOD 0 0 0 4294967295 ECU_ADDRESS 0x400E1E7C /end MEASUREMENT
/begin MEASUREMENT MCore_rba_Runtime_MonTask_ast[1].ctCalls_u32 "" ULONG NO_COMPU_METHOD 0 0 0 4294967295 ECU_ADDRESS 0x400E1E84 /end MEASUREMENT
/begin MEASUREMENT MCore_rba_Runtime_MonTask_ast[1].ctSampleProcessed_u8 "" UBYTE NO_COMPU_METHOD 0 0 0 255 ECU_ADDRESS 0x400E1E96 /end MEASUREMENT
/begin MEASUREMENT MCore_rba_Runtime_MonTask_ast[1].internal_st "" UBYTE NO_COMPU_METHOD 0 0 0 255 ECU_ADDRESS 0x400E1E88 /end MEASUREMENT
/begin MEASUREMENT MCore_rba_Runtime_MonTask_ast[1].internal_st.ctBeginCalls_u32 "" ULONG NO_COMPU_METHOD 0 0 0 4294967295 ECU_ADDRESS 0x400E1E8C /end MEASUREMENT
/begin MEASUREMENT MCore_rba_Runtime_MonTask_ast[1].internal_st.tiAccuRT_u32 "" ULONG NO_COMPU_METHOD 0 0 0 4294967295 ECU_ADDRESS 0x400E1E88 /end MEASUREMENT
/begin MEASUREMENT MCore_rba_Runtime_MonTask_ast[1].internal_st.tiBeginFree_u32 "" ULONG NO_COMPU_METHOD 0 0 0 4294967295 ECU_ADDRESS 0x400E1E90 /end MEASUREMENT
/begin MEASUREMENT MCore_rba_Runtime_MonTask_ast[1].loadPer64k_u16 "" UWORD NO_COMPU_METHOD 0 0 0 65535 ECU_ADDRESS 0x400E1E94 /end MEASUREMENT
/begin MEASUREMENT MCore_rba_Runtime_MonTask_ast[1].tiAvrgRT_u32 "" ULONG NO_COMPU_METHOD 0 0 0 4294967295 ECU_ADDRESS 0x400E1E80 /end MEASUREMENT
/begin MEASUREMENT MCore_rba_Runtime_MonTask_ast[1].tiCurRT_u32 "" ULONG NO_COMPU_METHOD 0 0 0 4294967295 ECU_ADDRESS 0x400E1E64 /end MEASUREMENT
/begin MEASUREMENT MCore_rba_Runtime_MonTask_ast[1].tiCurResponseT_u32 "" ULONG NO_COMPU_METHOD 0 0 0 4294967295 ECU_ADDRESS 0x400E1E70 /end MEASUREMENT
/begin MEASUREMENT MCore_rba_Runtime_MonTask_ast[1].tiMaxRT_u32 "" ULONG NO_COMPU_METHOD 0 0 0 4294967295 ECU_ADDRESS 0x400E1E6C /end MEASUREMENT
/begin MEASUREMENT MCore_rba_Runtime_MonTask_ast[1].tiMaxResponseT_u32 "" ULONG NO_COMPU_METHOD 0 0 0 4294967295 ECU_ADDRESS 0x400E1E78 /end MEASUREMENT
/begin MEASUREMENT MCore_rba_Runtime_MonTask_ast[1].tiMinRT_u32 "" ULONG NO_COMPU_METHOD 0 0 0 4294967295 ECU_ADDRESS 0x400E1E68 /end MEASUREMENT
/begin MEASUREMENT MCore_rba_Runtime_MonTask_ast[1].tiMinResponseT_u32 "" ULONG NO_COMPU_METHOD 0 0 0 4294967295 ECU_ADDRESS 0x400E1E74 /end MEASUREMENT
/begin MEASUREMENT MCore_rba_Runtime_MonTask_ast[2].ctCallsTotal_u32 "" ULONG NO_COMPU_METHOD 0 0 0 4294967295 ECU_ADDRESS 0x400E1EB0 /end MEASUREMENT
/begin MEASUREMENT MCore_rba_Runtime_MonTask_ast[2].ctCalls_u32 "" ULONG NO_COMPU_METHOD 0 0 0 4294967295 ECU_ADDRESS 0x400E1EB8 /end MEASUREMENT
/begin MEASUREMENT MCore_rba_Runtime_MonTask_ast[2].ctSampleProcessed_u8 "" UBYTE NO_COMPU_METHOD 0 0 0 255 ECU_ADDRESS 0x400E1ECA /end MEASUREMENT
/begin MEASUREMENT MCore_rba_Runtime_MonTask_ast[2].internal_st "" UBYTE NO_COMPU_METHOD 0 0 0 255 ECU_ADDRESS 0x400E1EBC /end MEASUREMENT
/begin MEASUREMENT MCore_rba_Runtime_MonTask_ast[2].internal_st.ctBeginCalls_u32 "" ULONG NO_COMPU_METHOD 0 0 0 4294967295 ECU_ADDRESS 0x400E1EC0 /end MEASUREMENT
/begin MEASUREMENT MCore_rba_Runtime_MonTask_ast[2].internal_st.tiAccuRT_u32 "" ULONG NO_COMPU_METHOD 0 0 0 4294967295 ECU_ADDRESS 0x400E1EBC /end MEASUREMENT
/begin MEASUREMENT MCore_rba_Runtime_MonTask_ast[2].internal_st.tiBeginFree_u32 "" ULONG NO_COMPU_METHOD 0 0 0 4294967295 ECU_ADDRESS 0x400E1EC4 /end MEASUREMENT
/begin MEASUREMENT MCore_rba_Runtime_MonTask_ast[2].loadPer64k_u16 "" UWORD NO_COMPU_METHOD 0 0 0 65535 ECU_ADDRESS 0x400E1EC8 /end MEASUREMENT
/begin MEASUREMENT MCore_rba_Runtime_MonTask_ast[2].tiAvrgRT_u32 "" ULONG NO_COMPU_METHOD 0 0 0 4294967295 ECU_ADDRESS 0x400E1EB4 /end MEASUREMENT
/begin MEASUREMENT MCore_rba_Runtime_MonTask_ast[2].tiCurRT_u32 "" ULONG NO_COMPU_METHOD 0 0 0 4294967295 ECU_ADDRESS 0x400E1E98 /end MEASUREMENT
/begin MEASUREMENT MCore_rba_Runtime_MonTask_ast[2].tiCurResponseT_u32 "" ULONG NO_COMPU_METHOD 0 0 0 4294967295 ECU_ADDRESS 0x400E1EA4 /end MEASUREMENT
/begin MEASUREMENT MCore_rba_Runtime_MonTask_ast[2].tiMaxRT_u32 "" ULONG NO_COMPU_METHOD 0 0 0 4294967295 ECU_ADDRESS 0x400E1EA0 /end MEASUREMENT
/begin MEASUREMENT MCore_rba_Runtime_MonTask_ast[2].tiMaxResponseT_u32 "" ULONG NO_COMPU_METHOD 0 0 0 4294967295 ECU_ADDRESS 0x400E1EAC /end MEASUREMENT
/begin MEASUREMENT MCore_rba_Runtime_MonTask_ast[2].tiMinRT_u32 "" ULONG NO_COMPU_METHOD 0 0 0 4294967295 ECU_ADDRESS 0x400E1E9C /end MEASUREMENT
/begin MEASUREMENT MCore_rba_Runtime_MonTask_ast[2].tiMinResponseT_u32 "" ULONG NO_COMPU_METHOD 0 0 0 4294967295 ECU_ADDRESS 0x400E1EA8 /end MEASUREMENT
/begin MEASUREMENT MCore_rba_Runtime_MonTask_ast[3].ctCallsTotal_u32 "" ULONG NO_COMPU_METHOD 0 0 0 4294967295 ECU_ADDRESS 0x400E1EE4 /end MEASUREMENT
/begin MEASUREMENT MCore_rba_Runtime_MonTask_ast[3].ctCalls_u32 "" ULONG NO_COMPU_METHOD 0 0 0 4294967295 ECU_ADDRESS 0x400E1EEC /end MEASUREMENT
/begin MEASUREMENT MCore_rba_Runtime_MonTask_ast[3].ctSampleProcessed_u8 "" UBYTE NO_COMPU_METHOD 0 0 0 255 ECU_ADDRESS 0x400E1EFE /end MEASUREMENT
/begin MEASUREMENT MCore_rba_Runtime_MonTask_ast[3].internal_st "" UBYTE NO_COMPU_METHOD 0 0 0 255 ECU_ADDRESS 0x400E1EF0 /end MEASUREMENT
/begin MEASUREMENT MCore_rba_Runtime_MonTask_ast[3].internal_st.ctBeginCalls_u32 "" ULONG NO_COMPU_METHOD 0 0 0 4294967295 ECU_ADDRESS 0x400E1EF4 /end MEASUREMENT
/begin MEASUREMENT MCore_rba_Runtime_MonTask_ast[3].internal_st.tiAccuRT_u32 "" ULONG NO_COMPU_METHOD 0 0 0 4294967295 ECU_ADDRESS 0x400E1EF0 /end MEASUREMENT
/begin MEASUREMENT MCore_rba_Runtime_MonTask_ast[3].internal_st.tiBeginFree_u32 "" ULONG NO_COMPU_METHOD 0 0 0 4294967295 ECU_ADDRESS 0x400E1EF8 /end MEASUREMENT
/begin MEASUREMENT MCore_rba_Runtime_MonTask_ast[3].loadPer64k_u16 "" UWORD NO_COMPU_METHOD 0 0 0 65535 ECU_ADDRESS 0x400E1EFC /end MEASUREMENT
/begin MEASUREMENT MCore_rba_Runtime_MonTask_ast[3].tiAvrgRT_u32 "" ULONG NO_COMPU_METHOD 0 0 0 4294967295 ECU_ADDRESS 0x400E1EE8 /end MEASUREMENT
/begin MEASUREMENT MCore_rba_Runtime_MonTask_ast[3].tiCurRT_u32 "" ULONG NO_COMPU_METHOD 0 0 0 4294967295 ECU_ADDRESS 0x400E1ECC /end MEASUREMENT
/begin MEASUREMENT MCore_rba_Runtime_MonTask_ast[3].tiCurResponseT_u32 "" ULONG NO_COMPU_METHOD 0 0 0 4294967295 ECU_ADDRESS 0x400E1ED8 /end MEASUREMENT
/begin MEASUREMENT MCore_rba_Runtime_MonTask_ast[3].tiMaxRT_u32 "" ULONG NO_COMPU_METHOD 0 0 0 4294967295 ECU_ADDRESS 0x400E1ED4 /end MEASUREMENT
/begin MEASUREMENT MCore_rba_Runtime_MonTask_ast[3].tiMaxResponseT_u32 "" ULONG NO_COMPU_METHOD 0 0 0 4294967295 ECU_ADDRESS 0x400E1EE0 /end MEASUREMENT
/begin MEASUREMENT MCore_rba_Runtime_MonTask_ast[3].tiMinRT_u32 "" ULONG NO_COMPU_METHOD 0 0 0 4294967295 ECU_ADDRESS 0x400E1ED0 /end MEASUREMENT
/begin MEASUREMENT MCore_rba_Runtime_MonTask_ast[3].tiMinResponseT_u32 "" ULONG NO_COMPU_METHOD 0 0 0 4294967295 ECU_ADDRESS 0x400E1EDC /end MEASUREMENT
/begin MEASUREMENT MCore_rba_Runtime_MonTask_ast[4].ctCallsTotal_u32 "" ULONG NO_COMPU_METHOD 0 0 0 4294967295 ECU_ADDRESS 0x400E1F18 /end MEASUREMENT
/begin MEASUREMENT MCore_rba_Runtime_MonTask_ast[4].ctCalls_u32 "" ULONG NO_COMPU_METHOD 0 0 0 4294967295 ECU_ADDRESS 0x400E1F20 /end MEASUREMENT
/begin MEASUREMENT MCore_rba_Runtime_MonTask_ast[4].ctSampleProcessed_u8 "" UBYTE NO_COMPU_METHOD 0 0 0 255 ECU_ADDRESS 0x400E1F32 /end MEASUREMENT
/begin MEASUREMENT MCore_rba_Runtime_MonTask_ast[4].internal_st "" UBYTE NO_COMPU_METHOD 0 0 0 255 ECU_ADDRESS 0x400E1F24 /end MEASUREMENT
/begin MEASUREMENT MCore_rba_Runtime_MonTask_ast[4].internal_st.ctBeginCalls_u32 "" ULONG NO_COMPU_METHOD 0 0 0 4294967295 ECU_ADDRESS 0x400E1F28 /end MEASUREMENT
/begin MEASUREMENT MCore_rba_Runtime_MonTask_ast[4].internal_st.tiAccuRT_u32 "" ULONG NO_COMPU_METHOD 0 0 0 4294967295 ECU_ADDRESS 0x400E1F24 /end MEASUREMENT
/begin MEASUREMENT MCore_rba_Runtime_MonTask_ast[4].internal_st.tiBeginFree_u32 "" ULONG NO_COMPU_METHOD 0 0 0 4294967295 ECU_ADDRESS 0x400E1F2C /end MEASUREMENT
/begin MEASUREMENT MCore_rba_Runtime_MonTask_ast[4].loadPer64k_u16 "" UWORD NO_COMPU_METHOD 0 0 0 65535 ECU_ADDRESS 0x400E1F30 /end MEASUREMENT
/begin MEASUREMENT MCore_rba_Runtime_MonTask_ast[4].tiAvrgRT_u32 "" ULONG NO_COMPU_METHOD 0 0 0 4294967295 ECU_ADDRESS 0x400E1F1C /end MEASUREMENT
/begin MEASUREMENT MCore_rba_Runtime_MonTask_ast[4].tiCurRT_u32 "" ULONG NO_COMPU_METHOD 0 0 0 4294967295 ECU_ADDRESS 0x400E1F00 /end MEASUREMENT
/begin MEASUREMENT MCore_rba_Runtime_MonTask_ast[4].tiCurResponseT_u32 "" ULONG NO_COMPU_METHOD 0 0 0 4294967295 ECU_ADDRESS 0x400E1F0C /end MEASUREMENT
/begin MEASUREMENT MCore_rba_Runtime_MonTask_ast[4].tiMaxRT_u32 "" ULONG NO_COMPU_METHOD 0 0 0 4294967295 ECU_ADDRESS 0x400E1F08 /end MEASUREMENT
/begin MEASUREMENT MCore_rba_Runtime_MonTask_ast[4].tiMaxResponseT_u32 "" ULONG NO_COMPU_METHOD 0 0 0 4294967295 ECU_ADDRESS 0x400E1F14 /end MEASUREMENT
/begin MEASUREMENT MCore_rba_Runtime_MonTask_ast[4].tiMinRT_u32 "" ULONG NO_COMPU_METHOD 0 0 0 4294967295 ECU_ADDRESS 0x400E1F04 /end MEASUREMENT
/begin MEASUREMENT MCore_rba_Runtime_MonTask_ast[4].tiMinResponseT_u32 "" ULONG NO_COMPU_METHOD 0 0 0 4294967295 ECU_ADDRESS 0x400E1F10 /end MEASUREMENT
/begin MEASUREMENT MCore_rba_Runtime_MonTask_ast[5].ctCallsTotal_u32 "" ULONG NO_COMPU_METHOD 0 0 0 4294967295 ECU_ADDRESS 0x400E1F4C /end MEASUREMENT
/begin MEASUREMENT MCore_rba_Runtime_MonTask_ast[5].ctCalls_u32 "" ULONG NO_COMPU_METHOD 0 0 0 4294967295 ECU_ADDRESS 0x400E1F54 /end MEASUREMENT
/begin MEASUREMENT MCore_rba_Runtime_MonTask_ast[5].ctSampleProcessed_u8 "" UBYTE NO_COMPU_METHOD 0 0 0 255 ECU_ADDRESS 0x400E1F66 /end MEASUREMENT
/begin MEASUREMENT MCore_rba_Runtime_MonTask_ast[5].internal_st "" UBYTE NO_COMPU_METHOD 0 0 0 255 ECU_ADDRESS 0x400E1F58 /end MEASUREMENT
/begin MEASUREMENT MCore_rba_Runtime_MonTask_ast[5].internal_st.ctBeginCalls_u32 "" ULONG NO_COMPU_METHOD 0 0 0 4294967295 ECU_ADDRESS 0x400E1F5C /end MEASUREMENT
/begin MEASUREMENT MCore_rba_Runtime_MonTask_ast[5].internal_st.tiAccuRT_u32 "" ULONG NO_COMPU_METHOD 0 0 0 4294967295 ECU_ADDRESS 0x400E1F58 /end MEASUREMENT
/begin MEASUREMENT MCore_rba_Runtime_MonTask_ast[5].internal_st.tiBeginFree_u32 "" ULONG NO_COMPU_METHOD 0 0 0 4294967295 ECU_ADDRESS 0x400E1F60 /end MEASUREMENT
/begin MEASUREMENT MCore_rba_Runtime_MonTask_ast[5].loadPer64k_u16 "" UWORD NO_COMPU_METHOD 0 0 0 65535 ECU_ADDRESS 0x400E1F64 /end MEASUREMENT
/begin MEASUREMENT MCore_rba_Runtime_MonTask_ast[5].tiAvrgRT_u32 "" ULONG NO_COMPU_METHOD 0 0 0 4294967295 ECU_ADDRESS 0x400E1F50 /end MEASUREMENT
/begin MEASUREMENT MCore_rba_Runtime_MonTask_ast[5].tiCurRT_u32 "" ULONG NO_COMPU_METHOD 0 0 0 4294967295 ECU_ADDRESS 0x400E1F34 /end MEASUREMENT
/begin MEASUREMENT MCore_rba_Runtime_MonTask_ast[5].tiCurResponseT_u32 "" ULONG NO_COMPU_METHOD 0 0 0 4294967295 ECU_ADDRESS 0x400E1F40 /end MEASUREMENT
/begin MEASUREMENT MCore_rba_Runtime_MonTask_ast[5].tiMaxRT_u32 "" ULONG NO_COMPU_METHOD 0 0 0 4294967295 ECU_ADDRESS 0x400E1F3C /end MEASUREMENT
/begin MEASUREMENT MCore_rba_Runtime_MonTask_ast[5].tiMaxResponseT_u32 "" ULONG NO_COMPU_METHOD 0 0 0 4294967295 ECU_ADDRESS 0x400E1F48 /end MEASUREMENT
/begin MEASUREMENT MCore_rba_Runtime_MonTask_ast[5].tiMinRT_u32 "" ULONG NO_COMPU_METHOD 0 0 0 4294967295 ECU_ADDRESS 0x400E1F38 /end MEASUREMENT
/begin MEASUREMENT MCore_rba_Runtime_MonTask_ast[5].tiMinResponseT_u32 "" ULONG NO_COMPU_METHOD 0 0 0 4294967295 ECU_ADDRESS 0x400E1F44 /end MEASUREMENT
/begin MEASUREMENT MCore_rba_Runtime_MonTask_ast[6].ctCallsTotal_u32 "" ULONG NO_COMPU_METHOD 0 0 0 4294967295 ECU_ADDRESS 0x400E1F80 /end MEASUREMENT
/begin MEASUREMENT MCore_rba_Runtime_MonTask_ast[6].ctCalls_u32 "" ULONG NO_COMPU_METHOD 0 0 0 4294967295 ECU_ADDRESS 0x400E1F88 /end MEASUREMENT
/begin MEASUREMENT MCore_rba_Runtime_MonTask_ast[6].ctSampleProcessed_u8 "" UBYTE NO_COMPU_METHOD 0 0 0 255 ECU_ADDRESS 0x400E1F9A /end MEASUREMENT
/begin MEASUREMENT MCore_rba_Runtime_MonTask_ast[6].internal_st "" UBYTE NO_COMPU_METHOD 0 0 0 255 ECU_ADDRESS 0x400E1F8C /end MEASUREMENT
/begin MEASUREMENT MCore_rba_Runtime_MonTask_ast[6].internal_st.ctBeginCalls_u32 "" ULONG NO_COMPU_METHOD 0 0 0 4294967295 ECU_ADDRESS 0x400E1F90 /end MEASUREMENT
/begin MEASUREMENT MCore_rba_Runtime_MonTask_ast[6].internal_st.tiAccuRT_u32 "" ULONG NO_COMPU_METHOD 0 0 0 4294967295 ECU_ADDRESS 0x400E1F8C /end MEASUREMENT
/begin MEASUREMENT MCore_rba_Runtime_MonTask_ast[6].internal_st.tiBeginFree_u32 "" ULONG NO_COMPU_METHOD 0 0 0 4294967295 ECU_ADDRESS 0x400E1F94 /end MEASUREMENT
/begin MEASUREMENT MCore_rba_Runtime_MonTask_ast[6].loadPer64k_u16 "" UWORD NO_COMPU_METHOD 0 0 0 65535 ECU_ADDRESS 0x400E1F98 /end MEASUREMENT
/begin MEASUREMENT MCore_rba_Runtime_MonTask_ast[6].tiAvrgRT_u32 "" ULONG NO_COMPU_METHOD 0 0 0 4294967295 ECU_ADDRESS 0x400E1F84 /end MEASUREMENT
/begin MEASUREMENT MCore_rba_Runtime_MonTask_ast[6].tiCurRT_u32 "" ULONG NO_COMPU_METHOD 0 0 0 4294967295 ECU_ADDRESS 0x400E1F68 /end MEASUREMENT
/begin MEASUREMENT MCore_rba_Runtime_MonTask_ast[6].tiCurResponseT_u32 "" ULONG NO_COMPU_METHOD 0 0 0 4294967295 ECU_ADDRESS 0x400E1F74 /end MEASUREMENT
/begin MEASUREMENT MCore_rba_Runtime_MonTask_ast[6].tiMaxRT_u32 "" ULONG NO_COMPU_METHOD 0 0 0 4294967295 ECU_ADDRESS 0x400E1F70 /end MEASUREMENT
/begin MEASUREMENT MCore_rba_Runtime_MonTask_ast[6].tiMaxResponseT_u32 "" ULONG NO_COMPU_METHOD 0 0 0 4294967295 ECU_ADDRESS 0x400E1F7C /end MEASUREMENT
/begin MEASUREMENT MCore_rba_Runtime_MonTask_ast[6].tiMinRT_u32 "" ULONG NO_COMPU_METHOD 0 0 0 4294967295 ECU_ADDRESS 0x400E1F6C /end MEASUREMENT
/begin MEASUREMENT MCore_rba_Runtime_MonTask_ast[6].tiMinResponseT_u32 "" ULONG NO_COMPU_METHOD 0 0 0 4294967295 ECU_ADDRESS 0x400E1F78 /end MEASUREMENT
/begin MEASUREMENT MCore_rba_Runtime_MonTask_ast[7].ctCallsTotal_u32 "" ULONG NO_COMPU_METHOD 0 0 0 4294967295 ECU_ADDRESS 0x400E1FB4 /end MEASUREMENT
/begin MEASUREMENT MCore_rba_Runtime_MonTask_ast[7].ctCalls_u32 "" ULONG NO_COMPU_METHOD 0 0 0 4294967295 ECU_ADDRESS 0x400E1FBC /end MEASUREMENT
/begin MEASUREMENT MCore_rba_Runtime_MonTask_ast[7].ctSampleProcessed_u8 "" UBYTE NO_COMPU_METHOD 0 0 0 255 ECU_ADDRESS 0x400E1FCE /end MEASUREMENT
/begin MEASUREMENT MCore_rba_Runtime_MonTask_ast[7].internal_st "" UBYTE NO_COMPU_METHOD 0 0 0 255 ECU_ADDRESS 0x400E1FC0 /end MEASUREMENT
/begin MEASUREMENT MCore_rba_Runtime_MonTask_ast[7].internal_st.ctBeginCalls_u32 "" ULONG NO_COMPU_METHOD 0 0 0 4294967295 ECU_ADDRESS 0x400E1FC4 /end MEASUREMENT
/begin MEASUREMENT MCore_rba_Runtime_MonTask_ast[7].internal_st.tiAccuRT_u32 "" ULONG NO_COMPU_METHOD 0 0 0 4294967295 ECU_ADDRESS 0x400E1FC0 /end MEASUREMENT
/begin MEASUREMENT MCore_rba_Runtime_MonTask_ast[7].internal_st.tiBeginFree_u32 "" ULONG NO_COMPU_METHOD 0 0 0 4294967295 ECU_ADDRESS 0x400E1FC8 /end MEASUREMENT
/begin MEASUREMENT MCore_rba_Runtime_MonTask_ast[7].loadPer64k_u16 "" UWORD NO_COMPU_METHOD 0 0 0 65535 ECU_ADDRESS 0x400E1FCC /end MEASUREMENT
/begin MEASUREMENT MCore_rba_Runtime_MonTask_ast[7].tiAvrgRT_u32 "" ULONG NO_COMPU_METHOD 0 0 0 4294967295 ECU_ADDRESS 0x400E1FB8 /end MEASUREMENT
/begin MEASUREMENT MCore_rba_Runtime_MonTask_ast[7].tiCurRT_u32 "" ULONG NO_COMPU_METHOD 0 0 0 4294967295 ECU_ADDRESS 0x400E1F9C /end MEASUREMENT
/begin MEASUREMENT MCore_rba_Runtime_MonTask_ast[7].tiCurResponseT_u32 "" ULONG NO_COMPU_METHOD 0 0 0 4294967295 ECU_ADDRESS 0x400E1FA8 /end MEASUREMENT
/begin MEASUREMENT MCore_rba_Runtime_MonTask_ast[7].tiMaxRT_u32 "" ULONG NO_COMPU_METHOD 0 0 0 4294967295 ECU_ADDRESS 0x400E1FA4 /end MEASUREMENT
/begin MEASUREMENT MCore_rba_Runtime_MonTask_ast[7].tiMaxResponseT_u32 "" ULONG NO_COMPU_METHOD 0 0 0 4294967295 ECU_ADDRESS 0x400E1FB0 /end MEASUREMENT
/begin MEASUREMENT MCore_rba_Runtime_MonTask_ast[7].tiMinRT_u32 "" ULONG NO_COMPU_METHOD 0 0 0 4294967295 ECU_ADDRESS 0x400E1FA0 /end MEASUREMENT
/begin MEASUREMENT MCore_rba_Runtime_MonTask_ast[7].tiMinResponseT_u32 "" ULONG NO_COMPU_METHOD 0 0 0 4294967295 ECU_ADDRESS 0x400E1FAC /end MEASUREMENT
/begin MEASUREMENT MCore_rba_Runtime_MonTask_ast[8].ctCallsTotal_u32 "" ULONG NO_COMPU_METHOD 0 0 0 4294967295 ECU_ADDRESS 0x400E1FE8 /end MEASUREMENT
/begin MEASUREMENT MCore_rba_Runtime_MonTask_ast[8].ctCalls_u32 "" ULONG NO_COMPU_METHOD 0 0 0 4294967295 ECU_ADDRESS 0x400E1FF0 /end MEASUREMENT
/begin MEASUREMENT MCore_rba_Runtime_MonTask_ast[8].ctSampleProcessed_u8 "" UBYTE NO_COMPU_METHOD 0 0 0 255 ECU_ADDRESS 0x400E2002 /end MEASUREMENT
/begin MEASUREMENT MCore_rba_Runtime_MonTask_ast[8].internal_st "" UBYTE NO_COMPU_METHOD 0 0 0 255 ECU_ADDRESS 0x400E1FF4 /end MEASUREMENT
/begin MEASUREMENT MCore_rba_Runtime_MonTask_ast[8].internal_st.ctBeginCalls_u32 "" ULONG NO_COMPU_METHOD 0 0 0 4294967295 ECU_ADDRESS 0x400E1FF8 /end MEASUREMENT
/begin MEASUREMENT MCore_rba_Runtime_MonTask_ast[8].internal_st.tiAccuRT_u32 "" ULONG NO_COMPU_METHOD 0 0 0 4294967295 ECU_ADDRESS 0x400E1FF4 /end MEASUREMENT
/begin MEASUREMENT MCore_rba_Runtime_MonTask_ast[8].internal_st.tiBeginFree_u32 "" ULONG NO_COMPU_METHOD 0 0 0 4294967295 ECU_ADDRESS 0x400E1FFC /end MEASUREMENT
/begin MEASUREMENT MCore_rba_Runtime_MonTask_ast[8].loadPer64k_u16 "" UWORD NO_COMPU_METHOD 0 0 0 65535 ECU_ADDRESS 0x400E2000 /end MEASUREMENT
/begin MEASUREMENT MCore_rba_Runtime_MonTask_ast[8].tiAvrgRT_u32 "" ULONG NO_COMPU_METHOD 0 0 0 4294967295 ECU_ADDRESS 0x400E1FEC /end MEASUREMENT
/begin MEASUREMENT MCore_rba_Runtime_MonTask_ast[8].tiCurRT_u32 "" ULONG NO_COMPU_METHOD 0 0 0 4294967295 ECU_ADDRESS 0x400E1FD0 /end MEASUREMENT
/begin MEASUREMENT MCore_rba_Runtime_MonTask_ast[8].tiCurResponseT_u32 "" ULONG NO_COMPU_METHOD 0 0 0 4294967295 ECU_ADDRESS 0x400E1FDC /end MEASUREMENT
/begin MEASUREMENT MCore_rba_Runtime_MonTask_ast[8].tiMaxRT_u32 "" ULONG NO_COMPU_METHOD 0 0 0 4294967295 ECU_ADDRESS 0x400E1FD8 /end MEASUREMENT
/begin MEASUREMENT MCore_rba_Runtime_MonTask_ast[8].tiMaxResponseT_u32 "" ULONG NO_COMPU_METHOD 0 0 0 4294967295 ECU_ADDRESS 0x400E1FE4 /end MEASUREMENT
/begin MEASUREMENT MCore_rba_Runtime_MonTask_ast[8].tiMinRT_u32 "" ULONG NO_COMPU_METHOD 0 0 0 4294967295 ECU_ADDRESS 0x400E1FD4 /end MEASUREMENT
/begin MEASUREMENT MCore_rba_Runtime_MonTask_ast[8].tiMinResponseT_u32 "" ULONG NO_COMPU_METHOD 0 0 0 4294967295 ECU_ADDRESS 0x400E1FE0 /end MEASUREMENT
/begin MEASUREMENT MCore_rba_Runtime_idleStamp_au32 "" UBYTE NO_COMPU_METHOD 0 0 0 255 ECU_ADDRESS 0x400E1AC0 /end MEASUREMENT
/begin MEASUREMENT MCore_rba_Runtime_oldFlagValue_au8 "" UBYTE NO_COMPU_METHOD 0 0 0 255 ECU_ADDRESS 0x400E1AC8 /end MEASUREMENT
/begin MEASUREMENT MCore_rba_Runtime_stopWatchStamp_au32 "" UBYTE NO_COMPU_METHOD 0 0 0 255 ECU_ADDRESS 0x400E1AC4 /end MEASUREMENT
/begin MEASUREMENT MCore_VV_MC_MaxCPULoad "" UWORD NO_COMPU_METHOD 0 0 0 65535 ECU_ADDRESS 0x5280A9A4 /end MEASUREMENT
/begin MEASUREMENT MCore_MC_OS_ErrorHook_Counter "" ULONG NO_COMPU_METHOD 0 0 0 4294967295 ECU_ADDRESS 0x52807F44 /end MEASUREMENT
/begin MEASUREMENT MCore_RB_MST_ErrorsReported "" UBYTE NO_COMPU_METHOD 0 0 0 65535 ECU_ADDRESS 0x400A809A /end MEASUREMENT
/begin MEASUREMENT MCore_rb_OSC_Cat2Table "" UBYTE DefaultIdenticalCompu 0 0 0 255.0 ARRAY_SIZE 53 ECU_ADDRESS 0x5280B17C /end MEASUREMENT
/begin MEASUREMENT MCore_rb_OSC_Cat2Table[8].value "" UBYTE NO_COMPU_METHOD 0 0 0 65535 ECU_ADDRESS 0x5280B1BC /end MEASUREMENT
/begin MEASUREMENT MCore_rb_OSC_Cat2Table[8].sc2GndChannelMode "" UBYTE DataType_DataTypeSemantics_osc_Sc2GndChannelMode_type 0 0 0 255 ECU_ADDRESS 0x5280B1BE /end MEASUREMENT
/begin MEASUREMENT MCore_rb_OSC_Cat2Table[8].OLChannelMode "" UBYTE DataType_DataTypeSemantics_osc_OpenLoadChannelMode_type 0 0 0 255 ECU_ADDRESS 0x5280B1BF /end MEASUREMENT
/begin MEASUREMENT MCore_rb_OSC_Cat2Table[8].PdlChannelMode "" UBYTE DataType_DataTypeSemantics_osc_PldChannelMode_type 0 0 0 255 ECU_ADDRESS 0x5280B1C0 /end MEASUREMENT
/begin MEASUREMENT MCore_rb_OSC_Cat2Table[8].funcRequestStatus "" UBYTE DataType_DataTypeSemantics_osc_funcRequestStatus_enum_type 0 0 0 255 ECU_ADDRESS 0x5280B1C1 /end MEASUREMENT
/begin MEASUREMENT MCore_rb_OSC_Cat2Table[8].LightRouterGuardState "" UBYTE NO_COMPU_METHOD 0 0 0 255 ECU_ADDRESS 0x5280B1C2 /end MEASUREMENT
/begin MEASUREMENT MCore_rb_OSC_Cat2Table[41].value "" UBYTE NO_COMPU_METHOD 0 0 0 65535 ECU_ADDRESS 0x5280B2C4 /end MEASUREMENT
/begin MEASUREMENT MCore_rb_OSC_Cat2Table[41].sc2GndChannelMode "" UBYTE DataType_DataTypeSemantics_osc_Sc2GndChannelMode_type 0 0 0 255 ECU_ADDRESS 0x5280B2C6 /end MEASUREMENT
/begin MEASUREMENT MCore_rb_OSC_Cat2Table[41].OLChannelMode "" UBYTE DataType_DataTypeSemantics_osc_OpenLoadChannelMode_type 0 0 0 255 ECU_ADDRESS 0x5280B2C7 /end MEASUREMENT
/begin MEASUREMENT MCore_rb_OSC_Cat2Table[41].PdlChannelMode "" UBYTE DataType_DataTypeSemantics_osc_PldChannelMode_type 0 0 0 255 ECU_ADDRESS 0x5280B2C8 /end MEASUREMENT
/begin MEASUREMENT MCore_rb_OSC_Cat2Table[41].funcRequestStatus "" UBYTE DataType_DataTypeSemantics_osc_funcRequestStatus_enum_type 0 0 0 255 ECU_ADDRESS 0x5280B2C9 /end MEASUREMENT
/begin MEASUREMENT MCore_rb_OSC_Cat2Table[41].LightRouterGuardState "" UBYTE NO_COMPU_METHOD 0 0 0 255 ECU_ADDRESS 0x5280B2CA /end MEASUREMENT
/begin MEASUREMENT MCore_rb_OSC_Cat2Table[46].value "" UBYTE NO_COMPU_METHOD 0 0 0 65535 ECU_ADDRESS 0x5280B2EC /end MEASUREMENT
/begin MEASUREMENT MCore_rb_OSC_Cat2Table[46].sc2GndChannelMode "" UBYTE DataType_DataTypeSemantics_osc_Sc2GndChannelMode_type 0 0 0 255 ECU_ADDRESS 0x5280B2EE /end MEASUREMENT
/begin MEASUREMENT MCore_rb_OSC_Cat2Table[46].OLChannelMode "" UBYTE DataType_DataTypeSemantics_osc_OpenLoadChannelMode_type 0 0 0 255 ECU_ADDRESS 0x5280B2EF /end MEASUREMENT
/begin MEASUREMENT MCore_rb_OSC_Cat2Table[46].PdlChannelMode "" UBYTE DataType_DataTypeSemantics_osc_PldChannelMode_type 0 0 0 255 ECU_ADDRESS 0x5280B2F0 /end MEASUREMENT
/begin MEASUREMENT MCore_rb_OSC_Cat2Table[46].funcRequestStatus "" UBYTE DataType_DataTypeSemantics_osc_funcRequestStatus_enum_type 0 0 0 255 ECU_ADDRESS 0x5280B2F1 /end MEASUREMENT
/begin MEASUREMENT MCore_rb_OSC_Cat2Table[46].LightRouterGuardState "" UBYTE NO_COMPU_METHOD 0 0 0 255 ECU_ADDRESS 0x5280B2F2 /end MEASUREMENT
/begin MEASUREMENT MCore_rb_OSC_Cat2Table[51].value "" UBYTE NO_COMPU_METHOD 0 0 0 65535 ECU_ADDRESS 0x5280B314 /end MEASUREMENT
/begin MEASUREMENT MCore_rb_OSC_Cat2Table[51].sc2GndChannelMode "" UBYTE DataType_DataTypeSemantics_osc_Sc2GndChannelMode_type 0 0 0 255 ECU_ADDRESS 0x5280B316 /end MEASUREMENT
/begin MEASUREMENT MCore_rb_OSC_Cat2Table[51].OLChannelMode "" UBYTE DataType_DataTypeSemantics_osc_OpenLoadChannelMode_type 0 0 0 255 ECU_ADDRESS 0x5280B317 /end MEASUREMENT
/begin MEASUREMENT MCore_rb_OSC_Cat2Table[51].PdlChannelMode "" UBYTE DataType_DataTypeSemantics_osc_PldChannelMode_type 0 0 0 255 ECU_ADDRESS 0x5280B318 /end MEASUREMENT
/begin MEASUREMENT MCore_rb_OSC_Cat2Table[51].funcRequestStatus "" UBYTE DataType_DataTypeSemantics_osc_funcRequestStatus_enum_type 0 0 0 255 ECU_ADDRESS 0x5280B319 /end MEASUREMENT
/begin MEASUREMENT MCore_rb_OSC_Cat2Table[51].LightRouterGuardState "" UBYTE NO_COMPU_METHOD 0 0 0 255 ECU_ADDRESS 0x5280B31A /end MEASUREMENT
/begin MEASUREMENT MCore_rb_RemainingStack_MCore_in_bytes "" UWORD NO_COMPU_METHOD 0 0 0 65535 ECU_ADDRESS 0x5280CA54 /end MEASUREMENT
/begin MEASUREMENT MCore_rb_StackSize_MCore_in_bytes "" UWORD NO_COMPU_METHOD 0 0 0 65535 ECU_ADDRESS 0x5280CA56 /end MEASUREMENT
/begin MEASUREMENT MCore_rb_SipF_ProcessImage.Cat1 "" UBYTE NO_COMPU_METHOD 0 0 0 255 ECU_ADDRESS 0x400DF1BC /end MEASUREMENT
/begin MEASUREMENT MCore_rb_SipF_ProcessImage.Cat1[0].debCounter "" UWORD NO_COMPU_METHOD 0 0 0 65535 ECU_ADDRESS 0x400DF1C4 /end MEASUREMENT
/begin MEASUREMENT MCore_rb_SipF_ProcessImage.Cat1[0].debounced "" UWORD NO_COMPU_METHOD 0 0 0 65535 ECU_ADDRESS 0x400DF1C2 /end MEASUREMENT
/begin MEASUREMENT MCore_rb_SipF_ProcessImage.Cat1[0].discrete "" UWORD NO_COMPU_METHOD 0 0 0 65535 ECU_ADDRESS 0x400DF1BE /end MEASUREMENT
/begin MEASUREMENT MCore_rb_SipF_ProcessImage.Cat1[0].discreteOld "" UWORD NO_COMPU_METHOD 0 0 0 65535 ECU_ADDRESS 0x400DF1C0 /end MEASUREMENT
/begin MEASUREMENT MCore_rb_SipF_ProcessImage.Cat1[0].processed "" UWORD NO_COMPU_METHOD 0 0 0 65535 ECU_ADDRESS 0x400DF1C6 /end MEASUREMENT
/begin MEASUREMENT MCore_rb_SipF_ProcessImage.Cat1[0].snapshot "" UWORD NO_COMPU_METHOD 0 0 0 65535 ECU_ADDRESS 0x400DF1BC /end MEASUREMENT
/begin MEASUREMENT MCore_rb_SipF_ProcessImage.Cat1[0].switches "" UBYTE NO_COMPU_METHOD 0 0 0 255 ECU_ADDRESS 0x400DF1C8 /end MEASUREMENT
/begin MEASUREMENT MCore_rb_SipF_ProcessImage.Cat1[0].switches.mcalInputDisconnect "" SBYTE rb_SipF_ProcessImage.Cat1[0].switches.mcalInputDisconnect.CONVERSION 0 0 -128 127 ECU_ADDRESS 0x400DF1C8 /end MEASUREMENT
/begin MEASUREMENT MCore_rb_SipF_ProcessImage.Cat1[0].switches.sipfInputDisconnect "" SBYTE rb_SipF_ProcessImage.Cat1[0].switches.sipfInputDisconnect.CONVERSION 0 0 -128 127 ECU_ADDRESS 0x400DF1C9 /end MEASUREMENT
/begin MEASUREMENT MCore_rb_SipF_ProcessImage.Cat1[10].debCounter "" UWORD NO_COMPU_METHOD 0 0 0 65535 ECU_ADDRESS 0x400DF250 /end MEASUREMENT
/begin MEASUREMENT MCore_rb_SipF_ProcessImage.Cat1[10].debounced "" UWORD NO_COMPU_METHOD 0 0 0 65535 ECU_ADDRESS 0x400DF24E /end MEASUREMENT
/begin MEASUREMENT MCore_rb_SipF_ProcessImage.Cat1[10].discrete "" UWORD NO_COMPU_METHOD 0 0 0 65535 ECU_ADDRESS 0x400DF24A /end MEASUREMENT
/begin MEASUREMENT MCore_rb_SipF_ProcessImage.Cat1[10].discreteOld "" UWORD NO_COMPU_METHOD 0 0 0 65535 ECU_ADDRESS 0x400DF24C /end MEASUREMENT
/begin MEASUREMENT MCore_rb_SipF_ProcessImage.Cat1[10].processed "" UWORD NO_COMPU_METHOD 0 0 0 65535 ECU_ADDRESS 0x400DF252 /end MEASUREMENT
/begin MEASUREMENT MCore_rb_SipF_ProcessImage.Cat1[10].snapshot "" UWORD NO_COMPU_METHOD 0 0 0 65535 ECU_ADDRESS 0x400DF248 /end MEASUREMENT
/begin MEASUREMENT MCore_rb_SipF_ProcessImage.Cat1[10].switches "" UBYTE NO_COMPU_METHOD 0 0 0 255 ECU_ADDRESS 0x400DF254 /end MEASUREMENT
/begin MEASUREMENT MCore_rb_SipF_ProcessImage.Cat1[10].switches.mcalInputDisconnect "" SBYTE rb_SipF_ProcessImage.Cat1[10].switches.mcalInputDisconnect.CONVERSION 0 0 -128 127 ECU_ADDRESS 0x400DF254 /end MEASUREMENT
/begin MEASUREMENT MCore_rb_SipF_ProcessImage.Cat1[10].switches.sipfInputDisconnect "" SBYTE rb_SipF_ProcessImage.Cat1[10].switches.sipfInputDisconnect.CONVERSION 0 0 -128 127 ECU_ADDRESS 0x400DF255 /end MEASUREMENT
/begin MEASUREMENT MCore_rb_SipF_ProcessImage.Cat1[11].debCounter "" UWORD NO_COMPU_METHOD 0 0 0 65535 ECU_ADDRESS 0x400DF25E /end MEASUREMENT
/begin MEASUREMENT MCore_rb_SipF_ProcessImage.Cat1[11].debounced "" UWORD NO_COMPU_METHOD 0 0 0 65535 ECU_ADDRESS 0x400DF25C /end MEASUREMENT
/begin MEASUREMENT MCore_rb_SipF_ProcessImage.Cat1[11].discrete "" UWORD NO_COMPU_METHOD 0 0 0 65535 ECU_ADDRESS 0x400DF258 /end MEASUREMENT
/begin MEASUREMENT MCore_rb_SipF_ProcessImage.Cat1[11].discreteOld "" UWORD NO_COMPU_METHOD 0 0 0 65535 ECU_ADDRESS 0x400DF25A /end MEASUREMENT
/begin MEASUREMENT MCore_rb_SipF_ProcessImage.Cat1[11].processed "" UWORD NO_COMPU_METHOD 0 0 0 65535 ECU_ADDRESS 0x400DF260 /end MEASUREMENT
/begin MEASUREMENT MCore_rb_SipF_ProcessImage.Cat1[11].snapshot "" UWORD NO_COMPU_METHOD 0 0 0 65535 ECU_ADDRESS 0x400DF256 /end MEASUREMENT
/begin MEASUREMENT MCore_rb_SipF_ProcessImage.Cat1[11].switches "" UBYTE NO_COMPU_METHOD 0 0 0 255 ECU_ADDRESS 0x400DF262 /end MEASUREMENT
/begin MEASUREMENT MCore_rb_SipF_ProcessImage.Cat1[11].switches.mcalInputDisconnect "" SBYTE rb_SipF_ProcessImage.Cat1[11].switches.mcalInputDisconnect.CONVERSION 0 0 -128 127 ECU_ADDRESS 0x400DF262 /end MEASUREMENT
/begin MEASUREMENT MCore_rb_SipF_ProcessImage.Cat1[11].switches.sipfInputDisconnect "" SBYTE rb_SipF_ProcessImage.Cat1[11].switches.sipfInputDisconnect.CONVERSION 0 0 -128 127 ECU_ADDRESS 0x400DF263 /end MEASUREMENT
/begin MEASUREMENT MCore_rb_SipF_ProcessImage.Cat1[12].debCounter "" UWORD NO_COMPU_METHOD 0 0 0 65535 ECU_ADDRESS 0x400DF26C /end MEASUREMENT
/begin MEASUREMENT MCore_rb_SipF_ProcessImage.Cat1[12].debounced "" UWORD NO_COMPU_METHOD 0 0 0 65535 ECU_ADDRESS 0x400DF26A /end MEASUREMENT
/begin MEASUREMENT MCore_rb_SipF_ProcessImage.Cat1[12].discrete "" UWORD NO_COMPU_METHOD 0 0 0 65535 ECU_ADDRESS 0x400DF266 /end MEASUREMENT
/begin MEASUREMENT MCore_rb_SipF_ProcessImage.Cat1[12].discreteOld "" UWORD NO_COMPU_METHOD 0 0 0 65535 ECU_ADDRESS 0x400DF268 /end MEASUREMENT
/begin MEASUREMENT MCore_rb_SipF_ProcessImage.Cat1[12].processed "" UWORD NO_COMPU_METHOD 0 0 0 65535 ECU_ADDRESS 0x400DF26E /end MEASUREMENT
/begin MEASUREMENT MCore_rb_SipF_ProcessImage.Cat1[12].snapshot "" UWORD NO_COMPU_METHOD 0 0 0 65535 ECU_ADDRESS 0x400DF264 /end MEASUREMENT
/begin MEASUREMENT MCore_rb_SipF_ProcessImage.Cat1[12].switches "" UBYTE NO_COMPU_METHOD 0 0 0 255 ECU_ADDRESS 0x400DF270 /end MEASUREMENT
/begin MEASUREMENT MCore_rb_SipF_ProcessImage.Cat1[12].switches.mcalInputDisconnect "" SBYTE rb_SipF_ProcessImage.Cat1[12].switches.mcalInputDisconnect.CONVERSION 0 0 -128 127 ECU_ADDRESS 0x400DF270 /end MEASUREMENT
/begin MEASUREMENT MCore_rb_SipF_ProcessImage.Cat1[12].switches.sipfInputDisconnect "" SBYTE rb_SipF_ProcessImage.Cat1[12].switches.sipfInputDisconnect.CONVERSION 0 0 -128 127 ECU_ADDRESS 0x400DF271 /end MEASUREMENT
/begin MEASUREMENT MCore_rb_SipF_ProcessImage.Cat1[13].debCounter "" UWORD NO_COMPU_METHOD 0 0 0 65535 ECU_ADDRESS 0x400DF27A /end MEASUREMENT
/begin MEASUREMENT MCore_rb_SipF_ProcessImage.Cat1[13].debounced "" UWORD NO_COMPU_METHOD 0 0 0 65535 ECU_ADDRESS 0x400DF278 /end MEASUREMENT
/begin MEASUREMENT MCore_rb_SipF_ProcessImage.Cat1[13].discrete "" UWORD NO_COMPU_METHOD 0 0 0 65535 ECU_ADDRESS 0x400DF274 /end MEASUREMENT
/begin MEASUREMENT MCore_rb_SipF_ProcessImage.Cat1[13].discreteOld "" UWORD NO_COMPU_METHOD 0 0 0 65535 ECU_ADDRESS 0x400DF276 /end MEASUREMENT
/begin MEASUREMENT MCore_rb_SipF_ProcessImage.Cat1[13].processed "" UWORD NO_COMPU_METHOD 0 0 0 65535 ECU_ADDRESS 0x400DF27C /end MEASUREMENT
/begin MEASUREMENT MCore_rb_SipF_ProcessImage.Cat1[13].snapshot "" UWORD NO_COMPU_METHOD 0 0 0 65535 ECU_ADDRESS 0x400DF272 /end MEASUREMENT
/begin MEASUREMENT MCore_rb_SipF_ProcessImage.Cat1[13].switches "" UBYTE NO_COMPU_METHOD 0 0 0 255 ECU_ADDRESS 0x400DF27E /end MEASUREMENT
/begin MEASUREMENT MCore_rb_SipF_ProcessImage.Cat1[13].switches.mcalInputDisconnect "" SBYTE rb_SipF_ProcessImage.Cat1[13].switches.mcalInputDisconnect.CONVERSION 0 0 -128 127 ECU_ADDRESS 0x400DF27E /end MEASUREMENT
/begin MEASUREMENT MCore_rb_SipF_ProcessImage.Cat1[13].switches.sipfInputDisconnect "" SBYTE rb_SipF_ProcessImage.Cat1[13].switches.sipfInputDisconnect.CONVERSION 0 0 -128 127 ECU_ADDRESS 0x400DF27F /end MEASUREMENT
/begin MEASUREMENT MCore_rb_SipF_ProcessImage.Cat1[14].debCounter "" UWORD NO_COMPU_METHOD 0 0 0 65535 ECU_ADDRESS 0x400DF288 /end MEASUREMENT
/begin MEASUREMENT MCore_rb_SipF_ProcessImage.Cat1[14].debounced "" UWORD NO_COMPU_METHOD 0 0 0 65535 ECU_ADDRESS 0x400DF286 /end MEASUREMENT
/begin MEASUREMENT MCore_rb_SipF_ProcessImage.Cat1[14].discrete "" UWORD NO_COMPU_METHOD 0 0 0 65535 ECU_ADDRESS 0x400DF282 /end MEASUREMENT
/begin MEASUREMENT MCore_rb_SipF_ProcessImage.Cat1[14].discreteOld "" UWORD NO_COMPU_METHOD 0 0 0 65535 ECU_ADDRESS 0x400DF284 /end MEASUREMENT
/begin MEASUREMENT MCore_rb_SipF_ProcessImage.Cat1[14].processed "" UWORD NO_COMPU_METHOD 0 0 0 65535 ECU_ADDRESS 0x400DF28A /end MEASUREMENT
/begin MEASUREMENT MCore_rb_SipF_ProcessImage.Cat1[14].snapshot "" UWORD NO_COMPU_METHOD 0 0 0 65535 ECU_ADDRESS 0x400DF280 /end MEASUREMENT
/begin MEASUREMENT MCore_rb_SipF_ProcessImage.Cat1[14].switches "" UBYTE NO_COMPU_METHOD 0 0 0 255 ECU_ADDRESS 0x400DF28C /end MEASUREMENT
/begin MEASUREMENT MCore_rb_SipF_ProcessImage.Cat1[14].switches.mcalInputDisconnect "" SBYTE rb_SipF_ProcessImage.Cat1[14].switches.mcalInputDisconnect.CONVERSION 0 0 -128 127 ECU_ADDRESS 0x400DF28C /end MEASUREMENT
/begin MEASUREMENT MCore_rb_SipF_ProcessImage.Cat1[14].switches.sipfInputDisconnect "" SBYTE rb_SipF_ProcessImage.Cat1[14].switches.sipfInputDisconnect.CONVERSION 0 0 -128 127 ECU_ADDRESS 0x400DF28D /end MEASUREMENT
/begin MEASUREMENT MCore_rb_SipF_ProcessImage.Cat1[15].debCounter "" UWORD NO_COMPU_METHOD 0 0 0 65535 ECU_ADDRESS 0x400DF296 /end MEASUREMENT
/begin MEASUREMENT MCore_rb_SipF_ProcessImage.Cat1[15].debounced "" UWORD NO_COMPU_METHOD 0 0 0 65535 ECU_ADDRESS 0x400DF294 /end MEASUREMENT
/begin MEASUREMENT MCore_rb_SipF_ProcessImage.Cat1[15].discrete "" UWORD NO_COMPU_METHOD 0 0 0 65535 ECU_ADDRESS 0x400DF290 /end MEASUREMENT
/begin MEASUREMENT MCore_rb_SipF_ProcessImage.Cat1[15].discreteOld "" UWORD NO_COMPU_METHOD 0 0 0 65535 ECU_ADDRESS 0x400DF292 /end MEASUREMENT
/begin MEASUREMENT MCore_rb_SipF_ProcessImage.Cat1[15].processed "" UWORD NO_COMPU_METHOD 0 0 0 65535 ECU_ADDRESS 0x400DF298 /end MEASUREMENT
/begin MEASUREMENT MCore_rb_SipF_ProcessImage.Cat1[15].snapshot "" UWORD NO_COMPU_METHOD 0 0 0 65535 ECU_ADDRESS 0x400DF28E /end MEASUREMENT
/begin MEASUREMENT MCore_rb_SipF_ProcessImage.Cat1[15].switches "" UBYTE NO_COMPU_METHOD 0 0 0 255 ECU_ADDRESS 0x400DF29A /end MEASUREMENT
/begin MEASUREMENT MCore_rb_SipF_ProcessImage.Cat1[15].switches.mcalInputDisconnect "" SBYTE rb_SipF_ProcessImage.Cat1[15].switches.mcalInputDisconnect.CONVERSION 0 0 -128 127 ECU_ADDRESS 0x400DF29A /end MEASUREMENT
/begin MEASUREMENT MCore_rb_SipF_ProcessImage.Cat1[15].switches.sipfInputDisconnect "" SBYTE rb_SipF_ProcessImage.Cat1[15].switches.sipfInputDisconnect.CONVERSION 0 0 -128 127 ECU_ADDRESS 0x400DF29B /end MEASUREMENT
/begin MEASUREMENT MCore_rb_SipF_ProcessImage.Cat1[16].debCounter "" UWORD NO_COMPU_METHOD 0 0 0 65535 ECU_ADDRESS 0x400DF2A4 /end MEASUREMENT
/begin MEASUREMENT MCore_rb_SipF_ProcessImage.Cat1[16].debounced "" UWORD NO_COMPU_METHOD 0 0 0 65535 ECU_ADDRESS 0x400DF2A2 /end MEASUREMENT
/begin MEASUREMENT MCore_rb_SipF_ProcessImage.Cat1[16].discrete "" UWORD NO_COMPU_METHOD 0 0 0 65535 ECU_ADDRESS 0x400DF29E /end MEASUREMENT
/begin MEASUREMENT MCore_rb_SipF_ProcessImage.Cat1[16].discreteOld "" UWORD NO_COMPU_METHOD 0 0 0 65535 ECU_ADDRESS 0x400DF2A0 /end MEASUREMENT
/begin MEASUREMENT MCore_rb_SipF_ProcessImage.Cat1[16].processed "" UWORD NO_COMPU_METHOD 0 0 0 65535 ECU_ADDRESS 0x400DF2A6 /end MEASUREMENT
/begin COMPU_METHOD Methods_boolean "" TAB_VERB "%10.5" "" COMPU_TAB_REF Methods_boolean /end COMPU_METHOD
/begin COMPU_METHOD VW_BCM_CompuMethods_SC_F1_O0_UNoUnit "" RAT_FUNC "%10.5" "" COEFFS 0.0 -1.0 0.0 0.0 0.0 -1.0 /end COMPU_METHOD
/begin COMPU_METHOD VW_BCM_CompuMethods_SC_F1_O0_USec "" RAT_FUNC "%10.5" "" COEFFS 0.0 -1.0 0.0 0.0 0.0 -1.0 /end COMPU_METHOD
/begin COMPU_METHOD VW_BCM_CompuMethods_CM_TXTenErrStatus "" TAB_VERB "%10.5" "" COMPU_TAB_REF VW_BCM_CompuMethods_CM_TXTenErrStatus /end COMPU_METHOD
/begin COMPU_METHOD VW_BCM_CompuMethods_SC_F0pt1_O0_UVolt "" RAT_FUNC "%10.5" "" COEFFS 0.0 -1.0 0.0 0.0 0.0 -0.1 /end COMPU_METHOD
/begin COMPU_METHOD VF301_CompuMethod_CM_HatchSts "" TAB_VERB "%10.5" "" COMPU_TAB_REF VF301_CompuMethod_CM_HatchSts /end COMPU_METHOD
/begin COMPU_METHOD VF301_CompuMethod_CM_TrunkFOBSearchRequest "" TAB_VERB "%10.5" "" COMPU_TAB_REF VF301_CompuMethod_CM_TrunkFOBSearchRequest /end COMPU_METHOD
/begin COMPU_METHOD VF506_DataType_DataTypeSemantics_CM_BCANAutoStopFailSts "" TAB_VERB "%10.5" "" COMPU_TAB_REF VF506_DataType_DataTypeSemantics_CM_BCANAutoStopFailSts /end COMPU_METHOD
/begin COMPU_METHOD VF834_CompuMethod_CM_HornActivation "" TAB_VERB "%10.5" "" COMPU_TAB_REF VF834_CompuMethod_CM_HornActivation /end COMPU_METHOD
/begin COMPU_METHOD CompuMethods_boolean "" TAB_VERB "%10.5" "" COMPU_TAB_REF CompuMethods_boolean /end COMPU_METHOD
/begin COMPU_METHOD VW_BCM_CompuMethods_SC_F0pt001_O0_UVolt "" RAT_FUNC "%10.5" "" COEFFS 0.0 -1.0 0.0 0.0 0.0 -0.001 /end COMPU_METHOD
/begin COMPU_METHOD VW_BCM_CompuMethods_CM_TXTenUKl30LErrSt "" TAB_VERB "%10.5" "" COMPU_TAB_REF VW_BCM_CompuMethods_CM_TXTenUKl30LErrSt /end COMPU_METHOD
/begin COMPU_METHOD VW_BCM_CompuMethods_CM_TXTenUKl30PErrSt "" TAB_VERB "%10.5" "" COMPU_TAB_REF VW_BCM_CompuMethods_CM_TXTenUKl30PErrSt /end COMPU_METHOD
/begin COMPU_METHOD VW_BCM_CompuMethods_CM_TXTenUKl30RErrSt "" TAB_VERB "%10.5" "" COMPU_TAB_REF VW_BCM_CompuMethods_CM_TXTenUKl30RErrSt /end COMPU_METHOD
/begin COMPU_METHOD VW_BCM_CompuMethods_SC_F1_O0_UMiliVolt "" RAT_FUNC "%10.5" "" COEFFS 0.0 -1.0 0.0 0.0 0.0 -1.0 REF_UNIT VW_BCM_Units_MiliVolt /end COMPU_METHOD
/begin COMPU_METHOD VW_BCM_CompuMethods_SC_F0pt000030517578125_O0_UNoUnit "" RAT_FUNC "%10.5" "" COEFFS 0.0 -1.0 0.0 0.0 0.0 -3.0517578125E-5 /end COMPU_METHOD
/begin COMPU_METHOD DataType_DataTypeSemantics_DT_DriverFrontWindowDown "" TAB_VERB "%10.5" "" COMPU_TAB_REF DataType_DataTypeSemantics_DT_DriverFrontWindowDown /end COMPU_METHOD
/begin COMPU_METHOD DataType_DataTypeSemantics_DT_DriverFrontWindowUp "" TAB_VERB "%10.5" "" COMPU_TAB_REF DataType_DataTypeSemantics_DT_DriverFrontWindowUp /end COMPU_METHOD
/begin COMPU_METHOD DataType_DataTypeSemantics_DT_ExternalLuggageCntrl "" TAB_VERB "%10.5" "" COMPU_TAB_REF DataType_DataTypeSemantics_DT_ExternalLuggageCntrl /end COMPU_METHOD
/begin COMPU_METHOD DataType_DataTypeSemantics_DT_LuggageCntrl "" TAB_VERB "%10.5" "" COMPU_TAB_REF DataType_DataTypeSemantics_DT_LuggageCntrl /end COMPU_METHOD
/begin COMPU_METHOD DataType_DataTypeSemantics_DT_PsngrFrontWindowDown "" TAB_VERB "%10.5" "" COMPU_TAB_REF DataType_DataTypeSemantics_DT_PsngrFrontWindowDown /end COMPU_METHOD
/begin COMPU_METHOD DataType_DataTypeSemantics_DT_PsngrFrontWindowUp "" TAB_VERB "%10.5" "" COMPU_TAB_REF DataType_DataTypeSemantics_DT_PsngrFrontWindowUp /end COMPU_METHOD
/begin COMPU_METHOD VW_BCM_CompuMethods_SC_F1_O0_UKiloOhm "" RAT_FUNC "%10.5" "" COEFFS 0.0 -1.0 0.0 0.0 0.0 -1.0 REF_UNIT VW_BCM_Units_KiloOhm /end COMPU_METHOD
/begin COMPU_METHOD VW_BCM_CompuMethods_SC_F0pt00390625_O0_UDegCgrd "" RAT_FUNC "%10.5" "" COEFFS 0.0 -1.0 0.0 0.0 0.0 -0.00390625 /end COMPU_METHOD
/begin COMPU_METHOD VW_BCM_CompuMethods_CM_TXTenSensorversorgungStatus "" TAB_VERB "%10.5" "" COMPU_TAB_REF VW_BCM_CompuMethods_CM_TXTenSensorversorgungStatus /end COMPU_METHOD
/begin COMPU_METHOD VW_BCM_CompuMethods_SC_F1_O0_UPerc "" RAT_FUNC "%10.5" "" COEFFS 0.0 -1.0 0.0 0.0 0.0 -1.0 /end COMPU_METHOD
/begin COMPU_METHOD DefaultIdenticalCompu "" RAT_FUNC "%10.5" "" COEFFS 0.0 1.0 0.0 0.0 0.0 1.0 /end COMPU_METHOD
/begin COMPU_METHOD ComM_ModeType "" TAB_VERB "%12.6" "" COMPU_TAB_REF CONV_TAB_ComM_ModeType /end COMPU_METHOD
/begin COMPU_METHOD SC_F0pt01_O0_Ukmh "" RAT_FUNC "%6.2" "km/h" COEFFS 0 1 0 0 0 0.01 /end COMPU_METHOD
/begin COMPU_METHOD VOID_SCALING "Void scaling for unscaled variables" RAT_FUNC "%3.0" "" COEFFS 0 1 0 0 0 1 /end COMPU_METHOD
/begin COMPU_METHOD VOID_SCALING_a "Void scaling for unscaled variables" RAT_FUNC "%1.0" "" COEFFS 0 1 0 0 0 1 /end COMPU_METHOD
/begin COMPU_METHOD VOID_SCALING_b "Void scaling for unscaled variables" RAT_FUNC "%5.0" "" COEFFS 0 1 0 0 0 1 /end COMPU_METHOD
/begin COMPU_METHOD EQ_LSB_1 "" RAT_FUNC "%1.0" "V" COEFFS 0 1 0 0 0 1 /end COMPU_METHOD
/begin COMPU_METHOD EQ_LSB_1_b "" RAT_FUNC "%1.0" "km/h" COEFFS 0 1 0 0 0 1 /end COMPU_METHOD
/begin COMPU_METHOD VOID_SCALING_c "Void scaling for unscaled variables" RAT_FUNC "%10.0" "" COEFFS 0 1 0 0 0 1 /end COMPU_METHOD
/begin COMPU_METHOD VOID_SCALING_d "Void scaling for unscaled variables" RAT_FUNC "%5.0" "" COEFFS 0 1 0 0 0 1 /end COMPU_METHOD
/begin COMPU_METHOD DataType_DataTypeSemantics_CM_StateOfAlarmSystem "" TAB_VERB "%10.5" "" COMPU_TAB_REF DataType_DataTypeSemantics_CM_StateOfAlarmSystem /end COMPU_METHOD
/begin COMPU_METHOD DataType_DataTypeSemantics_DT_VERS_BcmSts "" TAB_VERB "%10.5" "" COMPU_TAB_REF DataType_DataTypeSemantics_DT_VERS_BcmSts /end COMPU_METHOD
/begin COMPU_METHOD DataType_DataTypeSemantics_DT_VF087_TransponderAuthenticationReq "" TAB_VERB "%10.5" "" COMPU_TAB_REF DataType_DataTypeSemantics_DT_VF087_TransponderAuthenticationReq /end COMPU_METHOD
/begin COMPU_METHOD rb_RxE2E_State_enumTag "enumeration table" TAB_VERB "" "" COMPU_TAB_REF rb_RxE2E_State_enumTag /end COMPU_METHOD
/begin COMPU_METHOD DataType_DataTypeSemantics_osc_Sc2GndChannelMode_type "" TAB_VERB "%10.5" "" COMPU_TAB_REF DataType_DataTypeSemantics_osc_Sc2GndChannelMode_type /end COMPU_METHOD
/begin COMPU_METHOD DataType_DataTypeSemantics_osc_OpenLoadChannelMode_type "" TAB_VERB "%10.5" "" COMPU_TAB_REF DataType_DataTypeSemantics_osc_OpenLoadChannelMode_type /end COMPU_METHOD
/begin COMPU_METHOD DataType_DataTypeSemantics_osc_PldChannelMode_type "" TAB_VERB "%10.5" "" COMPU_TAB_REF DataType_DataTypeSemantics_osc_PldChannelMode_type /end COMPU_METHOD
/begin COMPU_METHOD DataType_DataTypeSemantics_osc_funcRequestStatus_enum_type "" TAB_VERB "%10.5" "" COMPU_TAB_REF DataType_DataTypeSemantics_osc_funcRequestStatus_enum_type /end COMPU_METHOD
/begin UNIT VW_BCM_Units_MiliVolt "" "" EXTENDED_SI /end UNIT
/begin UNIT VW_BCM_Units_KiloOhm "" "" EXTENDED_SI SI_EXPONENTS 2 1 -3 -2 0 0 0 /end UNIT
/begin COMPU_VTAB Methods_boolean "" TAB_VERB 2 0 "FALSE" 1 "TRUE" /end COMPU_VTAB
/begin COMPU_VTAB VW_BCM_CompuMethods_CM_TXTenErrStatus "" TAB_VERB 4 0 "Ok" 1 "Fehler" 2 "Init" 3 "No_Monitoring" /end COMPU_VTAB
/begin COMPU_VTAB VF301_CompuMethod_CM_HatchSts "" TAB_VERB 2 0 "VF301_HatchSts_CLOSED" 1 "VF301_HatchSts_OPEN" /end COMPU_VTAB
/begin COMPU_VTAB VF301_CompuMethod_CM_TrunkFOBSearchRequest "" TAB_VERB 3 0 "VF301_FOB_Cx0_NoAction" 1 "VF301_FOB_Cx1_Research" 2 "VF301_FOB_Cx2_Result_Received" /end COMPU_VTAB
/begin COMPU_VTAB VF506_DataType_DataTypeSemantics_CM_BCANAutoStopFailSts "" TAB_VERB 16 0 "Cx0_No_fail" 1 "Cx1_NCL_fail" 2 "Cx2_NQS_fail" 3 "Cx3_NQS_NCL_fail" 4 "Cx4_NCP_fail" 5 "Cx5_NCP_NCL_fail" 6 "Cx6_NCP_NQS_fail" 7 "Cx7_NCP_NQS_NCL_fail" 8 "Cx8_NBC_fail" 9 "Cx9_NBC_NCL_fail" 10 "CxA_NBC_NQS_fail" 11 "CxB_NBC_NQS_NCL_fail" 12 "CxC_NBC_NCP_fail" 13 "CxD_NBC_NCP_NCL_fail" 14 "CxE_NBC_NCP_NQS_fail" 15 "CxF_NBC_NCP_NQS_NCL_fail" /end COMPU_VTAB
/begin COMPU_VTAB VF834_CompuMethod_CM_HornActivation "" TAB_VERB 2 0 "VF834_NOT_ACTIVE" 1 "VF834_ACTIVE" /end COMPU_VTAB
/begin COMPU_VTAB CompuMethods_boolean "" TAB_VERB 2 0 "FALSE" 1 "TRUE" /end COMPU_VTAB
/begin COMPU_VTAB VW_BCM_CompuMethods_CM_TXTenUKl30LErrSt "" TAB_VERB 4 0 "Ok" 1 "Fehler" 2 "Init" 3 "No_Monitoring" /end COMPU_VTAB
/begin COMPU_VTAB VW_BCM_CompuMethods_CM_TXTenUKl30PErrSt "" TAB_VERB 4 0 "Ok" 1 "Fehler" 2 "Init" 3 "No_Monitoring" /end COMPU_VTAB
/begin COMPU_VTAB VW_BCM_CompuMethods_CM_TXTenUKl30RErrSt "" TAB_VERB 4 0 "Ok" 1 "Fehler" 2 "Init" 3 "No_Monitoring" /end COMPU_VTAB
/begin COMPU_VTAB DataType_DataTypeSemantics_DT_DriverFrontWindowDown "" TAB_VERB 4 0 "VF104_SWITCH_OC" 0 "VF104_SWITCH_SC" 1 "VF104_SWITCH_ACTV" 2 "VF104_SWITCH_IDLE" /end COMPU_VTAB
/begin COMPU_VTAB DataType_DataTypeSemantics_DT_DriverFrontWindowUp "" TAB_VERB 4 1 "VF104_SWITCH_ACTV" 2 "VF104_SWITCH_IDLE" 0 "VF104_SWITCH_OC" 0 "VF104_SWITCH_SC" /end COMPU_VTAB
/begin COMPU_VTAB DataType_DataTypeSemantics_DT_ExternalLuggageCntrl "" TAB_VERB 2 2 "VF099_EXTERNAL_LUG_BUTTON_RELEASED" 1 "VF099_EXTERNAL_LUG_BUTTON_PRESSED" /end COMPU_VTAB
/begin COMPU_VTAB DataType_DataTypeSemantics_DT_LuggageCntrl "" TAB_VERB 2 2 "VF099_LUG_BUTTON_RELEASED" 1 "VF099_LUG_BUTTON_PRESSED" /end COMPU_VTAB
/begin COMPU_VTAB DataType_DataTypeSemantics_DT_PsngrFrontWindowDown "" TAB_VERB 4 1 "VF104_SWITCH_ACTV" 2 "VF104_SWITCH_IDLE" 0 "VF104_SWITCH_OC" 0 "VF104_SWITCH_SC" /end COMPU_VTAB
/begin COMPU_VTAB DataType_DataTypeSemantics_DT_PsngrFrontWindowUp "" TAB_VERB 4 1 "VF104_SWITCH_ACTV" 2 "VF104_SWITCH_IDLE" 0 "VF104_SWITCH_OC" 0 "VF104_SWITCH_SC" /end COMPU_VTAB
/begin COMPU_VTAB VW_BCM_CompuMethods_CM_TXTenSensorversorgungStatus "" TAB_VERB 4 0 "SensorversorgungStatus_Unknown" 1 "SensorversorgungStatus_Normalspannung" 2 "SensorversorgungStatus_Unterspannung" 3 "SensorversorgungStatus_Ueberspannung" /end COMPU_VTAB
/begin COMPU_VTAB CONV_TAB_ComM_ModeType "Conversion table" TAB_VERB 3 0 "COMM_NO_COMMUNICATION" 1 "COMM_SILENT_COMMUNICATION" 2 "COMM_FULL_COMMUNICATION" /end COMPU_VTAB
/begin COMPU_VTAB DataType_DataTypeSemantics_CM_StateOfAlarmSystem "" TAB_VERB 9 0 "Cx0_Alarm_OFF" 1 "Cx1_Alarm_IDLE" 2 "Cx2_Alarm_ARMING" 3 "Cx3_Alarm_SURVEILLANCE" 4 "Cx4_Alarm_ACTIVE" 5 "Cx5_Alarm_DISARMING" 6 "Cx6_Alarm_DEACTIVATED" 7 "Cx7_Alarm_SERVICE" 8 "Cx8_Alarm_PROGRAMMING" /end COMPU_VTAB
/begin COMPU_VTAB DataType_DataTypeSemantics_DT_VERS_BcmSts "" TAB_VERB 2 0 "VERS_BCM_PROGRAMMED" 1 "VERS_BCM_VIRGIN" /end COMPU_VTAB
/begin COMPU_VTAB DataType_DataTypeSemantics_DT_VF087_TransponderAuthenticationReq "" TAB_VERB 16 0 "Cx0_Transponder_Not_Authenticated" 1 "Cx1_Transponder_1_Authenticated" 2 "Cx2_Transponder_2_Authenticated" 3 "Cx3_Transponder_3_Authenticated" 4 "Cx4_Transponder_4_Authenticated" 5 "Cx5_Transponder_5_Authenticated" 6 "Cx6_Transponder_6_Authenticated" 7 "Cx7_Transponder_7_Authenticated" 8 "Cx8_Transponder_8_Authenticated" 9 "Cx9_Transponder_9_Authenticated" 10 "CxA_Transponder_10_Authenticated" 11 "CxB_Transponder_11_Authenticated" 12 "CxC_Transponder_12_Authenticated" 13 "CxD_Transponder_13_Authenticated" 14 "CxE_Transponder_14_Authenticated" 15 "CxF_Transponder_15_Authenticated" /end COMPU_VTAB
/begin COMPU_VTAB DataType_DataTypeSemantics_osc_Sc2GndChannelMode_type "" TAB_VERB 7 0 "OSC_Sc2Gnd_Unknown_MODE" 1 "OSC_Sc2Gnd_NORMAL_MODE" 2 "OSC_Sc2Gnd_DEBOUNCE_ERR_MODE" 3 "OSC_Sc2Gnd_DEBOUNCE_FOLLOWING_ERR_MODE" 4 "OSC_Sc2Gnd_SHUTOFF_MODE" 5 "OSC_Sc2Gnd_ERROR_DETCETD_LAST_ACT_CYCLE" 6 "OSC_Sc2Gnd_TEMP_OVERLOAD" /end COMPU_VTAB
/begin COMPU_VTAB DataType_DataTypeSemantics_osc_OpenLoadChannelMode_type "" TAB_VERB 3 0 "OSC_OL_NoError_MODE" 1 "OSC_OL_Error_MODE" 2 "OSC_OL_Unknown_MODE" /end COMPU_VTAB
/begin COMPU_VTAB DataType_DataTypeSemantics_osc_PldChannelMode_type "" TAB_VERB 3 0 "OSC_PLD_NoError_MODE" 1 "OSC_PLD_Error_MODE" 2 "OSC_PLD_Unknown_MODE" /end COMPU_VTAB
/begin COMPU_VTAB DataType_DataTypeSemantics_osc_funcRequestStatus_enum_type "" TAB_VERB 3 0 "functRequest_low" 1 "functRequest_rising_edge" 2 "functRequest_high" /end COMPU_VTAB
/*********** End of merged COMPU_VTAB blocks ***********/ /*********** Start of merged COMPU_VTAB_RANGE blocks ***********/
/begin COMPU_VTAB_RANGE rb_RxE2E_State_enumTag "" 5 0 0 "RB_RX_E2E_NO_MONITORING" 1 1 "RB_RX_E2E_INIT_STATE" 2 2 "RB_RX_E2E_NORMAL_STATE" 3 3 "RB_RX_E2E_SAFE_STATE" 4 4 "RB_RX_E2E_INVALID_STATE" DEFAULT_VALUE "" /end COMPU_VTAB_RANGE
/end MODULE
/end PROJECT

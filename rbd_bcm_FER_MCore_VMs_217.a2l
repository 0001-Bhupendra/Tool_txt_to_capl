ASAP2_VERSION 1 61
/begin PROJECT prjDemo ""
/begin HEADER "" PROJECT_NO prjDemo_1_0 VERSION "AR_A2L_1.0" /end HEADER
/begin MODULE modFinalDemo ""
/begin MOD_COMMON "" BYTE_ORDER MSB_FIRST ALIGNMENT_BYTE 1 ALIGNMENT_WORD 1 ALIGNMENT_LONG 1 ALIGNMENT_INT64 1 ALIGNMENT_FLOAT32_IEEE 1 ALIGNMENT_FLOAT64_IEEE 4 /end MOD_COMMON
/begin RECORD_LAYOUT __FLOAT32_IEEE_Z_s1 FNC_VALUES 1 FLOAT32_IEEE ROW_DIR DIRECT /end RECORD_LAYOUT
/begin RECORD_LAYOUT __FLOAT64_IEEE_Z_s1 FNC_VALUES 1 FLOAT64_IEEE ROW_DIR DIRECT /end RECORD_LAYOUT
/begin RECORD_LAYOUT __UBYTE_S_s1 FNC_VALUES 1 UBYTE COLUMN_DIR DIRECT /end RECORD_LAYOUT
/begin RECORD_LAYOUT __UWORD_S_s1 FNC_VALUES 1 UWORD COLUMN_DIR DIRECT /end RECORD_LAYOUT
/begin RECORD_LAYOUT __ULONG_S_s1 FNC_VALUES 1 ULONG COLUMN_DIR DIRECT /end RECORD_LAYOUT
/begin RECORD_LAYOUT __SBYTE_S_s1 FNC_VALUES 1 SBYTE COLUMN_DIR DIRECT /end RECORD_LAYOUT
/begin RECORD_LAYOUT __SWORD_S_s1 FNC_VALUES 1 SWORD COLUMN_DIR DIRECT /end RECORD_LAYOUT
/begin RECORD_LAYOUT __SLONG_S_s1 FNC_VALUES 1 SLONG COLUMN_DIR DIRECT /end RECORD_LAYOUT
/begin RECORD_LAYOUT __FLOAT32_IEEE_S_s1 FNC_VALUES 1 FLOAT32_IEEE COLUMN_DIR DIRECT /end RECORD_LAYOUT
/begin RECORD_LAYOUT __FLOAT64_IEEE_S_s1 FNC_VALUES 1 FLOAT64_IEEE COLUMN_DIR DIRECT /end RECORD_LAYOUT
/begin RECORD_LAYOUT SSV__UBYTE_S_s1 AXIS_PTS_X 1 UBYTE INDEX_INCR DIRECT /end RECORD_LAYOUT
/begin MEASUREMENT MCore_VF228_actvLeChdLockCtrlInt "Boolean" UBYTE Methods_boolean 1 100 0.0 1.0 MAX_REFRESH 4 1 ECU_ADDRESS 0x400AB367 /end MEASUREMENT
/begin MEASUREMENT MCore_VF228_actvLeChdLockLed "Boolean" UBYTE Methods_boolean 1 100 0.0 1.0 MAX_REFRESH 4 1 ECU_ADDRESS 0x400AB368 /end MEASUREMENT
/begin MEASUREMENT MCore_VF228_actvRiChdLockCtrl "Boolean" UBYTE Methods_boolean 1 100 0.0 1.0 MAX_REFRESH 4 1 ECU_ADDRESS 0x400E3179 /end MEASUREMENT
/begin MEASUREMENT MCore_VF228_actvRiChdLockCtrlInt "Boolean" UBYTE Methods_boolean 1 100 0.0 1.0 MAX_REFRESH 4 1 ECU_ADDRESS 0x400AB369 /end MEASUREMENT
/begin MEASUREMENT MCore_VF228_actvRiChdLockLed "Boolean" UBYTE Methods_boolean 1 100 0.0 1.0 MAX_REFRESH 4 1 ECU_ADDRESS 0x400AB36A /end MEASUREMENT
/begin MEASUREMENT MCore_PiChdLockCtrlGnd "Boolean" UBYTE Methods_boolean 1 100 0.0 1.0 MAX_REFRESH 4 1 ECU_ADDRESS 0x400E388F /end MEASUREMENT
/begin MEASUREMENT MCore_Unconnected_DeNBC_LH_Unlock "Boolean" UBYTE Methods_boolean 1 100 0.0 1.0 MAX_REFRESH 4 1 ECU_ADDRESS 0x400E317C /end MEASUREMENT
/begin MEASUREMENT MCore_Unconnected_DeNBC_LV_Unlock "Boolean" UBYTE Methods_boolean 1 100 0.0 1.0 MAX_REFRESH 4 1 ECU_ADDRESS 0x400E317D /end MEASUREMENT
/begin MEASUREMENT MCore_Unconnected_DeNBC_Lock "Boolean" UBYTE Methods_boolean 1 100 0.0 1.0 MAX_REFRESH 4 1 ECU_ADDRESS 0x400E317B /end MEASUREMENT
/begin MEASUREMENT MCore_Unconnected_DeNBC_RH_Unlock "Boolean" UBYTE Methods_boolean 1 100 0.0 1.0 MAX_REFRESH 4 1 ECU_ADDRESS 0x400E317E /end MEASUREMENT
/begin MEASUREMENT MCore_Unconnected_DeNBC_RV_Unlock "Boolean" UBYTE Methods_boolean 1 100 0.0 1.0 MAX_REFRESH 4 1 ECU_ADDRESS 0x400E317F /end MEASUREMENT
/begin MEASUREMENT MCore_Unconnected_DeSTS_DRS_DriverLatchsts "" UBYTE App_VF092_CompuMethod_CM_STS_DRS_DriverLatchsts 1 100 0.0 255.0 MAX_REFRESH 4 1 ECU_ADDRESS 0x400E3181 /end MEASUREMENT
/begin MEASUREMENT MCore_Unconnected_DeSTS_DRS_PsngrLatchsts "" UBYTE App_VF092_CompuMethod_CM_STS_DRS_PsngrLatchsts 1 100 0.0 255.0 MAX_REFRESH 4 1 ECU_ADDRESS 0x400E3182 /end MEASUREMENT
/begin MEASUREMENT MCore_Unconnected_DeSTS_DRS_RearLeftLatchSts "unsigned integer 8bit" UBYTE VW_BCM_CompuMethods_SC_F1_O0_UNoUnit 1 100 0.0 255.0 MAX_REFRESH 4 1 ECU_ADDRESS 0x400E3184 /end MEASUREMENT
/begin MEASUREMENT MCore_Unconnected_DeSTS_DRS_RearRightLatchSts "unsigned integer 8bit" UBYTE VW_BCM_CompuMethods_SC_F1_O0_UNoUnit 1 100 0.0 255.0 MAX_REFRESH 4 1 ECU_ADDRESS 0x400E3183 /end MEASUREMENT
/begin MEASUREMENT MCore_VF301_TGL_Motor "unsigned integer 8bit" UBYTE VW_BCM_CompuMethods_SC_F1_O0_UNoUnit 1 100 0.0 255.0 MAX_REFRESH 4 1 ECU_ADDRESS 0x400E3890 /end MEASUREMENT
/begin MEASUREMENT MCore_DeDriverDoorSts "" UBYTE Methods_boolean 1 100 0.0 255.0 MAX_REFRESH 4 1 ECU_ADDRESS 0x400E3891
 /begin ANNOTATION ANNOTATION_LABEL "Description (coming from AUTOSAR DESC field)" /begin ANNOTATION_TEXT "This input indicates DriverDoor status\r\n" /end ANNOTATION_TEXT /end ANNOTATION
/end MEASUREMENT
/begin MEASUREMENT MCore_DePsngrDoorSts "" UBYTE Methods_boolean 1 100 0.0 255.0 MAX_REFRESH 4 1 ECU_ADDRESS 0x400E3892
 /begin ANNOTATION ANNOTATION_LABEL "Description (coming from AUTOSAR DESC field)" /begin ANNOTATION_TEXT "This input indicates PsngrDoorSts status.\r\n" /end ANNOTATION_TEXT /end ANNOTATION
/end MEASUREMENT
/begin MEASUREMENT MCore_DeRearLeftDoorSts "" UBYTE Methods_boolean 1 100 0.0 255.0 MAX_REFRESH 4 1 ECU_ADDRESS 0x400E3893
 /begin ANNOTATION ANNOTATION_LABEL "Description (coming from AUTOSAR DESC field)" /begin ANNOTATION_TEXT "This input indicates Rear left door status\r\n" /end ANNOTATION_TEXT /end ANNOTATION
/end MEASUREMENT
/begin MEASUREMENT MCore_DeRearRightDoorSts "" UBYTE VF091_DataType_DataTypeSemantics_CM_PsngrDoorSts_CCAN1 1 100 0.0 255.0 MAX_REFRESH 4 1 ECU_ADDRESS 0x400E3894
 /begin ANNOTATION ANNOTATION_LABEL "Description (coming from AUTOSAR DESC field)" /begin ANNOTATION_TEXT "This input indicates rear right Door status\r\n" /end ANNOTATION_TEXT /end ANNOTATION
/end MEASUREMENT
/begin MEASUREMENT MCore_Unconnected_TesterValue_1 "Boolean" UBYTE Methods_boolean 1 100 0.0 1.0 MAX_REFRESH 4 1 ECU_ADDRESS 0x400E3186 /end MEASUREMENT
/begin MEASUREMENT MCore_Unconnected_TesterValue_2 "Boolean" UBYTE Methods_boolean 1 100 0.0 1.0 MAX_REFRESH 4 1 ECU_ADDRESS 0x400E3187 /end MEASUREMENT
/begin MEASUREMENT MCore_Unconnected_TesterValue_3 "Boolean" UBYTE Methods_boolean 1 100 0.0 1.0 MAX_REFRESH 4 1 ECU_ADDRESS 0x400E3188 /end MEASUREMENT
/begin MEASUREMENT MCore_StMon_367 "" UBYTE DefaultIdenticalCompu 1 100 0.0 255.0 MAX_REFRESH 4 1 ECU_ADDRESS 0x400E3896
 /begin ANNOTATION ANNOTATION_LABEL "Description (coming from AUTOSAR DESC field)"
  /begin ANNOTATION_TEXT "Application data type for error type data elements. Error types are bit coded\r\n" /end ANNOTATION_TEXT
 /end ANNOTATION
/end MEASUREMENT
/begin MEASUREMENT MCore_RequestActive_53 "Boolean" UBYTE Methods_boolean 1 100 0.0 1.0 MAX_REFRESH 4 1 ECU_ADDRESS 0x400E3897 /end MEASUREMENT
/begin MEASUREMENT MCore_RequestValue_46 "Boolean" UBYTE Methods_boolean 1 100 0.0 1.0 MAX_REFRESH 4 1 ECU_ADDRESS 0x400E3898 /end MEASUREMENT
/begin MEASUREMENT MCore_RequestActive_54 "Boolean" UBYTE Methods_boolean 1 100 0.0 1.0 MAX_REFRESH 4 1 ECU_ADDRESS 0x400E3899 /end MEASUREMENT
/begin MEASUREMENT MCore_RequestValue_47 "Boolean" UBYTE Methods_boolean 1 100 0.0 1.0 MAX_REFRESH 4 1 ECU_ADDRESS 0x400E389A /end MEASUREMENT
/begin MEASUREMENT MCore_RequestActive_55 "Boolean" UBYTE Methods_boolean 1 100 0.0 1.0 MAX_REFRESH 4 1 ECU_ADDRESS 0x400E389B /end MEASUREMENT
/begin MEASUREMENT MCore_RequestValue_48 "Boolean" UBYTE Methods_boolean 1 100 0.0 1.0 MAX_REFRESH 4 1 ECU_ADDRESS 0x400E389C /end MEASUREMENT
/begin MEASUREMENT MCore_LeftRearPositionLight "Boolean" UBYTE Methods_boolean 1 100 0.0 1.0 MAX_REFRESH 4 1 ECU_ADDRESS 0x400E389D /end MEASUREMENT
/begin MEASUREMENT MCore_RightRearPositionLight "Boolean" UBYTE Methods_boolean 1 100 0.0 1.0 MAX_REFRESH 4 1 ECU_ADDRESS 0x400E389E /end MEASUREMENT
/begin MEASUREMENT MCore_DeHeadlampRelay1 "Boolean" UBYTE Methods_boolean 1 100 0.0 1.0 MAX_REFRESH 4 1 ECU_ADDRESS 0x400E389F /end MEASUREMENT
/begin MEASUREMENT MCore_DeHeadlampRelay2 "Boolean" UBYTE Methods_boolean 1 100 0.0 1.0 MAX_REFRESH 4 1 ECU_ADDRESS 0x400E38A0 /end MEASUREMENT
/begin MEASUREMENT MCore_PiLowBeamCmd "unsigned integer 8bit" UBYTE VW_BCM_CompuMethods_SC_F1_O0_UNoUnit 1 100 0.0 255.0 MAX_REFRESH 4 1 ECU_ADDRESS 0x400E38A1 /end MEASUREMENT
/begin MEASUREMENT MCore_VF042_LowBeamSts "unsigned integer 8bit" UBYTE VW_BCM_CompuMethods_SC_F1_O0_UNoUnit 1 100 0.0 255.0 MAX_REFRESH 4 1 ECU_ADDRESS 0x400E38A2 /end MEASUREMENT
/begin MEASUREMENT MCore_StMon_368 "" UBYTE DefaultIdenticalCompu 1 100 0.0 255.0 MAX_REFRESH 4 1 ECU_ADDRESS 0x400E38A6
 /begin ANNOTATION ANNOTATION_LABEL "Description (coming from AUTOSAR DESC field)"
  /begin ANNOTATION_TEXT "Application data type for error type data elements. Error types are bit coded\r\n" /end ANNOTATION_TEXT
 /end ANNOTATION
/end MEASUREMENT
/begin MEASUREMENT MCore_NFR_Speed_FA_FailSts_1 "Boolean" UBYTE Methods_boolean 1 100 0.0 1.0 MAX_REFRESH 4 1 ECU_ADDRESS 0x5280D31E /end MEASUREMENT
/begin MEASUREMENT MCore_DeKeySwitchSts "" UBYTE DataType_DataTypeSemantics_DT_KeySwitchSts 1 100 0.0 255.0 MAX_REFRESH 4 1 ECU_ADDRESS 0x400E3882 /end MEASUREMENT
/begin MEASUREMENT MCore_DeKeySwitchSts_0 "" UBYTE DataType_DataTypeSemantics_DT_KeySwitchSts 1 100 0.0 255.0 MAX_REFRESH 4 1 ECU_ADDRESS 0x400E3883 /end MEASUREMENT
/begin MEASUREMENT MCore_Config_Chk_State "Boolean" UBYTE Methods_boolean 1 100 0.0 1.0 MAX_REFRESH 4 1 ECU_ADDRESS 0x400E38A7 /end MEASUREMENT
/begin MEASUREMENT MCore_DeDiagnosisStateDCM "" UBYTE Methods_boolean 1 100 0.0 255.0 MAX_REFRESH 4 1 ECU_ADDRESS 0x400E318C
 /begin ANNOTATION ANNOTATION_LABEL "Description (coming from AUTOSAR DESC field)"
  /begin ANNOTATION_TEXT "Boolean has the value space required to support the mathematical concept of binary-valued logic: {true, false}.\r\n" /end ANNOTATION_TEXT
 /end ANNOTATION
/end MEASUREMENT
/begin MEASUREMENT MCore_DeDiagnosisCurrentSession "" UBYTE DefaultIdenticalCompu 1 100 0.0 255.0 MAX_REFRESH 4 1 ECU_ADDRESS 0x400E318D
 /begin ANNOTATION ANNOTATION_LABEL "Description (coming from AUTOSAR DESC field)"
  /begin ANNOTATION_TEXT "UInt8 represents integers with a minimum value of 0 and a maximum value of 255. The order-relation on UInt8 is: x &lt; y iff y - x is positive. UInt8 has a lexical representation consisting of a finite-length sequence of decimal digits (#x30-#x39). For example: 1, 0, 126, +10.\r\n" /end ANNOTATION_TEXT
 /end ANNOTATION
/end MEASUREMENT
/begin MEASUREMENT MCore_Unconnected_bAnfMuteMode "Boolean" UBYTE Methods_boolean 1 100 0.0 1.0 MAX_REFRESH 4 1 ECU_ADDRESS 0x400E318E
 /begin ANNOTATION ANNOTATION_LABEL "Description (coming from AUTOSAR DESC field)" /begin ANNOTATION_TEXT "Front Wiper mute mode request\r\n" /end ANNOTATION_TEXT /end ANNOTATION
/end MEASUREMENT
/begin MEASUREMENT MCore_MirrDir "" UBYTE DefaultIdenticalCompu 1 100 0.0 255.0 MAX_REFRESH 4 1 ECU_ADDRESS 0x400E35D6
 /begin ANNOTATION ANNOTATION_LABEL "Description (coming from AUTOSAR DESC field)" /begin ANNOTATION_TEXT "8 bit unsigned integer basetype\r\n" /end ANNOTATION_TEXT /end ANNOTATION
/end MEASUREMENT
/begin MEASUREMENT MCore_MirrSeln "" UBYTE DefaultIdenticalCompu 1 100 0.0 255.0 MAX_REFRESH 4 1 ECU_ADDRESS 0x400E35D7
 /begin ANNOTATION ANNOTATION_LABEL "Description (coming from AUTOSAR DESC field)" /begin ANNOTATION_TEXT "8 bit unsigned integer basetype\r\n" /end ANNOTATION_TEXT /end ANNOTATION
/end MEASUREMENT
/begin MEASUREMENT MCore_RoutineRunng "" UBYTE Methods_boolean 1 100 0.0 255.0 MAX_REFRESH 4 1 ECU_ADDRESS 0x400E35D8
 /begin ANNOTATION ANNOTATION_LABEL "Description (coming from AUTOSAR DESC field)" /begin ANNOTATION_TEXT "boolean basetype (0 = false, 1 = true)\r\n" /end ANNOTATION_TEXT /end ANNOTATION
/end MEASUREMENT
/begin MEASUREMENT MCore_VF301_EngineBonnetSts "Boolean" UBYTE Methods_boolean 1 100 0.0 1.0 MAX_REFRESH 4 1 ECU_ADDRESS 0x400E35D9 /end MEASUREMENT
/begin MEASUREMENT MCore_F228_LChildlockCommandDoorSts "Boolean" UBYTE Methods_boolean 1 100 0.0 1.0 MAX_REFRESH 4 1 ECU_ADDRESS 0x400E35DA /end MEASUREMENT
/begin MEASUREMENT MCore_F228_RChildlockCommandDoorSts "Boolean" UBYTE Methods_boolean 1 100 0.0 1.0 MAX_REFRESH 4 1 ECU_ADDRESS 0x400E35DB /end MEASUREMENT
/begin MEASUREMENT MCore_VF506_EngineSts "" UBYTE DefaultIdenticalCompu 1 100 0.0 255.0 MAX_REFRESH 4 1 ECU_ADDRESS 0x400E35DE /end MEASUREMENT
/begin MEASUREMENT MCore_STS_LH_PowerModeSts "unsigned integer 8bit" UBYTE VW_BCM_CompuMethods_SC_F1_O0_UNoUnit 1 100 0.0 255.0 MAX_REFRESH 4 1 ECU_ADDRESS 0x400E35DF /end MEASUREMENT
/begin MEASUREMENT MCore_STS_RH_PowerModeSts "unsigned integer 8bit" UBYTE VW_BCM_CompuMethods_SC_F1_O0_UNoUnit 1 100 0.0 255.0 MAX_REFRESH 4 1 ECU_ADDRESS 0x400E35E0 /end MEASUREMENT
/begin MEASUREMENT MCore_STS_LV_PowerModeSts "unsigned integer 8bit" UBYTE VW_BCM_CompuMethods_SC_F1_O0_UNoUnit 1 100 0.0 255.0 MAX_REFRESH 4 1 ECU_ADDRESS 0x400E35E1 /end MEASUREMENT
/begin MEASUREMENT MCore_STS_RV_PowerModeSts "unsigned integer 8bit" UBYTE VW_BCM_CompuMethods_SC_F1_O0_UNoUnit 1 100 0.0 255.0 MAX_REFRESH 4 1 ECU_ADDRESS 0x400E35E2 /end MEASUREMENT
/begin MEASUREMENT MCore_StMon_31 "" UBYTE DefaultIdenticalCompu 1 100 0.0 255.0 MAX_REFRESH 4 1 ECU_ADDRESS 0x400E35E8
 /begin ANNOTATION ANNOTATION_LABEL "Description (coming from AUTOSAR DESC field)"
  /begin ANNOTATION_TEXT "Application data type for error type data elements. Error types are bit coded\r\n" /end ANNOTATION_TEXT
 /end ANNOTATION
/end MEASUREMENT
/begin MEASUREMENT MCore_StMon_32 "" UBYTE DefaultIdenticalCompu 1 100 0.0 255.0 MAX_REFRESH 4 1 ECU_ADDRESS 0x400E35E9
 /begin ANNOTATION ANNOTATION_LABEL "Description (coming from AUTOSAR DESC field)"
  /begin ANNOTATION_TEXT "Application data type for error type data elements. Error types are bit coded\r\n" /end ANNOTATION_TEXT
 /end ANNOTATION
/end MEASUREMENT
/begin MEASUREMENT MCore_SounderLin_ActiveShdlTable_u8 "unsigned integer 8bit" UBYTE VW_BCM_CompuMethods_SC_F1_O0_UNoUnit 1 100 0.0 255.0 MAX_REFRESH 4 1 ECU_ADDRESS 0x400E364B /end MEASUREMENT
/begin MEASUREMENT MCore_SounderLin_Error_Wakeup_u8 "" UBYTE RB_RBD_ModeM_SounderLin_Interface_CompuMethod_CM_LIN2_Transmission_Error 1 100 0.0 255.0 MAX_REFRESH 4 1 ECU_ADDRESS 0x400E364C
 /begin ANNOTATION ANNOTATION_LABEL "Description (coming from AUTOSAR DESC field)" /begin ANNOTATION_TEXT "8 bit unsigned integer basetype\r\n" /end ANNOTATION_TEXT /end ANNOTATION
/end MEASUREMENT
/begin MEASUREMENT MCore_DE_VF087_IrregularWakeup "" UBYTE Methods_boolean 1 100 0.0 255.0 MAX_REFRESH 4 1 ECU_ADDRESS 0x400E364E
 /begin ANNOTATION ANNOTATION_LABEL "Description (coming from AUTOSAR DESC field)" /begin ANNOTATION_TEXT "boolean basetype (0 = false, 1 = true)\r\n" /end ANNOTATION_TEXT /end ANNOTATION
/end MEASUREMENT
/begin MEASUREMENT MCore_RequestEcuMode "unsigned integer 8bit" UBYTE BCGW_ModeM_CompuMethods_ModeM_RequestEcuModeType 1 100 0.0 255.0 MAX_REFRESH 1000 1 ECU_ADDRESS 0x400E362D /end MEASUREMENT
/begin MEASUREMENT MCore_RequestEcuMode_0 "unsigned integer 8bit" UBYTE BCGW_ModeM_CompuMethods_ModeM_RequestEcuModeType 1 100 0.0 255.0 MAX_REFRESH 1000 1 ECU_ADDRESS 0x400E362E /end MEASUREMENT
/begin MEASUREMENT MCore_RequestEcuMode_1 "unsigned integer 8bit" UBYTE BCGW_ModeM_CompuMethods_ModeM_RequestEcuModeType 1 100 0.0 255.0 MAX_REFRESH 1000 1 ECU_ADDRESS 0x400E362F /end MEASUREMENT
/begin MEASUREMENT MCore_RequestEcuMode_2 "unsigned integer 8bit" UBYTE BCGW_ModeM_CompuMethods_ModeM_RequestEcuModeType 1 100 0.0 255.0 MAX_REFRESH 1000 1 ECU_ADDRESS 0x400E3630 /end MEASUREMENT
/begin MEASUREMENT MCore_RequestEcuMode_3 "unsigned integer 8bit" UBYTE BCGW_ModeM_CompuMethods_ModeM_RequestEcuModeType 1 100 0.0 255.0 MAX_REFRESH 1000 1 ECU_ADDRESS 0x400E3631 /end MEASUREMENT
/begin MEASUREMENT MCore_RequestEcuMode_4 "unsigned integer 8bit" UBYTE BCGW_ModeM_CompuMethods_ModeM_RequestEcuModeType 1 100 0.0 255.0 MAX_REFRESH 1000 1 ECU_ADDRESS 0x400E3632 /end MEASUREMENT
/begin MEASUREMENT MCore_RequestEcuMode_5 "unsigned integer 8bit" UBYTE BCGW_ModeM_CompuMethods_ModeM_RequestEcuModeType 1 100 0.0 255.0 MAX_REFRESH 1000 1 ECU_ADDRESS 0x400E3633 /end MEASUREMENT
/begin MEASUREMENT MCore_RequestEcuMode_6 "unsigned integer 8bit" UBYTE BCGW_ModeM_CompuMethods_ModeM_RequestEcuModeType 1 100 0.0 255.0 MAX_REFRESH 1000 1 ECU_ADDRESS 0x400E3634 /end MEASUREMENT
/begin MEASUREMENT MCore_RequestEcuMode_7 "unsigned integer 8bit" UBYTE BCGW_ModeM_CompuMethods_ModeM_RequestEcuModeType 1 100 0.0 255.0 MAX_REFRESH 1000 1 ECU_ADDRESS 0x400E3635 /end MEASUREMENT
/begin MEASUREMENT MCore_RequestEcuMode_8 "unsigned integer 8bit" UBYTE BCGW_ModeM_CompuMethods_ModeM_RequestEcuModeType 1 100 0.0 255.0 MAX_REFRESH 1000 1 ECU_ADDRESS 0x400E3636 /end MEASUREMENT
/begin MEASUREMENT MCore_RequestEcuMode_9 "unsigned integer 8bit" UBYTE BCGW_ModeM_CompuMethods_ModeM_RequestEcuModeType 1 100 0.0 255.0 MAX_REFRESH 1000 1 ECU_ADDRESS 0x400E3637 /end MEASUREMENT
/begin MEASUREMENT MCore_RequestEcuMode_10 "unsigned integer 8bit" UBYTE BCGW_ModeM_CompuMethods_ModeM_RequestEcuModeType 1 100 0.0 255.0 MAX_REFRESH 1000 1 ECU_ADDRESS 0x400E3638 /end MEASUREMENT
/begin MEASUREMENT MCore_RequestEcuMode_11 "unsigned integer 8bit" UBYTE BCGW_ModeM_CompuMethods_ModeM_RequestEcuModeType 1 100 0.0 255.0 MAX_REFRESH 1000 1 ECU_ADDRESS 0x400E3639 /end MEASUREMENT
/begin MEASUREMENT MCore_RequestEcuMode_12 "unsigned integer 8bit" UBYTE BCGW_ModeM_CompuMethods_ModeM_RequestEcuModeType 1 100 0.0 255.0 MAX_REFRESH 1000 1 ECU_ADDRESS 0x400E363A /end MEASUREMENT
/begin MEASUREMENT MCore_RequestEcuMode_13 "unsigned integer 8bit" UBYTE BCGW_ModeM_CompuMethods_ModeM_RequestEcuModeType 1 100 0.0 255.0 MAX_REFRESH 1000 1 ECU_ADDRESS 0x400E363B /end MEASUREMENT
/begin MEASUREMENT MCore_RequestEcuMode_14 "unsigned integer 8bit" UBYTE BCGW_ModeM_CompuMethods_ModeM_RequestEcuModeType 1 100 0.0 255.0 MAX_REFRESH 1000 1 ECU_ADDRESS 0x400E363C /end MEASUREMENT
/begin MEASUREMENT MCore_RequestEcuMode_15 "unsigned integer 8bit" UBYTE BCGW_ModeM_CompuMethods_ModeM_RequestEcuModeType 1 100 0.0 255.0 MAX_REFRESH 1000 1 ECU_ADDRESS 0x400E363D /end MEASUREMENT
/begin MEASUREMENT MCore_RequestEcuMode_16 "unsigned integer 8bit" UBYTE BCGW_ModeM_CompuMethods_ModeM_RequestEcuModeType 1 100 0.0 255.0 MAX_REFRESH 1000 1 ECU_ADDRESS 0x400E363E /end MEASUREMENT
/begin MEASUREMENT MCore_RequestEcuMode_17 "unsigned integer 8bit" UBYTE BCGW_ModeM_CompuMethods_ModeM_RequestEcuModeType 1 100 0.0 255.0 MAX_REFRESH 1000 1 ECU_ADDRESS 0x400E363F /end MEASUREMENT
/begin MEASUREMENT MCore_RequestEcuMode_18 "unsigned integer 8bit" UBYTE BCGW_ModeM_CompuMethods_ModeM_RequestEcuModeType 1 100 0.0 255.0 MAX_REFRESH 1000 1 ECU_ADDRESS 0x400E3640 /end MEASUREMENT
/begin MEASUREMENT MCore_RequestEcuMode_19 "unsigned integer 8bit" UBYTE BCGW_ModeM_CompuMethods_ModeM_RequestEcuModeType 1 100 0.0 255.0 MAX_REFRESH 1000 1 ECU_ADDRESS 0x400E3641 /end MEASUREMENT
/begin MEASUREMENT MCore_RequestEcuMode_20 "unsigned integer 8bit" UBYTE BCGW_ModeM_CompuMethods_ModeM_RequestEcuModeType 1 100 0.0 255.0 MAX_REFRESH 1000 1 ECU_ADDRESS 0x400E3642 /end MEASUREMENT
/begin MEASUREMENT MCore_RequestEcuMode_21 "unsigned integer 8bit" UBYTE BCGW_ModeM_CompuMethods_ModeM_RequestEcuModeType 1 100 0.0 255.0 MAX_REFRESH 1000 1 ECU_ADDRESS 0x400E3643 /end MEASUREMENT
/begin MEASUREMENT MCore_RequestEcuMode_22 "unsigned integer 8bit" UBYTE BCGW_ModeM_CompuMethods_ModeM_RequestEcuModeType 1 100 0.0 255.0 MAX_REFRESH 1000 1 ECU_ADDRESS 0x400E3644 /end MEASUREMENT
/begin MEASUREMENT MCore_RequestEcuMode_23 "unsigned integer 8bit" UBYTE BCGW_ModeM_CompuMethods_ModeM_RequestEcuModeType 1 100 0.0 255.0 MAX_REFRESH 1000 1 ECU_ADDRESS 0x400E3645 /end MEASUREMENT
/begin MEASUREMENT MCore_RequestEcuMode_24 "unsigned integer 8bit" UBYTE BCGW_ModeM_CompuMethods_ModeM_RequestEcuModeType 1 100 0.0 255.0 MAX_REFRESH 1000 1 ECU_ADDRESS 0x400E3646 /end MEASUREMENT
/begin MEASUREMENT MCore_RequestEcuMode_25 "unsigned integer 8bit" UBYTE BCGW_ModeM_CompuMethods_ModeM_RequestEcuModeType 1 100 0.0 255.0 MAX_REFRESH 1000 1 ECU_ADDRESS 0x400E3647 /end MEASUREMENT
/begin MEASUREMENT MCore_RequestEcuMode_26 "unsigned integer 8bit" UBYTE BCGW_ModeM_CompuMethods_ModeM_RequestEcuModeType 1 100 0.0 255.0 MAX_REFRESH 1000 1 ECU_ADDRESS 0x400E3648 /end MEASUREMENT
/begin MEASUREMENT MCore_RequestEcuMode_27 "unsigned integer 8bit" UBYTE BCGW_ModeM_CompuMethods_ModeM_RequestEcuModeType 1 100 0.0 255.0 MAX_REFRESH 1000 1 ECU_ADDRESS 0x400E3649 /end MEASUREMENT
/begin MEASUREMENT MCore_RequestEcuMode_28 "unsigned integer 8bit" UBYTE BCGW_ModeM_CompuMethods_ModeM_RequestEcuModeType 1 100 0.0 255.0 MAX_REFRESH 1000 1 ECU_ADDRESS 0x400E364A /end MEASUREMENT
/begin MEASUREMENT MCore_bBHCanAktiv "Boolean" UBYTE Methods_boolean 1 100 0.0 1.0 MAX_REFRESH 4 1 ECU_ADDRESS 0x400AB35E
 /begin ANNOTATION ANNOTATION_LABEL "Description (coming from AUTOSAR DESC field)"
  /begin ANNOTATION_TEXT "SubCAN active (RepeatMessage, Normal Operation or ReadySleep), derived from the NMH statechart\r\n" /end ANNOTATION_TEXT
 /end ANNOTATION
/end MEASUREMENT
/begin MEASUREMENT MCore_bC1CanAktiv "Boolean" UBYTE Methods_boolean 1 100 0.0 1.0 MAX_REFRESH 4 1 ECU_ADDRESS 0x400AB35F
 /begin ANNOTATION ANNOTATION_LABEL "Description (coming from AUTOSAR DESC field)"
  /begin ANNOTATION_TEXT "KCAN active (RepeatMessage, Normal Operation or ReadySleep), derived from the NMH statechart\r\n" /end ANNOTATION_TEXT
 /end ANNOTATION
/end MEASUREMENT
/begin MEASUREMENT MCore_bC2CanAktiv "Boolean" UBYTE Methods_boolean 1 100 0.0 1.0 MAX_REFRESH 4 1 ECU_ADDRESS 0x400AB360
 /begin ANNOTATION ANNOTATION_LABEL "Description (coming from AUTOSAR DESC field)"
  /begin ANNOTATION_TEXT "KCAN active (RepeatMessage, Normal Operation or ReadySleep), derived from the NMH statechart\r\n" /end ANNOTATION_TEXT
 /end ANNOTATION
/end MEASUREMENT
/begin MEASUREMENT MCore_NetworkStatus "" UBYTE DataType_DataTypeSemantics_KOSMXACDOXIHEATDLSTUXELACIGSMHMO 1 100 0.0 255.0 MAX_REFRESH 4 1 ECU_ADDRESS 0x52800041 /end MEASUREMENT
/begin MEASUREMENT MCore_NetworkStatus_0 "" UBYTE DataType_DataTypeSemantics_AXOECGKIAISMEKUELOHCDKLKTTSUKOKT 1 100 0.0 255.0 MAX_REFRESH 4 1 ECU_ADDRESS 0x52800042 /end MEASUREMENT
/begin MEASUREMENT MCore_StMon_365 "" UBYTE DefaultIdenticalCompu 1 100 0.0 255.0 MAX_REFRESH 4 1 ECU_ADDRESS 0x5280D31D
 /begin ANNOTATION ANNOTATION_LABEL "Description (coming from AUTOSAR DESC field)"
  /begin ANNOTATION_TEXT "Application data type for error type data elements. Error types are bit coded\r\n" /end ANNOTATION_TEXT
 /end ANNOTATION
/end MEASUREMENT
/begin MEASUREMENT MCore_rasDataSenH_0 "unsigned integer 16bit" UWORD VW_BCM_CompuMethods_SC_F1_O0_UNoUnit 1 100 0.0 65535.0 MAX_REFRESH 4 1 ECU_ADDRESS 0x400E2FAC /end MEASUREMENT
/begin MEASUREMENT MCore_rawDataSenV_0 "unsigned integer 16bit" UWORD VW_BCM_CompuMethods_SC_F1_O0_UNoUnit 1 100 0.0 65535.0 MAX_REFRESH 4 1 ECU_ADDRESS 0x400E2FAE /end MEASUREMENT
/begin MEASUREMENT MCore_ErrAdcCat1 "" UBYTE DefaultIdenticalCompu 1 100 0.0 255.0 ARRAY_SIZE 39 ECU_ADDRESS 0x400E38A8 /end MEASUREMENT
/begin MEASUREMENT MCore_ErrAdcCat10 "" UBYTE DefaultIdenticalCompu 1 100 0.0 255.0 ARRAY_SIZE 15 ECU_ADDRESS 0x400E38CF /end MEASUREMENT
/begin MEASUREMENT MCore_ErrAdcCat20 "" UBYTE DefaultIdenticalCompu 1 100 0.0 255.0 ARRAY_SIZE 4 ECU_ADDRESS 0x400E2DA0 /end MEASUREMENT
/begin MEASUREMENT MCore_ErrAdcCat21 "" UBYTE DefaultIdenticalCompu 1 100 0.0 255.0 ARRAY_SIZE 3 ECU_ADDRESS 0x400E38DE /end MEASUREMENT
/begin MEASUREMENT MCore_ErrAdcCat30 "" UBYTE DefaultIdenticalCompu 1 100 0.0 255.0 ARRAY_SIZE 2 ECU_ADDRESS 0x400E2FB0 /end MEASUREMENT
/begin MEASUREMENT MCore_ErrAdcCat50 "" UBYTE DefaultIdenticalCompu 1 100 0.0 255.0 ARRAY_SIZE 69 ECU_ADDRESS 0x400E38E1 /end MEASUREMENT
/begin MEASUREMENT MCore_ErrAdcCat52 "" UBYTE DefaultIdenticalCompu 1 100 0.0 255.0 ARRAY_SIZE 12 ECU_ADDRESS 0x400E2DA4 /end MEASUREMENT
/begin MEASUREMENT MCore_ErrAdcCat53 "" UBYTE DefaultIdenticalCompu 1 100 0.0 255.0 ARRAY_SIZE 5 ECU_ADDRESS 0x400E3926 /end MEASUREMENT
/begin MEASUREMENT MCore_ErrAdcCat54 "" UBYTE DefaultIdenticalCompu 1 100 0.0 255.0 ARRAY_SIZE 54 ECU_ADDRESS 0x400E2FB2 /end MEASUREMENT
/begin MEASUREMENT MCore_cat1_0 "" UWORD DefaultIdenticalCompu 1 100 0.0 65535.0 ARRAY_SIZE 39 ECU_ADDRESS 0x400E2FE8 /end MEASUREMENT
/begin MEASUREMENT MCore_cat10_0 "" UWORD DefaultIdenticalCompu 1 100 0.0 65535.0 ARRAY_SIZE 15 ECU_ADDRESS 0x400E3036 /end MEASUREMENT
/begin MEASUREMENT MCore_cat20_0 "" UWORD DefaultIdenticalCompu 1 100 0.0 65535.0 ARRAY_SIZE 4 ECU_ADDRESS 0x400E2C40 /end MEASUREMENT
/begin MEASUREMENT MCore_cat21 "" UWORD DefaultIdenticalCompu 1 100 0.0 65535.0 ARRAY_SIZE 3 ECU_ADDRESS 0x400E3054 /end MEASUREMENT
/begin MEASUREMENT MCore_cat30 "" UWORD DefaultIdenticalCompu 1 100 0.0 65535.0 ARRAY_SIZE 2 ECU_ADDRESS 0x400E2DB0 /end MEASUREMENT
/begin MEASUREMENT MCore_cat50 "" UWORD DefaultIdenticalCompu 1 100 0.0 65535.0 ARRAY_SIZE 69 ECU_ADDRESS 0x400E305A /end MEASUREMENT
/begin MEASUREMENT MCore_cat52 "" UWORD DefaultIdenticalCompu 1 100 0.0 65535.0 ARRAY_SIZE 12 ECU_ADDRESS 0x400E2C48 /end MEASUREMENT
/begin MEASUREMENT MCore_cat53 "" UWORD DefaultIdenticalCompu 1 100 0.0 65535.0 ARRAY_SIZE 5 ECU_ADDRESS 0x400E30E4 /end MEASUREMENT
/begin MEASUREMENT MCore_cat54 "" UWORD DefaultIdenticalCompu 1 100 0.0 65535.0 ARRAY_SIZE 54 ECU_ADDRESS 0x400E2DB4 /end MEASUREMENT
/begin MEASUREMENT MCore_flgVehSpdErr_0 "Boolean" UBYTE Methods_boolean 1 100 0.0 1.0 MAX_REFRESH 4 1 ECU_ADDRESS 0x5280D31F /end MEASUREMENT
/begin MEASUREMENT MCore_vVehSpd_0 "unsigned integer 16bit" UWORD DefaultIdenticalCompu 1 100 0.0 65535.0 MAX_REFRESH 4 1 ECU_ADDRESS 0x1223AEE /end MEASUREMENT
/begin MEASUREMENT MCore_cat12processed "" UWORD DefaultIdenticalCompu 1 100 0.0 65535.0 ARRAY_SIZE 12 ECU_ADDRESS 0x400E2C60 /end MEASUREMENT
/begin MEASUREMENT MCore_cat2processed "" UWORD DefaultIdenticalCompu 1 100 0.0 65535.0 ARRAY_SIZE 54 ECU_ADDRESS 0x400E2E20 /end MEASUREMENT
/begin MEASUREMENT MCore_cat3processed "" UWORD DefaultIdenticalCompu 1 100 0.0 65535.0 ARRAY_SIZE 2 ECU_ADDRESS 0x400E2E8C /end MEASUREMENT
/begin MEASUREMENT MCore_TesterValue_u8_3 "unsigned integer 8bit" UBYTE VW_BCM_CompuMethods_SC_F1_O0_UNoUnit 1 100 0.0 255.0 MAX_REFRESH 4 1 ECU_ADDRESS 0x400E3AFF /end MEASUREMENT
/begin MEASUREMENT MCore_TesterValue_u8_4 "unsigned integer 8bit" UBYTE VW_BCM_CompuMethods_SC_F1_O0_UNoUnit 1 100 0.0 255.0 MAX_REFRESH 4 1 ECU_ADDRESS 0x400E3B01 /end MEASUREMENT
/begin MEASUREMENT MCore_VF663_HW_FrontFanThsld "unsigned integer 8bit" UBYTE VW_BCM_CompuMethods_SC_F1_O0_UNoUnit 1 100 0.0 255.0 MAX_REFRESH 4 1 ECU_ADDRESS 0x400E3B02 /end MEASUREMENT
/begin MEASUREMENT MCore_VF663_HW_RearFanThsld "unsigned integer 8bit" UBYTE VW_BCM_CompuMethods_SC_F1_O0_UNoUnit 1 100 0.0 255.0 MAX_REFRESH 4 1 ECU_ADDRESS 0x400E3B03 /end MEASUREMENT
/begin MEASUREMENT MCore_UserPresence "Boolean" UBYTE Methods_boolean 1 100 0.0 1.0 MAX_REFRESH 4 1 ECU_ADDRESS 0x400E3B39 /end MEASUREMENT
/begin MEASUREMENT MCore_NBCActivityInProgress "Boolean" UBYTE Methods_boolean 1 100 0.0 1.0 MAX_REFRESH 4 1 ECU_ADDRESS 0x400E3B3A /end MEASUREMENT
/begin MEASUREMENT MCore_DeABSSts_0 "unsigned integer 8bit" UBYTE VW_BCM_CompuMethods_SC_F1_O0_UNoUnit 1 100 0.0 255.0 MAX_REFRESH 4 1 ECU_ADDRESS 0x400E3B3B /end MEASUREMENT
/begin MEASUREMENT MCore_DeEPBSts "unsigned integer 8bit" UBYTE VW_BCM_CompuMethods_SC_F1_O0_UNoUnit 1 100 0.0 255.0 MAX_REFRESH 4 1 ECU_ADDRESS 0x400E3B3C /end MEASUREMENT
/begin MEASUREMENT MCore_DriverMirrorHorizPosRsp_0 "unsigned integer 8bit" UBYTE VW_BCM_CompuMethods_SC_F1_O0_UNoUnit 1 100 0.0 255.0 MAX_REFRESH 4 1 ECU_ADDRESS 0x400E3B3D /end MEASUREMENT
/begin MEASUREMENT MCore_DriverMirrorVertPosRsp_0 "unsigned integer 8bit" UBYTE VW_BCM_CompuMethods_SC_F1_O0_UNoUnit 1 100 0.0 255.0 MAX_REFRESH 4 1 ECU_ADDRESS 0x400E3B3E /end MEASUREMENT
/begin MEASUREMENT MCore_PsngrMirrorHorizPosRsp_0 "unsigned integer 8bit" UBYTE VW_BCM_CompuMethods_SC_F1_O0_UNoUnit 1 100 0.0 255.0 MAX_REFRESH 4 1 ECU_ADDRESS 0x400E3B3F /end MEASUREMENT
/begin MEASUREMENT MCore_PsngrMirrorVertPosRsp_0 "unsigned integer 8bit" UBYTE VW_BCM_CompuMethods_SC_F1_O0_UNoUnit 1 100 0.0 255.0 MAX_REFRESH 4 1 ECU_ADDRESS 0x400E3B40 /end MEASUREMENT
/begin MEASUREMENT MCore_DeRearLightAlignment_Button_0 "" UBYTE CompuMethod_CM_VF078_Button_Status 1 100 0.0 255.0 MAX_REFRESH 4 1 ECU_ADDRESS 0x400E3B41 /end MEASUREMENT
/begin MEASUREMENT MCore_RainSensorActive_1 "Boolean" UBYTE Methods_boolean 1 100 0.0 1.0 MAX_REFRESH 4 1 ECU_ADDRESS 0x400E3B43 /end MEASUREMENT
/begin MEASUREMENT MCore_VF868_RimHeatingFbk_0 "" UBYTE App_3rdParty_CompuMethode_CM_RimHeatingFbk 1 100 0.0 255.0 MAX_REFRESH 4 1 ECU_ADDRESS 0x400E3B44 /end MEASUREMENT
/begin MEASUREMENT MCore_ACCSystemSts "unsigned integer 8bit" UBYTE VW_BCM_CompuMethods_SC_F1_O0_UNoUnit 1 100 0.0 255.0 MAX_REFRESH 4 1 ECU_ADDRESS 0x400E3B45 /end MEASUREMENT
/begin MEASUREMENT MCore_SlopeValidData "Boolean" UBYTE Methods_boolean 1 100 0.0 1.0 MAX_REFRESH 4 1 ECU_ADDRESS 0x400E3B47 /end MEASUREMENT
/begin MEASUREMENT MCore_VF916_DriverWindowSts_0 "unsigned integer 8bit" UBYTE VW_BCM_CompuMethods_SC_F1_O0_UNoUnit 1 100 0.0 255.0 MAX_REFRESH 4 1 ECU_ADDRESS 0x400E3B49 /end MEASUREMENT
/begin MEASUREMENT MCore_Wing1_Fbk_Pos_FailSts_0 "Boolean" UBYTE Methods_boolean 1 100 0.0 1.0 MAX_REFRESH 4 1 ECU_ADDRESS 0x400E3B4B /end MEASUREMENT
/begin MEASUREMENT MCore_Wing2_Fbk_Pos_FailSts "Boolean" UBYTE Methods_boolean 1 100 0.0 1.0 MAX_REFRESH 4 1 ECU_ADDRESS 0x400E3B4D /end MEASUREMENT
/begin MEASUREMENT MCore_Wing3_Fbk_Pos_FailSts "Boolean" UBYTE Methods_boolean 1 100 0.0 1.0 MAX_REFRESH 4 1 ECU_ADDRESS 0x400E3B4F /end MEASUREMENT
/begin MEASUREMENT MCore_Wing4_Fbk_Pos_FailSts "Boolean" UBYTE Methods_boolean 1 100 0.0 1.0 MAX_REFRESH 4 1 ECU_ADDRESS 0x400E3B51 /end MEASUREMENT
/begin MEASUREMENT MCore_VF916_PsngrWindowSts_0 "unsigned integer 8bit" UBYTE VW_BCM_CompuMethods_SC_F1_O0_UNoUnit 1 100 0.0 255.0 MAX_REFRESH 4 1 ECU_ADDRESS 0x400E3B52 /end MEASUREMENT
/begin MEASUREMENT MCore_RBlowerSpeed10L "unsigned integer 8bit" UBYTE VW_BCM_CompuMethods_SC_F1_O0_UNoUnit 1 100 0.0 255.0 MAX_REFRESH 4 1 ECU_ADDRESS 0x400E3B53 /end MEASUREMENT
/begin MEASUREMENT MCore_VF916_RearLeftWindowSts_0 "unsigned integer 8bit" UBYTE VW_BCM_CompuMethods_SC_F1_O0_UNoUnit 1 100 0.0 255.0 MAX_REFRESH 4 1 ECU_ADDRESS 0x400E3B54 /end MEASUREMENT
/begin MEASUREMENT MCore_VF916_RearRightWindowSts_0 "unsigned integer 8bit" UBYTE VW_BCM_CompuMethods_SC_F1_O0_UNoUnit 1 100 0.0 255.0 MAX_REFRESH 4 1 ECU_ADDRESS 0x400E3B55 /end MEASUREMENT
/begin MEASUREMENT MCore_DriverSeatBackRestPos_1 "unsigned integer 8bit" UBYTE VW_BCM_CompuMethods_SC_F1_O0_UNoUnit 1 100 0.0 255.0 MAX_REFRESH 4 1 ECU_ADDRESS 0x400E3B56 /end MEASUREMENT
/begin MEASUREMENT MCore_DriverSeatLiftPos_1 "unsigned integer 8bit" UBYTE VW_BCM_CompuMethods_SC_F1_O0_UNoUnit 1 100 0.0 255.0 MAX_REFRESH 4 1 ECU_ADDRESS 0x400E3B57 /end MEASUREMENT
/begin MEASUREMENT MCore_DriverSeatLongitudinalPos_1 "unsigned integer 8bit" UBYTE VW_BCM_CompuMethods_SC_F1_O0_UNoUnit 1 100 0.0 255.0 MAX_REFRESH 4 1 ECU_ADDRESS 0x400E3B58 /end MEASUREMENT
/begin MEASUREMENT MCore_DriverSeatTiltPos_1 "unsigned integer 8bit" UBYTE VW_BCM_CompuMethods_SC_F1_O0_UNoUnit 1 100 0.0 255.0 MAX_REFRESH 4 1 ECU_ADDRESS 0x400E3B59 /end MEASUREMENT
/begin MEASUREMENT MCore_PsngrSeatBackRestPos_1 "unsigned integer 8bit" UBYTE VW_BCM_CompuMethods_SC_F1_O0_UNoUnit 1 100 0.0 255.0 MAX_REFRESH 4 1 ECU_ADDRESS 0x400E3B5A /end MEASUREMENT
/begin MEASUREMENT MCore_PsngrSeatLiftPos_1 "unsigned integer 8bit" UBYTE VW_BCM_CompuMethods_SC_F1_O0_UNoUnit 1 100 0.0 255.0 MAX_REFRESH 4 1 ECU_ADDRESS 0x400E3B5B /end MEASUREMENT
/begin MEASUREMENT MCore_PsngrSeatLongitudinalPos_1 "unsigned integer 8bit" UBYTE VW_BCM_CompuMethods_SC_F1_O0_UNoUnit 1 100 0.0 255.0 MAX_REFRESH 4 1 ECU_ADDRESS 0x400E3B5C /end MEASUREMENT
/begin MEASUREMENT MCore_PsngrSeatTiltPos_1 "unsigned integer 8bit" UBYTE VW_BCM_CompuMethods_SC_F1_O0_UNoUnit 1 100 0.0 255.0 MAX_REFRESH 4 1 ECU_ADDRESS 0x400E3B5D /end MEASUREMENT
/begin MEASUREMENT MCore_AirConditionCompressor "Boolean" UBYTE Methods_boolean 1 100 0.0 1.0 MAX_REFRESH 4 1 ECU_ADDRESS 0x400E3B5E /end MEASUREMENT
/begin MEASUREMENT MCore_BlowerSpeed10L "unsigned integer 8bit" UBYTE VW_BCM_CompuMethods_SC_F1_O0_UNoUnit 1 100 0.0 255.0 MAX_REFRESH 4 1 ECU_ADDRESS 0x400E3B5F /end MEASUREMENT
/begin MEASUREMENT MCore_RearSeatLeftLiftPos_1 "unsigned integer 8bit" UBYTE VW_BCM_CompuMethods_SC_F1_O0_UNoUnit 1 100 0.0 255.0 MAX_REFRESH 4 1 ECU_ADDRESS 0x400E3B60 /end MEASUREMENT
/begin MEASUREMENT MCore_RearSeatLeftLongitudinalPos_1 "unsigned integer 8bit" UBYTE VW_BCM_CompuMethods_SC_F1_O0_UNoUnit 1 100 0.0 255.0 MAX_REFRESH 4 1 ECU_ADDRESS 0x400E3B61 /end MEASUREMENT
/begin MEASUREMENT MCore_RearSeatLeftTiltPos_1 "unsigned integer 8bit" UBYTE VW_BCM_CompuMethods_SC_F1_O0_UNoUnit 1 100 0.0 255.0 MAX_REFRESH 4 1 ECU_ADDRESS 0x400E3B62 /end MEASUREMENT
/begin MEASUREMENT MCore_RearSeatRightLiftPos_1 "unsigned integer 8bit" UBYTE VW_BCM_CompuMethods_SC_F1_O0_UNoUnit 1 100 0.0 255.0 MAX_REFRESH 4 1 ECU_ADDRESS 0x400E3B63 /end MEASUREMENT
/begin MEASUREMENT MCore_RearSeatRightLongitudinalPos_1 "unsigned integer 8bit" UBYTE VW_BCM_CompuMethods_SC_F1_O0_UNoUnit 1 100 0.0 255.0 MAX_REFRESH 4 1 ECU_ADDRESS 0x400E3B64 /end MEASUREMENT
/begin MEASUREMENT MCore_RearSeatRightTiltPos_1 "unsigned integer 8bit" UBYTE VW_BCM_CompuMethods_SC_F1_O0_UNoUnit 1 100 0.0 255.0 MAX_REFRESH 4 1 ECU_ADDRESS 0x400E3B65 /end MEASUREMENT
/begin MEASUREMENT MCore_FuelFlapSts "Boolean" UBYTE Methods_boolean 1 100 0.0 1.0 MAX_REFRESH 4 1 ECU_ADDRESS 0x400E3B66 /end MEASUREMENT
/begin MEASUREMENT MCore_CapoteFailSts_6 "unsigned integer 8bit" UBYTE VW_BCM_CompuMethods_SC_F1_O0_UNoUnit 1 100 0.0 255.0 MAX_REFRESH 4 1 ECU_ADDRESS 0x400E3B67 /end MEASUREMENT
/begin MEASUREMENT MCore_StMon_391 "" UBYTE DefaultIdenticalCompu 1 100 0.0 255.0 MAX_REFRESH 4 1 ECU_ADDRESS 0x400E3B69
 /begin ANNOTATION ANNOTATION_LABEL "Description (coming from AUTOSAR DESC field)"
  /begin ANNOTATION_TEXT "Application data type for error type data elements. Error types are bit coded\r\n" /end ANNOTATION_TEXT
 /end ANNOTATION
/end MEASUREMENT
/begin MEASUREMENT MCore_StMon_392 "" UBYTE DefaultIdenticalCompu 1 100 0.0 255.0 MAX_REFRESH 4 1 ECU_ADDRESS 0x400E3B6A
 /begin ANNOTATION ANNOTATION_LABEL "Description (coming from AUTOSAR DESC field)"
  /begin ANNOTATION_TEXT "Application data type for error type data elements. Error types are bit coded\r\n" /end ANNOTATION_TEXT
 /end ANNOTATION
/end MEASUREMENT
/begin MEASUREMENT MCore_StMon_393 "" UBYTE DefaultIdenticalCompu 1 100 0.0 255.0 MAX_REFRESH 4 1 ECU_ADDRESS 0x400E3B6B
 /begin ANNOTATION ANNOTATION_LABEL "Description (coming from AUTOSAR DESC field)"
  /begin ANNOTATION_TEXT "Application data type for error type data elements. Error types are bit coded\r\n" /end ANNOTATION_TEXT
 /end ANNOTATION
/end MEASUREMENT
/begin MEASUREMENT MCore_StMon_394 "" UBYTE DefaultIdenticalCompu 1 100 0.0 255.0 MAX_REFRESH 4 1 ECU_ADDRESS 0x400E3B6C
 /begin ANNOTATION ANNOTATION_LABEL "Description (coming from AUTOSAR DESC field)"
  /begin ANNOTATION_TEXT "Application data type for error type data elements. Error types are bit coded\r\n" /end ANNOTATION_TEXT
 /end ANNOTATION
/end MEASUREMENT
/begin MEASUREMENT MCore_StMon_395 "" UBYTE DefaultIdenticalCompu 1 100 0.0 255.0 MAX_REFRESH 4 1 ECU_ADDRESS 0x400E3B6D
 /begin ANNOTATION ANNOTATION_LABEL "Description (coming from AUTOSAR DESC field)"
  /begin ANNOTATION_TEXT "Application data type for error type data elements. Error types are bit coded\r\n" /end ANNOTATION_TEXT
 /end ANNOTATION
/end MEASUREMENT
/begin MEASUREMENT MCore_StMon_396 "" UBYTE DefaultIdenticalCompu 1 100 0.0 255.0 MAX_REFRESH 4 1 ECU_ADDRESS 0x400E3B6E
 /begin ANNOTATION ANNOTATION_LABEL "Description (coming from AUTOSAR DESC field)"
  /begin ANNOTATION_TEXT "Application data type for error type data elements. Error types are bit coded\r\n" /end ANNOTATION_TEXT
 /end ANNOTATION
/end MEASUREMENT
/begin MEASUREMENT MCore_StMon_397 "" UBYTE DefaultIdenticalCompu 1 100 0.0 255.0 MAX_REFRESH 4 1 ECU_ADDRESS 0x400E3B6F
 /begin ANNOTATION ANNOTATION_LABEL "Description (coming from AUTOSAR DESC field)"
  /begin ANNOTATION_TEXT "Application data type for error type data elements. Error types are bit coded\r\n" /end ANNOTATION_TEXT
 /end ANNOTATION
/end MEASUREMENT
/begin MEASUREMENT MCore_StMon_398 "" UBYTE DefaultIdenticalCompu 1 100 0.0 255.0 MAX_REFRESH 4 1 ECU_ADDRESS 0x400E3B70
 /begin ANNOTATION ANNOTATION_LABEL "Description (coming from AUTOSAR DESC field)"
  /begin ANNOTATION_TEXT "Application data type for error type data elements. Error types are bit coded\r\n" /end ANNOTATION_TEXT
 /end ANNOTATION
/end MEASUREMENT
/begin MEASUREMENT MCore_StMon_399 "" UBYTE DefaultIdenticalCompu 1 100 0.0 255.0 MAX_REFRESH 4 1 ECU_ADDRESS 0x400E3B71
 /begin ANNOTATION ANNOTATION_LABEL "Description (coming from AUTOSAR DESC field)"
  /begin ANNOTATION_TEXT "Application data type for error type data elements. Error types are bit coded\r\n" /end ANNOTATION_TEXT
 /end ANNOTATION
/end MEASUREMENT
/begin MEASUREMENT MCore_StMon_400 "" UBYTE DefaultIdenticalCompu 1 100 0.0 255.0 MAX_REFRESH 4 1 ECU_ADDRESS 0x400E3B72
 /begin ANNOTATION ANNOTATION_LABEL "Description (coming from AUTOSAR DESC field)"
  /begin ANNOTATION_TEXT "Application data type for error type data elements. Error types are bit coded\r\n" /end ANNOTATION_TEXT
 /end ANNOTATION
/end MEASUREMENT
/begin MEASUREMENT MCore_StMon_401 "" UBYTE DefaultIdenticalCompu 1 100 0.0 255.0 MAX_REFRESH 4 1 ECU_ADDRESS 0x400E3B73
 /begin ANNOTATION ANNOTATION_LABEL "Description (coming from AUTOSAR DESC field)"
  /begin ANNOTATION_TEXT "Application data type for error type data elements. Error types are bit coded\r\n" /end ANNOTATION_TEXT
 /end ANNOTATION
/end MEASUREMENT
/begin MEASUREMENT MCore_StMon_402 "" UBYTE DefaultIdenticalCompu 1 100 0.0 255.0 MAX_REFRESH 4 1 ECU_ADDRESS 0x400E3B74
 /begin ANNOTATION ANNOTATION_LABEL "Description (coming from AUTOSAR DESC field)"
  /begin ANNOTATION_TEXT "Application data type for error type data elements. Error types are bit coded\r\n" /end ANNOTATION_TEXT
 /end ANNOTATION
/end MEASUREMENT
/begin MEASUREMENT MCore_StMon_403 "" UBYTE DefaultIdenticalCompu 1 100 0.0 255.0 MAX_REFRESH 4 1 ECU_ADDRESS 0x400E3B75
 /begin ANNOTATION ANNOTATION_LABEL "Description (coming from AUTOSAR DESC field)"
  /begin ANNOTATION_TEXT "Application data type for error type data elements. Error types are bit coded\r\n" /end ANNOTATION_TEXT
 /end ANNOTATION
/end MEASUREMENT
/begin MEASUREMENT MCore_StMon_404 "" UBYTE DefaultIdenticalCompu 1 100 0.0 255.0 MAX_REFRESH 4 1 ECU_ADDRESS 0x400E3B76
 /begin ANNOTATION ANNOTATION_LABEL "Description (coming from AUTOSAR DESC field)"
  /begin ANNOTATION_TEXT "Application data type for error type data elements. Error types are bit coded\r\n" /end ANNOTATION_TEXT
 /end ANNOTATION
/end MEASUREMENT
/begin MEASUREMENT MCore_StMon_405 "" UBYTE DefaultIdenticalCompu 1 100 0.0 255.0 MAX_REFRESH 4 1 ECU_ADDRESS 0x400E3B77
 /begin ANNOTATION ANNOTATION_LABEL "Description (coming from AUTOSAR DESC field)"
  /begin ANNOTATION_TEXT "Application data type for error type data elements. Error types are bit coded\r\n" /end ANNOTATION_TEXT
 /end ANNOTATION
/end MEASUREMENT
/begin MEASUREMENT MCore_StMon_406 "" UBYTE DefaultIdenticalCompu 1 100 0.0 255.0 MAX_REFRESH 4 1 ECU_ADDRESS 0x400E3B78
 /begin ANNOTATION ANNOTATION_LABEL "Description (coming from AUTOSAR DESC field)"
  /begin ANNOTATION_TEXT "Application data type for error type data elements. Error types are bit coded\r\n" /end ANNOTATION_TEXT
 /end ANNOTATION
/end MEASUREMENT
/begin MEASUREMENT MCore_StMon_407 "" UBYTE DefaultIdenticalCompu 1 100 0.0 255.0 MAX_REFRESH 4 1 ECU_ADDRESS 0x400E3B79
 /begin ANNOTATION ANNOTATION_LABEL "Description (coming from AUTOSAR DESC field)"
  /begin ANNOTATION_TEXT "Application data type for error type data elements. Error types are bit coded\r\n" /end ANNOTATION_TEXT
 /end ANNOTATION
/end MEASUREMENT
/begin MEASUREMENT MCore_StMon_408 "" UBYTE DefaultIdenticalCompu 1 100 0.0 255.0 MAX_REFRESH 4 1 ECU_ADDRESS 0x400E3B7A
 /begin ANNOTATION ANNOTATION_LABEL "Description (coming from AUTOSAR DESC field)"
  /begin ANNOTATION_TEXT "Application data type for error type data elements. Error types are bit coded\r\n" /end ANNOTATION_TEXT
 /end ANNOTATION
/end MEASUREMENT
/begin MEASUREMENT MCore_StMon_409 "" UBYTE DefaultIdenticalCompu 1 100 0.0 255.0 MAX_REFRESH 4 1 ECU_ADDRESS 0x400E3B7B
 /begin ANNOTATION ANNOTATION_LABEL "Description (coming from AUTOSAR DESC field)"
  /begin ANNOTATION_TEXT "Application data type for error type data elements. Error types are bit coded\r\n" /end ANNOTATION_TEXT
 /end ANNOTATION
/end MEASUREMENT
/begin MEASUREMENT MCore_StMon_410 "" UBYTE DefaultIdenticalCompu 1 100 0.0 255.0 MAX_REFRESH 4 1 ECU_ADDRESS 0x400E3B7C
 /begin ANNOTATION ANNOTATION_LABEL "Description (coming from AUTOSAR DESC field)"
  /begin ANNOTATION_TEXT "Application data type for error type data elements. Error types are bit coded\r\n" /end ANNOTATION_TEXT
 /end ANNOTATION
/end MEASUREMENT
/begin MEASUREMENT MCore_StMon_411 "" UBYTE DefaultIdenticalCompu 1 100 0.0 255.0 MAX_REFRESH 4 1 ECU_ADDRESS 0x400E3B7D
 /begin ANNOTATION ANNOTATION_LABEL "Description (coming from AUTOSAR DESC field)"
  /begin ANNOTATION_TEXT "Application data type for error type data elements. Error types are bit coded\r\n" /end ANNOTATION_TEXT
 /end ANNOTATION
/end MEASUREMENT
/begin MEASUREMENT MCore_AXSStat_0 "unsigned integer 8bit" UBYTE VW_BCM_CompuMethods_SC_F1_O0_UNoUnit 1 100 0.0 255.0 MAX_REFRESH 4 1 ECU_ADDRESS 0x400E3B84 /end MEASUREMENT
/begin MEASUREMENT MCore_AYSStat_0 "unsigned integer 8bit" UBYTE VW_BCM_CompuMethods_SC_F1_O0_UNoUnit 1 100 0.0 255.0 MAX_REFRESH 4 1 ECU_ADDRESS 0x400E3B85 /end MEASUREMENT
/begin MEASUREMENT MCore_DeExpired "" UBYTE Methods_boolean 1 100 0.0 255.0 MAX_REFRESH 3 5 ECU_ADDRESS 0x400E392E
 /begin ANNOTATION ANNOTATION_LABEL "Description (coming from AUTOSAR DESC field)" /begin ANNOTATION_TEXT "Data indicating the alarm expiration.\r\n" /end ANNOTATION_TEXT /end ANNOTATION
/end MEASUREMENT
/begin MEASUREMENT MCore_DeExpired_0 "" UBYTE Methods_boolean 1 100 0.0 255.0 MAX_REFRESH 3 5 ECU_ADDRESS 0x400E392F
 /begin ANNOTATION ANNOTATION_LABEL "Description (coming from AUTOSAR DESC field)" /begin ANNOTATION_TEXT "Data indicating the alarm expiration.\r\n" /end ANNOTATION_TEXT /end ANNOTATION
/end MEASUREMENT
/begin MEASUREMENT MCore_DeExpired_1 "" UBYTE Methods_boolean 1 100 0.0 255.0 MAX_REFRESH 3 5 ECU_ADDRESS 0x400E3930
 /begin ANNOTATION ANNOTATION_LABEL "Description (coming from AUTOSAR DESC field)" /begin ANNOTATION_TEXT "Data indicating the alarm expiration.\r\n" /end ANNOTATION_TEXT /end ANNOTATION
/end MEASUREMENT
/begin MEASUREMENT MCore_DeExpired_2 "" UBYTE Methods_boolean 1 100 0.0 255.0 MAX_REFRESH 3 5 ECU_ADDRESS 0x400E3931
 /begin ANNOTATION ANNOTATION_LABEL "Description (coming from AUTOSAR DESC field)" /begin ANNOTATION_TEXT "Data indicating the alarm expiration.\r\n" /end ANNOTATION_TEXT /end ANNOTATION
/end MEASUREMENT
/begin MEASUREMENT MCore_DeExpired_3 "" UBYTE Methods_boolean 1 100 0.0 255.0 MAX_REFRESH 3 5 ECU_ADDRESS 0x400E3932
 /begin ANNOTATION ANNOTATION_LABEL "Description (coming from AUTOSAR DESC field)" /begin ANNOTATION_TEXT "Data indicating the alarm expiration.\r\n" /end ANNOTATION_TEXT /end ANNOTATION
/end MEASUREMENT
/begin MEASUREMENT MCore_DeExpired_4 "" UBYTE Methods_boolean 1 100 0.0 255.0 MAX_REFRESH 3 5 ECU_ADDRESS 0x400E3933
 /begin ANNOTATION ANNOTATION_LABEL "Description (coming from AUTOSAR DESC field)" /begin ANNOTATION_TEXT "Data indicating the alarm expiration.\r\n" /end ANNOTATION_TEXT /end ANNOTATION
/end MEASUREMENT
/begin MEASUREMENT MCore_DeExpired_5 "" UBYTE Methods_boolean 1 100 0.0 255.0 MAX_REFRESH 3 5 ECU_ADDRESS 0x400E3934
 /begin ANNOTATION ANNOTATION_LABEL "Description (coming from AUTOSAR DESC field)" /begin ANNOTATION_TEXT "Data indicating the alarm expiration.\r\n" /end ANNOTATION_TEXT /end ANNOTATION
/end MEASUREMENT
/begin MEASUREMENT MCore_DeExpired_6 "" UBYTE Methods_boolean 1 100 0.0 255.0 MAX_REFRESH 3 5 ECU_ADDRESS 0x400E3935
 /begin ANNOTATION ANNOTATION_LABEL "Description (coming from AUTOSAR DESC field)" /begin ANNOTATION_TEXT "Data indicating the alarm expiration.\r\n" /end ANNOTATION_TEXT /end ANNOTATION
/end MEASUREMENT
/begin MEASUREMENT MCore_DeExpired_7 "" UBYTE Methods_boolean 1 100 0.0 255.0 MAX_REFRESH 3 5 ECU_ADDRESS 0x400E3936
 /begin ANNOTATION ANNOTATION_LABEL "Description (coming from AUTOSAR DESC field)" /begin ANNOTATION_TEXT "Data indicating the alarm expiration.\r\n" /end ANNOTATION_TEXT /end ANNOTATION
/end MEASUREMENT
/begin MEASUREMENT MCore_DeExpired_8 "" UBYTE Methods_boolean 1 100 0.0 255.0 MAX_REFRESH 3 5 ECU_ADDRESS 0x400E3937
 /begin ANNOTATION ANNOTATION_LABEL "Description (coming from AUTOSAR DESC field)" /begin ANNOTATION_TEXT "Data indicating the alarm expiration.\r\n" /end ANNOTATION_TEXT /end ANNOTATION
/end MEASUREMENT
/begin MEASUREMENT MCore_DeExpired_9 "" UBYTE Methods_boolean 1 100 0.0 255.0 MAX_REFRESH 3 5 ECU_ADDRESS 0x400E3938
 /begin ANNOTATION ANNOTATION_LABEL "Description (coming from AUTOSAR DESC field)" /begin ANNOTATION_TEXT "Data indicating the alarm expiration.\r\n" /end ANNOTATION_TEXT /end ANNOTATION
/end MEASUREMENT
/begin MEASUREMENT MCore_DeExpired_10 "" UBYTE Methods_boolean 1 100 0.0 255.0 MAX_REFRESH 3 5 ECU_ADDRESS 0x400E3939
 /begin ANNOTATION ANNOTATION_LABEL "Description (coming from AUTOSAR DESC field)" /begin ANNOTATION_TEXT "Data indicating the alarm expiration.\r\n" /end ANNOTATION_TEXT /end ANNOTATION
/end MEASUREMENT
/begin MEASUREMENT MCore_DeExpired_11 "" UBYTE Methods_boolean 1 100 0.0 255.0 MAX_REFRESH 3 5 ECU_ADDRESS 0x400E393A
 /begin ANNOTATION ANNOTATION_LABEL "Description (coming from AUTOSAR DESC field)" /begin ANNOTATION_TEXT "Data indicating the alarm expiration.\r\n" /end ANNOTATION_TEXT /end ANNOTATION
/end MEASUREMENT
/begin MEASUREMENT MCore_DeExpired_12 "" UBYTE Methods_boolean 1 100 0.0 255.0 MAX_REFRESH 3 5 ECU_ADDRESS 0x400E393B
 /begin ANNOTATION ANNOTATION_LABEL "Description (coming from AUTOSAR DESC field)" /begin ANNOTATION_TEXT "Data indicating the alarm expiration.\r\n" /end ANNOTATION_TEXT /end ANNOTATION
/end MEASUREMENT
/begin MEASUREMENT MCore_DeExpired_13 "" UBYTE Methods_boolean 1 100 0.0 255.0 MAX_REFRESH 3 5 ECU_ADDRESS 0x400E393C
 /begin ANNOTATION ANNOTATION_LABEL "Description (coming from AUTOSAR DESC field)" /begin ANNOTATION_TEXT "Data indicating the alarm expiration.\r\n" /end ANNOTATION_TEXT /end ANNOTATION
/end MEASUREMENT
/begin MEASUREMENT MCore_DeExpired_14 "" UBYTE Methods_boolean 1 100 0.0 255.0 MAX_REFRESH 3 5 ECU_ADDRESS 0x400E393D
 /begin ANNOTATION ANNOTATION_LABEL "Description (coming from AUTOSAR DESC field)" /begin ANNOTATION_TEXT "Data indicating the alarm expiration.\r\n" /end ANNOTATION_TEXT /end ANNOTATION
/end MEASUREMENT
/begin MEASUREMENT MCore_DeExpired_15 "" UBYTE Methods_boolean 1 100 0.0 255.0 MAX_REFRESH 3 5 ECU_ADDRESS 0x400E393E
 /begin ANNOTATION ANNOTATION_LABEL "Description (coming from AUTOSAR DESC field)" /begin ANNOTATION_TEXT "Data indicating the alarm expiration.\r\n" /end ANNOTATION_TEXT /end ANNOTATION
/end MEASUREMENT
/begin MEASUREMENT MCore_DeExpired_16 "" UBYTE Methods_boolean 1 100 0.0 255.0 MAX_REFRESH 3 5 ECU_ADDRESS 0x400E393F
 /begin ANNOTATION ANNOTATION_LABEL "Description (coming from AUTOSAR DESC field)" /begin ANNOTATION_TEXT "Data indicating the alarm expiration.\r\n" /end ANNOTATION_TEXT /end ANNOTATION
/end MEASUREMENT
/begin MEASUREMENT MCore_DeExpired_17 "" UBYTE Methods_boolean 1 100 0.0 255.0 MAX_REFRESH 3 5 ECU_ADDRESS 0x400E3940
 /begin ANNOTATION ANNOTATION_LABEL "Description (coming from AUTOSAR DESC field)" /begin ANNOTATION_TEXT "Data indicating the alarm expiration.\r\n" /end ANNOTATION_TEXT /end ANNOTATION
/end MEASUREMENT
/begin MEASUREMENT MCore_DeExpired_18 "" UBYTE Methods_boolean 1 100 0.0 255.0 MAX_REFRESH 3 5 ECU_ADDRESS 0x400E3941
 /begin ANNOTATION ANNOTATION_LABEL "Description (coming from AUTOSAR DESC field)" /begin ANNOTATION_TEXT "Data indicating the alarm expiration.\r\n" /end ANNOTATION_TEXT /end ANNOTATION
/end MEASUREMENT
/begin MEASUREMENT MCore_DeExpired_19 "" UBYTE Methods_boolean 1 100 0.0 255.0 MAX_REFRESH 3 5 ECU_ADDRESS 0x400E3942
 /begin ANNOTATION ANNOTATION_LABEL "Description (coming from AUTOSAR DESC field)" /begin ANNOTATION_TEXT "Data indicating the alarm expiration.\r\n" /end ANNOTATION_TEXT /end ANNOTATION
/end MEASUREMENT
/begin MEASUREMENT MCore_DeExpired_20 "" UBYTE Methods_boolean 1 100 0.0 255.0 MAX_REFRESH 3 5 ECU_ADDRESS 0x400E3943
 /begin ANNOTATION ANNOTATION_LABEL "Description (coming from AUTOSAR DESC field)" /begin ANNOTATION_TEXT "Data indicating the alarm expiration.\r\n" /end ANNOTATION_TEXT /end ANNOTATION
/end MEASUREMENT
/begin MEASUREMENT MCore_DeExpired_21 "" UBYTE Methods_boolean 1 100 0.0 255.0 MAX_REFRESH 3 5 ECU_ADDRESS 0x400E3944
 /begin ANNOTATION ANNOTATION_LABEL "Description (coming from AUTOSAR DESC field)" /begin ANNOTATION_TEXT "Data indicating the alarm expiration.\r\n" /end ANNOTATION_TEXT /end ANNOTATION
/end MEASUREMENT
/begin MEASUREMENT MCore_DeExpired_22 "" UBYTE Methods_boolean 1 100 0.0 255.0 MAX_REFRESH 3 5 ECU_ADDRESS 0x400E3945
 /begin ANNOTATION ANNOTATION_LABEL "Description (coming from AUTOSAR DESC field)" /begin ANNOTATION_TEXT "Data indicating the alarm expiration.\r\n" /end ANNOTATION_TEXT /end ANNOTATION
/end MEASUREMENT
/begin MEASUREMENT MCore_DeExpired_23 "" UBYTE Methods_boolean 1 100 0.0 255.0 MAX_REFRESH 3 5 ECU_ADDRESS 0x400E3946
 /begin ANNOTATION ANNOTATION_LABEL "Description (coming from AUTOSAR DESC field)" /begin ANNOTATION_TEXT "Data indicating the alarm expiration.\r\n" /end ANNOTATION_TEXT /end ANNOTATION
/end MEASUREMENT
/begin MEASUREMENT MCore_DeExpired_24 "" UBYTE Methods_boolean 1 100 0.0 255.0 MAX_REFRESH 3 5 ECU_ADDRESS 0x400E3947
 /begin ANNOTATION ANNOTATION_LABEL "Description (coming from AUTOSAR DESC field)" /begin ANNOTATION_TEXT "Data indicating the alarm expiration.\r\n" /end ANNOTATION_TEXT /end ANNOTATION
/end MEASUREMENT
/begin MEASUREMENT MCore_DeExpired_25 "" UBYTE Methods_boolean 1 100 0.0 255.0 MAX_REFRESH 3 5 ECU_ADDRESS 0x400E3948
 /begin ANNOTATION ANNOTATION_LABEL "Description (coming from AUTOSAR DESC field)" /begin ANNOTATION_TEXT "Data indicating the alarm expiration.\r\n" /end ANNOTATION_TEXT /end ANNOTATION
/end MEASUREMENT
/begin MEASUREMENT MCore_DeExpired_26 "" UBYTE Methods_boolean 1 100 0.0 255.0 MAX_REFRESH 3 5 ECU_ADDRESS 0x400E3949
 /begin ANNOTATION ANNOTATION_LABEL "Description (coming from AUTOSAR DESC field)" /begin ANNOTATION_TEXT "Data indicating the alarm expiration.\r\n" /end ANNOTATION_TEXT /end ANNOTATION
/end MEASUREMENT
/begin MEASUREMENT MCore_DeExpired_27 "" UBYTE Methods_boolean 1 100 0.0 255.0 MAX_REFRESH 3 5 ECU_ADDRESS 0x400E394A
 /begin ANNOTATION ANNOTATION_LABEL "Description (coming from AUTOSAR DESC field)" /begin ANNOTATION_TEXT "Data indicating the alarm expiration.\r\n" /end ANNOTATION_TEXT /end ANNOTATION
/end MEASUREMENT
/begin MEASUREMENT MCore_DeExpired_28 "" UBYTE Methods_boolean 1 100 0.0 255.0 MAX_REFRESH 3 5 ECU_ADDRESS 0x400E394B
 /begin ANNOTATION ANNOTATION_LABEL "Description (coming from AUTOSAR DESC field)" /begin ANNOTATION_TEXT "Data indicating the alarm expiration.\r\n" /end ANNOTATION_TEXT /end ANNOTATION
/end MEASUREMENT
/begin MEASUREMENT MCore_DeExpired_29 "" UBYTE Methods_boolean 1 100 0.0 255.0 MAX_REFRESH 3 5 ECU_ADDRESS 0x400E394C
 /begin ANNOTATION ANNOTATION_LABEL "Description (coming from AUTOSAR DESC field)" /begin ANNOTATION_TEXT "Data indicating the alarm expiration.\r\n" /end ANNOTATION_TEXT /end ANNOTATION
/end MEASUREMENT
/begin MEASUREMENT MCore_DeExpired_30 "" UBYTE Methods_boolean 1 100 0.0 255.0 MAX_REFRESH 3 5 ECU_ADDRESS 0x400E394D
 /begin ANNOTATION ANNOTATION_LABEL "Description (coming from AUTOSAR DESC field)" /begin ANNOTATION_TEXT "Data indicating the alarm expiration.\r\n" /end ANNOTATION_TEXT /end ANNOTATION
/end MEASUREMENT
/begin MEASUREMENT MCore_DeExpired_31 "" UBYTE Methods_boolean 1 100 0.0 255.0 MAX_REFRESH 3 5 ECU_ADDRESS 0x400E394E
 /begin ANNOTATION ANNOTATION_LABEL "Description (coming from AUTOSAR DESC field)" /begin ANNOTATION_TEXT "Data indicating the alarm expiration.\r\n" /end ANNOTATION_TEXT /end ANNOTATION
/end MEASUREMENT
/begin MEASUREMENT MCore_DeExpired_32 "" UBYTE Methods_boolean 1 100 0.0 255.0 MAX_REFRESH 3 5 ECU_ADDRESS 0x400E394F
 /begin ANNOTATION ANNOTATION_LABEL "Description (coming from AUTOSAR DESC field)" /begin ANNOTATION_TEXT "Data indicating the alarm expiration.\r\n" /end ANNOTATION_TEXT /end ANNOTATION
/end MEASUREMENT
/begin MEASUREMENT MCore_DeExpired_33 "" UBYTE Methods_boolean 1 100 0.0 255.0 MAX_REFRESH 3 5 ECU_ADDRESS 0x400E3950
 /begin ANNOTATION ANNOTATION_LABEL "Description (coming from AUTOSAR DESC field)" /begin ANNOTATION_TEXT "Data indicating the alarm expiration.\r\n" /end ANNOTATION_TEXT /end ANNOTATION
/end MEASUREMENT
/begin MEASUREMENT MCore_DeExpired_34 "" UBYTE Methods_boolean 1 100 0.0 255.0 MAX_REFRESH 3 5 ECU_ADDRESS 0x400E3951
 /begin ANNOTATION ANNOTATION_LABEL "Description (coming from AUTOSAR DESC field)" /begin ANNOTATION_TEXT "Data indicating the alarm expiration.\r\n" /end ANNOTATION_TEXT /end ANNOTATION
/end MEASUREMENT
/begin MEASUREMENT MCore_DeExpired_35 "" UBYTE Methods_boolean 1 100 0.0 255.0 MAX_REFRESH 3 5 ECU_ADDRESS 0x400E3952
 /begin ANNOTATION ANNOTATION_LABEL "Description (coming from AUTOSAR DESC field)" /begin ANNOTATION_TEXT "Data indicating the alarm expiration.\r\n" /end ANNOTATION_TEXT /end ANNOTATION
/end MEASUREMENT
/begin MEASUREMENT MCore_DeExpired_36 "" UBYTE Methods_boolean 1 100 0.0 255.0 MAX_REFRESH 3 5 ECU_ADDRESS 0x400E3953
 /begin ANNOTATION ANNOTATION_LABEL "Description (coming from AUTOSAR DESC field)" /begin ANNOTATION_TEXT "Data indicating the alarm expiration.\r\n" /end ANNOTATION_TEXT /end ANNOTATION
/end MEASUREMENT
/begin MEASUREMENT MCore_DeExpired_37 "" UBYTE Methods_boolean 1 100 0.0 255.0 MAX_REFRESH 3 5 ECU_ADDRESS 0x400E3954
 /begin ANNOTATION ANNOTATION_LABEL "Description (coming from AUTOSAR DESC field)" /begin ANNOTATION_TEXT "Data indicating the alarm expiration.\r\n" /end ANNOTATION_TEXT /end ANNOTATION
/end MEASUREMENT
/begin MEASUREMENT MCore_DeExpired_38 "" UBYTE Methods_boolean 1 100 0.0 255.0 MAX_REFRESH 3 5 ECU_ADDRESS 0x400E3955
 /begin ANNOTATION ANNOTATION_LABEL "Description (coming from AUTOSAR DESC field)" /begin ANNOTATION_TEXT "Data indicating the alarm expiration.\r\n" /end ANNOTATION_TEXT /end ANNOTATION
/end MEASUREMENT
/begin MEASUREMENT MCore_DeExpired_39 "" UBYTE Methods_boolean 1 100 0.0 255.0 MAX_REFRESH 3 5 ECU_ADDRESS 0x400E3956
 /begin ANNOTATION ANNOTATION_LABEL "Description (coming from AUTOSAR DESC field)" /begin ANNOTATION_TEXT "Data indicating the alarm expiration.\r\n" /end ANNOTATION_TEXT /end ANNOTATION
/end MEASUREMENT
/begin MEASUREMENT MCore_DeExpired_40 "" UBYTE Methods_boolean 1 100 0.0 255.0 MAX_REFRESH 3 5 ECU_ADDRESS 0x400E3191
 /begin ANNOTATION ANNOTATION_LABEL "Description (coming from AUTOSAR DESC field)" /begin ANNOTATION_TEXT "Data indicating the alarm expiration.\r\n" /end ANNOTATION_TEXT /end ANNOTATION
/end MEASUREMENT
/begin MEASUREMENT MCore_DeExpired_41 "" UBYTE Methods_boolean 1 100 0.0 255.0 MAX_REFRESH 3 5 ECU_ADDRESS 0x400E3192
 /begin ANNOTATION ANNOTATION_LABEL "Description (coming from AUTOSAR DESC field)" /begin ANNOTATION_TEXT "Data indicating the alarm expiration.\r\n" /end ANNOTATION_TEXT /end ANNOTATION
/end MEASUREMENT
/begin MEASUREMENT MCore_DeExpired_42 "" UBYTE Methods_boolean 1 100 0.0 255.0 MAX_REFRESH 3 5 ECU_ADDRESS 0x400E3193
 /begin ANNOTATION ANNOTATION_LABEL "Description (coming from AUTOSAR DESC field)" /begin ANNOTATION_TEXT "Data indicating the alarm expiration.\r\n" /end ANNOTATION_TEXT /end ANNOTATION
/end MEASUREMENT
/begin MEASUREMENT MCore_DeExpired_43 "" UBYTE Methods_boolean 1 100 0.0 255.0 MAX_REFRESH 3 5 ECU_ADDRESS 0x400E3194
 /begin ANNOTATION ANNOTATION_LABEL "Description (coming from AUTOSAR DESC field)" /begin ANNOTATION_TEXT "Data indicating the alarm expiration.\r\n" /end ANNOTATION_TEXT /end ANNOTATION
/end MEASUREMENT
/begin MEASUREMENT MCore_DeExpired_44 "" UBYTE Methods_boolean 1 100 0.0 255.0 MAX_REFRESH 3 5 ECU_ADDRESS 0x400E3195
 /begin ANNOTATION ANNOTATION_LABEL "Description (coming from AUTOSAR DESC field)" /begin ANNOTATION_TEXT "Data indicating the alarm expiration.\r\n" /end ANNOTATION_TEXT /end ANNOTATION
/end MEASUREMENT
/begin MEASUREMENT MCore_DeExpired_45 "" UBYTE Methods_boolean 1 100 0.0 255.0 MAX_REFRESH 3 5 ECU_ADDRESS 0x400E3196
 /begin ANNOTATION ANNOTATION_LABEL "Description (coming from AUTOSAR DESC field)" /begin ANNOTATION_TEXT "Data indicating the alarm expiration.\r\n" /end ANNOTATION_TEXT /end ANNOTATION
/end MEASUREMENT
/begin MEASUREMENT MCore_DeExpired_46 "" UBYTE Methods_boolean 1 100 0.0 255.0 MAX_REFRESH 3 5 ECU_ADDRESS 0x400E3197
 /begin ANNOTATION ANNOTATION_LABEL "Description (coming from AUTOSAR DESC field)" /begin ANNOTATION_TEXT "Data indicating the alarm expiration.\r\n" /end ANNOTATION_TEXT /end ANNOTATION
/end MEASUREMENT
/begin MEASUREMENT MCore_DeExpired_47 "" UBYTE Methods_boolean 1 100 0.0 255.0 MAX_REFRESH 3 5 ECU_ADDRESS 0x400E3198
 /begin ANNOTATION ANNOTATION_LABEL "Description (coming from AUTOSAR DESC field)" /begin ANNOTATION_TEXT "Data indicating the alarm expiration.\r\n" /end ANNOTATION_TEXT /end ANNOTATION
/end MEASUREMENT
/begin MEASUREMENT MCore_DeExpired_48 "" UBYTE Methods_boolean 1 100 0.0 255.0 MAX_REFRESH 3 5 ECU_ADDRESS 0x400E3199
 /begin ANNOTATION ANNOTATION_LABEL "Description (coming from AUTOSAR DESC field)" /begin ANNOTATION_TEXT "Data indicating the alarm expiration.\r\n" /end ANNOTATION_TEXT /end ANNOTATION
/end MEASUREMENT
/begin MEASUREMENT MCore_DeExpired_49 "" UBYTE Methods_boolean 1 100 0.0 255.0 MAX_REFRESH 3 5 ECU_ADDRESS 0x400E3957
 /begin ANNOTATION ANNOTATION_LABEL "Description (coming from AUTOSAR DESC field)" /begin ANNOTATION_TEXT "Data indicating the alarm expiration.\r\n" /end ANNOTATION_TEXT /end ANNOTATION
/end MEASUREMENT
/begin MEASUREMENT MCore_DeExpired_50 "" UBYTE Methods_boolean 1 100 0.0 255.0 MAX_REFRESH 3 5 ECU_ADDRESS 0x400E3958
 /begin ANNOTATION ANNOTATION_LABEL "Description (coming from AUTOSAR DESC field)" /begin ANNOTATION_TEXT "Data indicating the alarm expiration.\r\n" /end ANNOTATION_TEXT /end ANNOTATION
/end MEASUREMENT
/begin MEASUREMENT MCore_DeExpired_51 "" UBYTE Methods_boolean 1 100 0.0 255.0 MAX_REFRESH 3 5 ECU_ADDRESS 0x400E3959
 /begin ANNOTATION ANNOTATION_LABEL "Description (coming from AUTOSAR DESC field)" /begin ANNOTATION_TEXT "Data indicating the alarm expiration.\r\n" /end ANNOTATION_TEXT /end ANNOTATION
/end MEASUREMENT
/begin MEASUREMENT MCore_DeExpired_52 "" UBYTE Methods_boolean 1 100 0.0 255.0 MAX_REFRESH 3 5 ECU_ADDRESS 0x400E395A
 /begin ANNOTATION ANNOTATION_LABEL "Description (coming from AUTOSAR DESC field)" /begin ANNOTATION_TEXT "Data indicating the alarm expiration.\r\n" /end ANNOTATION_TEXT /end ANNOTATION
/end MEASUREMENT
/begin MEASUREMENT MCore_DeExpired_53 "" UBYTE Methods_boolean 1 100 0.0 255.0 MAX_REFRESH 3 5 ECU_ADDRESS 0x400E395B
 /begin ANNOTATION ANNOTATION_LABEL "Description (coming from AUTOSAR DESC field)" /begin ANNOTATION_TEXT "Data indicating the alarm expiration.\r\n" /end ANNOTATION_TEXT /end ANNOTATION
/end MEASUREMENT
/begin MEASUREMENT MCore_DeExpired_54 "" UBYTE Methods_boolean 1 100 0.0 255.0 MAX_REFRESH 3 5 ECU_ADDRESS 0x400E395C
 /begin ANNOTATION ANNOTATION_LABEL "Description (coming from AUTOSAR DESC field)" /begin ANNOTATION_TEXT "Data indicating the alarm expiration.\r\n" /end ANNOTATION_TEXT /end ANNOTATION
/end MEASUREMENT
/begin MEASUREMENT MCore_DeExpired_55 "" UBYTE Methods_boolean 1 100 0.0 255.0 MAX_REFRESH 3 5 ECU_ADDRESS 0x400E395D
 /begin ANNOTATION ANNOTATION_LABEL "Description (coming from AUTOSAR DESC field)" /begin ANNOTATION_TEXT "Data indicating the alarm expiration.\r\n" /end ANNOTATION_TEXT /end ANNOTATION
/end MEASUREMENT
/begin MEASUREMENT MCore_DeExpired_56 "" UBYTE Methods_boolean 1 100 0.0 255.0 MAX_REFRESH 3 5 ECU_ADDRESS 0x400E395E
 /begin ANNOTATION ANNOTATION_LABEL "Description (coming from AUTOSAR DESC field)" /begin ANNOTATION_TEXT "Data indicating the alarm expiration.\r\n" /end ANNOTATION_TEXT /end ANNOTATION
/end MEASUREMENT
/begin MEASUREMENT MCore_DeExpired_57 "" UBYTE Methods_boolean 1 100 0.0 255.0 MAX_REFRESH 3 5 ECU_ADDRESS 0x400E395F
 /begin ANNOTATION ANNOTATION_LABEL "Description (coming from AUTOSAR DESC field)" /begin ANNOTATION_TEXT "Data indicating the alarm expiration.\r\n" /end ANNOTATION_TEXT /end ANNOTATION
/end MEASUREMENT
/begin MEASUREMENT MCore_DeExpired_58 "" UBYTE Methods_boolean 1 100 0.0 255.0 MAX_REFRESH 3 5 ECU_ADDRESS 0x400E3960
 /begin ANNOTATION ANNOTATION_LABEL "Description (coming from AUTOSAR DESC field)" /begin ANNOTATION_TEXT "Data indicating the alarm expiration.\r\n" /end ANNOTATION_TEXT /end ANNOTATION
/end MEASUREMENT
/begin MEASUREMENT MCore_DeExpired_59 "" UBYTE Methods_boolean 1 100 0.0 255.0 MAX_REFRESH 3 5 ECU_ADDRESS 0x400E3961
 /begin ANNOTATION ANNOTATION_LABEL "Description (coming from AUTOSAR DESC field)" /begin ANNOTATION_TEXT "Data indicating the alarm expiration.\r\n" /end ANNOTATION_TEXT /end ANNOTATION
/end MEASUREMENT
/begin MEASUREMENT MCore_DeExpired_60 "" UBYTE Methods_boolean 1 100 0.0 255.0 MAX_REFRESH 3 5 ECU_ADDRESS 0x400E3962
 /begin ANNOTATION ANNOTATION_LABEL "Description (coming from AUTOSAR DESC field)" /begin ANNOTATION_TEXT "Data indicating the alarm expiration.\r\n" /end ANNOTATION_TEXT /end ANNOTATION
/end MEASUREMENT
/begin MEASUREMENT MCore_DeExpired_61 "" UBYTE Methods_boolean 1 100 0.0 255.0 MAX_REFRESH 3 5 ECU_ADDRESS 0x400E3963
 /begin ANNOTATION ANNOTATION_LABEL "Description (coming from AUTOSAR DESC field)" /begin ANNOTATION_TEXT "Data indicating the alarm expiration.\r\n" /end ANNOTATION_TEXT /end ANNOTATION
/end MEASUREMENT
/begin MEASUREMENT MCore_DeExpired_62 "" UBYTE Methods_boolean 1 100 0.0 255.0 MAX_REFRESH 3 5 ECU_ADDRESS 0x400E3964
 /begin ANNOTATION ANNOTATION_LABEL "Description (coming from AUTOSAR DESC field)" /begin ANNOTATION_TEXT "Data indicating the alarm expiration.\r\n" /end ANNOTATION_TEXT /end ANNOTATION
/end MEASUREMENT
/begin MEASUREMENT MCore_DeExpired_63 "" UBYTE Methods_boolean 1 100 0.0 255.0 MAX_REFRESH 3 5 ECU_ADDRESS 0x400E3965
 /begin ANNOTATION ANNOTATION_LABEL "Description (coming from AUTOSAR DESC field)" /begin ANNOTATION_TEXT "Data indicating the alarm expiration.\r\n" /end ANNOTATION_TEXT /end ANNOTATION
/end MEASUREMENT
/begin MEASUREMENT MCore_DeExpired_64 "" UBYTE Methods_boolean 1 100 0.0 255.0 MAX_REFRESH 3 5 ECU_ADDRESS 0x400E3966
 /begin ANNOTATION ANNOTATION_LABEL "Description (coming from AUTOSAR DESC field)" /begin ANNOTATION_TEXT "Data indicating the alarm expiration.\r\n" /end ANNOTATION_TEXT /end ANNOTATION
/end MEASUREMENT
/begin MEASUREMENT MCore_DeExpired_65 "" UBYTE Methods_boolean 1 100 0.0 255.0 MAX_REFRESH 3 5 ECU_ADDRESS 0x400E3967
 /begin ANNOTATION ANNOTATION_LABEL "Description (coming from AUTOSAR DESC field)" /begin ANNOTATION_TEXT "Data indicating the alarm expiration.\r\n" /end ANNOTATION_TEXT /end ANNOTATION
/end MEASUREMENT
/begin MEASUREMENT MCore_DeExpired_66 "" UBYTE Methods_boolean 1 100 0.0 255.0 MAX_REFRESH 3 5 ECU_ADDRESS 0x400E3968
 /begin ANNOTATION ANNOTATION_LABEL "Description (coming from AUTOSAR DESC field)" /begin ANNOTATION_TEXT "Data indicating the alarm expiration.\r\n" /end ANNOTATION_TEXT /end ANNOTATION
/end MEASUREMENT
/begin MEASUREMENT MCore_DeExpired_67 "" UBYTE Methods_boolean 1 100 0.0 255.0 MAX_REFRESH 3 5 ECU_ADDRESS 0x400E3969
 /begin ANNOTATION ANNOTATION_LABEL "Description (coming from AUTOSAR DESC field)" /begin ANNOTATION_TEXT "Data indicating the alarm expiration.\r\n" /end ANNOTATION_TEXT /end ANNOTATION
/end MEASUREMENT
/begin MEASUREMENT MCore_DeExpired_68 "" UBYTE Methods_boolean 1 100 0.0 255.0 MAX_REFRESH 3 5 ECU_ADDRESS 0x400E396A
 /begin ANNOTATION ANNOTATION_LABEL "Description (coming from AUTOSAR DESC field)" /begin ANNOTATION_TEXT "Data indicating the alarm expiration.\r\n" /end ANNOTATION_TEXT /end ANNOTATION
/end MEASUREMENT
/begin MEASUREMENT MCore_DeExpired_69 "" UBYTE Methods_boolean 1 100 0.0 255.0 MAX_REFRESH 3 5 ECU_ADDRESS 0x400E396B
 /begin ANNOTATION ANNOTATION_LABEL "Description (coming from AUTOSAR DESC field)" /begin ANNOTATION_TEXT "Data indicating the alarm expiration.\r\n" /end ANNOTATION_TEXT /end ANNOTATION
/end MEASUREMENT
/begin MEASUREMENT MCore_DeExpired_70 "" UBYTE Methods_boolean 1 100 0.0 255.0 MAX_REFRESH 3 5 ECU_ADDRESS 0x400E396C
 /begin ANNOTATION ANNOTATION_LABEL "Description (coming from AUTOSAR DESC field)" /begin ANNOTATION_TEXT "Data indicating the alarm expiration.\r\n" /end ANNOTATION_TEXT /end ANNOTATION
/end MEASUREMENT
/begin MEASUREMENT MCore_DeExpired_71 "" UBYTE Methods_boolean 1 100 0.0 255.0 MAX_REFRESH 3 5 ECU_ADDRESS 0x400E396D
 /begin ANNOTATION ANNOTATION_LABEL "Description (coming from AUTOSAR DESC field)" /begin ANNOTATION_TEXT "Data indicating the alarm expiration.\r\n" /end ANNOTATION_TEXT /end ANNOTATION
/end MEASUREMENT
/begin MEASUREMENT MCore_DeExpired_72 "" UBYTE Methods_boolean 1 100 0.0 255.0 MAX_REFRESH 3 5 ECU_ADDRESS 0x400E396E
 /begin ANNOTATION ANNOTATION_LABEL "Description (coming from AUTOSAR DESC field)" /begin ANNOTATION_TEXT "Data indicating the alarm expiration.\r\n" /end ANNOTATION_TEXT /end ANNOTATION
/end MEASUREMENT
/begin MEASUREMENT MCore_DeExpired_73 "" UBYTE Methods_boolean 1 100 0.0 255.0 MAX_REFRESH 3 5 ECU_ADDRESS 0x400E396F
 /begin ANNOTATION ANNOTATION_LABEL "Description (coming from AUTOSAR DESC field)" /begin ANNOTATION_TEXT "Data indicating the alarm expiration.\r\n" /end ANNOTATION_TEXT /end ANNOTATION
/end MEASUREMENT
/begin MEASUREMENT MCore_DeExpired_74 "" UBYTE Methods_boolean 1 100 0.0 255.0 MAX_REFRESH 3 5 ECU_ADDRESS 0x400E3970
 /begin ANNOTATION ANNOTATION_LABEL "Description (coming from AUTOSAR DESC field)" /begin ANNOTATION_TEXT "Data indicating the alarm expiration.\r\n" /end ANNOTATION_TEXT /end ANNOTATION
/end MEASUREMENT
/begin MEASUREMENT MCore_DeExpired_75 "" UBYTE Methods_boolean 1 100 0.0 255.0 MAX_REFRESH 3 5 ECU_ADDRESS 0x400E3971
 /begin ANNOTATION ANNOTATION_LABEL "Description (coming from AUTOSAR DESC field)" /begin ANNOTATION_TEXT "Data indicating the alarm expiration.\r\n" /end ANNOTATION_TEXT /end ANNOTATION
/end MEASUREMENT
/begin MEASUREMENT MCore_DeExpired_76 "" UBYTE Methods_boolean 1 100 0.0 255.0 MAX_REFRESH 3 5 ECU_ADDRESS 0x400E3972
 /begin ANNOTATION ANNOTATION_LABEL "Description (coming from AUTOSAR DESC field)" /begin ANNOTATION_TEXT "Data indicating the alarm expiration.\r\n" /end ANNOTATION_TEXT /end ANNOTATION
/end MEASUREMENT
/begin MEASUREMENT MCore_DeExpired_77 "" UBYTE Methods_boolean 1 100 0.0 255.0 MAX_REFRESH 3 5 ECU_ADDRESS 0x400E3973
 /begin ANNOTATION ANNOTATION_LABEL "Description (coming from AUTOSAR DESC field)" /begin ANNOTATION_TEXT "Data indicating the alarm expiration.\r\n" /end ANNOTATION_TEXT /end ANNOTATION
/end MEASUREMENT
/begin MEASUREMENT MCore_DeExpired_78 "" UBYTE Methods_boolean 1 100 0.0 255.0 MAX_REFRESH 3 5 ECU_ADDRESS 0x400E3974
 /begin ANNOTATION ANNOTATION_LABEL "Description (coming from AUTOSAR DESC field)" /begin ANNOTATION_TEXT "Data indicating the alarm expiration.\r\n" /end ANNOTATION_TEXT /end ANNOTATION
/end MEASUREMENT
/begin MEASUREMENT MCore_DeExpired_79 "" UBYTE Methods_boolean 1 100 0.0 255.0 MAX_REFRESH 3 5 ECU_ADDRESS 0x400E3975
 /begin ANNOTATION ANNOTATION_LABEL "Description (coming from AUTOSAR DESC field)" /begin ANNOTATION_TEXT "Data indicating the alarm expiration.\r\n" /end ANNOTATION_TEXT /end ANNOTATION
/end MEASUREMENT
/begin MEASUREMENT MCore_DeExpired_80 "" UBYTE Methods_boolean 1 100 0.0 255.0 MAX_REFRESH 3 5 ECU_ADDRESS 0x400E3976
 /begin ANNOTATION ANNOTATION_LABEL "Description (coming from AUTOSAR DESC field)" /begin ANNOTATION_TEXT "Data indicating the alarm expiration.\r\n" /end ANNOTATION_TEXT /end ANNOTATION
/end MEASUREMENT
/begin MEASUREMENT MCore_DeExpired_81 "" UBYTE Methods_boolean 1 100 0.0 255.0 MAX_REFRESH 3 5 ECU_ADDRESS 0x400E3977
 /begin ANNOTATION ANNOTATION_LABEL "Description (coming from AUTOSAR DESC field)" /begin ANNOTATION_TEXT "Data indicating the alarm expiration.\r\n" /end ANNOTATION_TEXT /end ANNOTATION
/end MEASUREMENT
/begin MEASUREMENT MCore_DeExpired_82 "" UBYTE Methods_boolean 1 100 0.0 255.0 MAX_REFRESH 3 5 ECU_ADDRESS 0x400E3978
 /begin ANNOTATION ANNOTATION_LABEL "Description (coming from AUTOSAR DESC field)" /begin ANNOTATION_TEXT "Data indicating the alarm expiration.\r\n" /end ANNOTATION_TEXT /end ANNOTATION
/end MEASUREMENT
/begin MEASUREMENT MCore_DeExpired_83 "" UBYTE Methods_boolean 1 100 0.0 255.0 MAX_REFRESH 3 5 ECU_ADDRESS 0x400E3979
 /begin ANNOTATION ANNOTATION_LABEL "Description (coming from AUTOSAR DESC field)" /begin ANNOTATION_TEXT "Data indicating the alarm expiration.\r\n" /end ANNOTATION_TEXT /end ANNOTATION
/end MEASUREMENT
/begin MEASUREMENT MCore_DeExpired_84 "" UBYTE Methods_boolean 1 100 0.0 255.0 MAX_REFRESH 3 5 ECU_ADDRESS 0x400E397A
 /begin ANNOTATION ANNOTATION_LABEL "Description (coming from AUTOSAR DESC field)" /begin ANNOTATION_TEXT "Data indicating the alarm expiration.\r\n" /end ANNOTATION_TEXT /end ANNOTATION
/end MEASUREMENT
/begin MEASUREMENT MCore_DeExpired_85 "" UBYTE Methods_boolean 1 100 0.0 255.0 MAX_REFRESH 3 5 ECU_ADDRESS 0x400E397B
 /begin ANNOTATION ANNOTATION_LABEL "Description (coming from AUTOSAR DESC field)" /begin ANNOTATION_TEXT "Data indicating the alarm expiration.\r\n" /end ANNOTATION_TEXT /end ANNOTATION
/end MEASUREMENT
/begin MEASUREMENT MCore_DeExpired_86 "" UBYTE Methods_boolean 1 100 0.0 255.0 MAX_REFRESH 3 5 ECU_ADDRESS 0x400E397C
 /begin ANNOTATION ANNOTATION_LABEL "Description (coming from AUTOSAR DESC field)" /begin ANNOTATION_TEXT "Data indicating the alarm expiration.\r\n" /end ANNOTATION_TEXT /end ANNOTATION
/end MEASUREMENT
/begin MEASUREMENT MCore_DeExpired_87 "" UBYTE Methods_boolean 1 100 0.0 255.0 MAX_REFRESH 3 5 ECU_ADDRESS 0x400E397D
 /begin ANNOTATION ANNOTATION_LABEL "Description (coming from AUTOSAR DESC field)" /begin ANNOTATION_TEXT "Data indicating the alarm expiration.\r\n" /end ANNOTATION_TEXT /end ANNOTATION
/end MEASUREMENT
/begin MEASUREMENT MCore_DeExpired_88 "" UBYTE Methods_boolean 1 100 0.0 255.0 MAX_REFRESH 3 5 ECU_ADDRESS 0x400E397E
 /begin ANNOTATION ANNOTATION_LABEL "Description (coming from AUTOSAR DESC field)" /begin ANNOTATION_TEXT "Data indicating the alarm expiration.\r\n" /end ANNOTATION_TEXT /end ANNOTATION
/end MEASUREMENT
/begin MEASUREMENT MCore_DeExpired_89 "" UBYTE Methods_boolean 1 100 0.0 255.0 MAX_REFRESH 3 5 ECU_ADDRESS 0x400E397F
 /begin ANNOTATION ANNOTATION_LABEL "Description (coming from AUTOSAR DESC field)" /begin ANNOTATION_TEXT "Data indicating the alarm expiration.\r\n" /end ANNOTATION_TEXT /end ANNOTATION
/end MEASUREMENT
/begin MEASUREMENT MCore_DeExpired_90 "" UBYTE Methods_boolean 1 100 0.0 255.0 MAX_REFRESH 3 5 ECU_ADDRESS 0x400E3980
 /begin ANNOTATION ANNOTATION_LABEL "Description (coming from AUTOSAR DESC field)" /begin ANNOTATION_TEXT "Data indicating the alarm expiration.\r\n" /end ANNOTATION_TEXT /end ANNOTATION
/end MEASUREMENT
/begin MEASUREMENT MCore_DeExpired_91 "" UBYTE Methods_boolean 1 100 0.0 255.0 MAX_REFRESH 3 5 ECU_ADDRESS 0x400E3981
 /begin ANNOTATION ANNOTATION_LABEL "Description (coming from AUTOSAR DESC field)" /begin ANNOTATION_TEXT "Data indicating the alarm expiration.\r\n" /end ANNOTATION_TEXT /end ANNOTATION
/end MEASUREMENT
/begin MEASUREMENT MCore_DeExpired_92 "" UBYTE Methods_boolean 1 100 0.0 255.0 MAX_REFRESH 3 5 ECU_ADDRESS 0x400E3982
 /begin ANNOTATION ANNOTATION_LABEL "Description (coming from AUTOSAR DESC field)" /begin ANNOTATION_TEXT "Data indicating the alarm expiration.\r\n" /end ANNOTATION_TEXT /end ANNOTATION
/end MEASUREMENT
/begin MEASUREMENT MCore_DeExpired_93 "" UBYTE Methods_boolean 1 100 0.0 255.0 MAX_REFRESH 3 5 ECU_ADDRESS 0x400E3983
 /begin ANNOTATION ANNOTATION_LABEL "Description (coming from AUTOSAR DESC field)" /begin ANNOTATION_TEXT "Data indicating the alarm expiration.\r\n" /end ANNOTATION_TEXT /end ANNOTATION
/end MEASUREMENT
/begin MEASUREMENT MCore_DeExpired_94 "" UBYTE Methods_boolean 1 100 0.0 255.0 MAX_REFRESH 3 5 ECU_ADDRESS 0x400E3984
 /begin ANNOTATION ANNOTATION_LABEL "Description (coming from AUTOSAR DESC field)" /begin ANNOTATION_TEXT "Data indicating the alarm expiration.\r\n" /end ANNOTATION_TEXT /end ANNOTATION
/end MEASUREMENT
/begin MEASUREMENT MCore_DeExpired_95 "" UBYTE Methods_boolean 1 100 0.0 255.0 MAX_REFRESH 3 5 ECU_ADDRESS 0x400E3985
 /begin ANNOTATION ANNOTATION_LABEL "Description (coming from AUTOSAR DESC field)" /begin ANNOTATION_TEXT "Data indicating the alarm expiration.\r\n" /end ANNOTATION_TEXT /end ANNOTATION
/end MEASUREMENT
/begin MEASUREMENT MCore_DeExpired_96 "" UBYTE Methods_boolean 1 100 0.0 255.0 MAX_REFRESH 3 5 ECU_ADDRESS 0x400E3986
 /begin ANNOTATION ANNOTATION_LABEL "Description (coming from AUTOSAR DESC field)" /begin ANNOTATION_TEXT "Data indicating the alarm expiration.\r\n" /end ANNOTATION_TEXT /end ANNOTATION
/end MEASUREMENT
/begin MEASUREMENT MCore_DeExpired_97 "" UBYTE Methods_boolean 1 100 0.0 255.0 MAX_REFRESH 3 5 ECU_ADDRESS 0x400E3987
 /begin ANNOTATION ANNOTATION_LABEL "Description (coming from AUTOSAR DESC field)" /begin ANNOTATION_TEXT "Data indicating the alarm expiration.\r\n" /end ANNOTATION_TEXT /end ANNOTATION
/end MEASUREMENT
/begin MEASUREMENT MCore_DeExpired_98 "" UBYTE Methods_boolean 1 100 0.0 255.0 MAX_REFRESH 3 5 ECU_ADDRESS 0x400E3988
 /begin ANNOTATION ANNOTATION_LABEL "Description (coming from AUTOSAR DESC field)" /begin ANNOTATION_TEXT "Data indicating the alarm expiration.\r\n" /end ANNOTATION_TEXT /end ANNOTATION
/end MEASUREMENT
/begin MEASUREMENT MCore_DeExpired_99 "" UBYTE Methods_boolean 1 100 0.0 255.0 MAX_REFRESH 3 5 ECU_ADDRESS 0x400E3989
 /begin ANNOTATION ANNOTATION_LABEL "Description (coming from AUTOSAR DESC field)" /begin ANNOTATION_TEXT "Data indicating the alarm expiration.\r\n" /end ANNOTATION_TEXT /end ANNOTATION
/end MEASUREMENT
/begin MEASUREMENT MCore_DeExpired_100 "" UBYTE Methods_boolean 1 100 0.0 255.0 MAX_REFRESH 3 5 ECU_ADDRESS 0x400E398A
 /begin ANNOTATION ANNOTATION_LABEL "Description (coming from AUTOSAR DESC field)" /begin ANNOTATION_TEXT "Data indicating the alarm expiration.\r\n" /end ANNOTATION_TEXT /end ANNOTATION
/end MEASUREMENT
/begin MEASUREMENT MCore_DeExpired_101 "" UBYTE Methods_boolean 1 100 0.0 255.0 MAX_REFRESH 3 5 ECU_ADDRESS 0x400E398B
 /begin ANNOTATION ANNOTATION_LABEL "Description (coming from AUTOSAR DESC field)" /begin ANNOTATION_TEXT "Data indicating the alarm expiration.\r\n" /end ANNOTATION_TEXT /end ANNOTATION
/end MEASUREMENT
/begin MEASUREMENT MCore_DeExpired_102 "" UBYTE Methods_boolean 1 100 0.0 255.0 MAX_REFRESH 3 5 ECU_ADDRESS 0x400E398C
 /begin ANNOTATION ANNOTATION_LABEL "Description (coming from AUTOSAR DESC field)" /begin ANNOTATION_TEXT "Data indicating the alarm expiration.\r\n" /end ANNOTATION_TEXT /end ANNOTATION
/end MEASUREMENT
/begin MEASUREMENT MCore_DeExpired_103 "" UBYTE Methods_boolean 1 100 0.0 255.0 MAX_REFRESH 3 5 ECU_ADDRESS 0x400E398D
 /begin ANNOTATION ANNOTATION_LABEL "Description (coming from AUTOSAR DESC field)" /begin ANNOTATION_TEXT "Data indicating the alarm expiration.\r\n" /end ANNOTATION_TEXT /end ANNOTATION
/end MEASUREMENT
/begin MEASUREMENT MCore_DeExpired_104 "" UBYTE Methods_boolean 1 100 0.0 255.0 MAX_REFRESH 3 5 ECU_ADDRESS 0x400E398E
 /begin ANNOTATION ANNOTATION_LABEL "Description (coming from AUTOSAR DESC field)" /begin ANNOTATION_TEXT "Data indicating the alarm expiration.\r\n" /end ANNOTATION_TEXT /end ANNOTATION
/end MEASUREMENT
/begin MEASUREMENT MCore_DeExpired_105 "" UBYTE Methods_boolean 1 100 0.0 255.0 MAX_REFRESH 3 5 ECU_ADDRESS 0x400E398F
 /begin ANNOTATION ANNOTATION_LABEL "Description (coming from AUTOSAR DESC field)" /begin ANNOTATION_TEXT "Data indicating the alarm expiration.\r\n" /end ANNOTATION_TEXT /end ANNOTATION
/end MEASUREMENT
/begin MEASUREMENT MCore_DeExpired_106 "" UBYTE Methods_boolean 1 100 0.0 255.0 MAX_REFRESH 3 5 ECU_ADDRESS 0x400E3990
 /begin ANNOTATION ANNOTATION_LABEL "Description (coming from AUTOSAR DESC field)" /begin ANNOTATION_TEXT "Data indicating the alarm expiration.\r\n" /end ANNOTATION_TEXT /end ANNOTATION
/end MEASUREMENT
/begin MEASUREMENT MCore_DeExpired_107 "" UBYTE Methods_boolean 1 100 0.0 255.0 MAX_REFRESH 3 5 ECU_ADDRESS 0x400E3991
 /begin ANNOTATION ANNOTATION_LABEL "Description (coming from AUTOSAR DESC field)" /begin ANNOTATION_TEXT "Data indicating the alarm expiration.\r\n" /end ANNOTATION_TEXT /end ANNOTATION
/end MEASUREMENT
/begin MEASUREMENT MCore_DeExpired_108 "" UBYTE Methods_boolean 1 100 0.0 255.0 MAX_REFRESH 3 5 ECU_ADDRESS 0x400E3992
 /begin ANNOTATION ANNOTATION_LABEL "Description (coming from AUTOSAR DESC field)" /begin ANNOTATION_TEXT "Data indicating the alarm expiration.\r\n" /end ANNOTATION_TEXT /end ANNOTATION
/end MEASUREMENT
/begin MEASUREMENT MCore_DeExpired_109 "" UBYTE Methods_boolean 1 100 0.0 255.0 MAX_REFRESH 3 5 ECU_ADDRESS 0x400E3993
 /begin ANNOTATION ANNOTATION_LABEL "Description (coming from AUTOSAR DESC field)" /begin ANNOTATION_TEXT "Data indicating the alarm expiration.\r\n" /end ANNOTATION_TEXT /end ANNOTATION
/end MEASUREMENT
/begin MEASUREMENT MCore_DeExpired_110 "" UBYTE Methods_boolean 1 100 0.0 255.0 MAX_REFRESH 3 5 ECU_ADDRESS 0x400E3994
 /begin ANNOTATION ANNOTATION_LABEL "Description (coming from AUTOSAR DESC field)" /begin ANNOTATION_TEXT "Data indicating the alarm expiration.\r\n" /end ANNOTATION_TEXT /end ANNOTATION
/end MEASUREMENT
/begin MEASUREMENT MCore_DeExpired_111 "" UBYTE Methods_boolean 1 100 0.0 255.0 MAX_REFRESH 3 5 ECU_ADDRESS 0x400E3995
 /begin ANNOTATION ANNOTATION_LABEL "Description (coming from AUTOSAR DESC field)" /begin ANNOTATION_TEXT "Data indicating the alarm expiration.\r\n" /end ANNOTATION_TEXT /end ANNOTATION
/end MEASUREMENT
/begin MEASUREMENT MCore_DeExpired_112 "" UBYTE Methods_boolean 1 100 0.0 255.0 MAX_REFRESH 3 5 ECU_ADDRESS 0x400E3996
 /begin ANNOTATION ANNOTATION_LABEL "Description (coming from AUTOSAR DESC field)" /begin ANNOTATION_TEXT "Data indicating the alarm expiration.\r\n" /end ANNOTATION_TEXT /end ANNOTATION
/end MEASUREMENT
/begin MEASUREMENT MCore_DeExpired_113 "" UBYTE Methods_boolean 1 100 0.0 255.0 MAX_REFRESH 3 5 ECU_ADDRESS 0x400E3997
 /begin ANNOTATION ANNOTATION_LABEL "Description (coming from AUTOSAR DESC field)" /begin ANNOTATION_TEXT "Data indicating the alarm expiration.\r\n" /end ANNOTATION_TEXT /end ANNOTATION
/end MEASUREMENT
/begin MEASUREMENT MCore_DeExpired_114 "" UBYTE Methods_boolean 1 100 0.0 255.0 MAX_REFRESH 3 5 ECU_ADDRESS 0x400E3998
 /begin ANNOTATION ANNOTATION_LABEL "Description (coming from AUTOSAR DESC field)" /begin ANNOTATION_TEXT "Data indicating the alarm expiration.\r\n" /end ANNOTATION_TEXT /end ANNOTATION
/end MEASUREMENT
/begin MEASUREMENT MCore_DeExpired_115 "" UBYTE Methods_boolean 1 100 0.0 255.0 MAX_REFRESH 3 5 ECU_ADDRESS 0x400E3999
 /begin ANNOTATION ANNOTATION_LABEL "Description (coming from AUTOSAR DESC field)" /begin ANNOTATION_TEXT "Data indicating the alarm expiration.\r\n" /end ANNOTATION_TEXT /end ANNOTATION
/end MEASUREMENT
/begin MEASUREMENT MCore_DeExpired_116 "" UBYTE Methods_boolean 1 100 0.0 255.0 MAX_REFRESH 3 5 ECU_ADDRESS 0x400E399A
 /begin ANNOTATION ANNOTATION_LABEL "Description (coming from AUTOSAR DESC field)" /begin ANNOTATION_TEXT "Data indicating the alarm expiration.\r\n" /end ANNOTATION_TEXT /end ANNOTATION
/end MEASUREMENT
/begin MEASUREMENT MCore_DeExpired_117 "" UBYTE Methods_boolean 1 100 0.0 255.0 MAX_REFRESH 3 5 ECU_ADDRESS 0x400E399B
 /begin ANNOTATION ANNOTATION_LABEL "Description (coming from AUTOSAR DESC field)" /begin ANNOTATION_TEXT "Data indicating the alarm expiration.\r\n" /end ANNOTATION_TEXT /end ANNOTATION
/end MEASUREMENT
/begin MEASUREMENT MCore_DeExpired_118 "" UBYTE Methods_boolean 1 100 0.0 255.0 MAX_REFRESH 3 5 ECU_ADDRESS 0x400E399C
 /begin ANNOTATION ANNOTATION_LABEL "Description (coming from AUTOSAR DESC field)" /begin ANNOTATION_TEXT "Data indicating the alarm expiration.\r\n" /end ANNOTATION_TEXT /end ANNOTATION
/end MEASUREMENT
/begin MEASUREMENT MCore_DeExpired_119 "" UBYTE Methods_boolean 1 100 0.0 255.0 MAX_REFRESH 3 5 ECU_ADDRESS 0x400E399D
 /begin ANNOTATION ANNOTATION_LABEL "Description (coming from AUTOSAR DESC field)" /begin ANNOTATION_TEXT "Data indicating the alarm expiration.\r\n" /end ANNOTATION_TEXT /end ANNOTATION
/end MEASUREMENT
/begin MEASUREMENT MCore_DeExpired_120 "" UBYTE Methods_boolean 1 100 0.0 255.0 MAX_REFRESH 3 5 ECU_ADDRESS 0x400E399E
 /begin ANNOTATION ANNOTATION_LABEL "Description (coming from AUTOSAR DESC field)" /begin ANNOTATION_TEXT "Data indicating the alarm expiration.\r\n" /end ANNOTATION_TEXT /end ANNOTATION
/end MEASUREMENT
/begin MEASUREMENT MCore_DeExpired_121 "" UBYTE Methods_boolean 1 100 0.0 255.0 MAX_REFRESH 3 5 ECU_ADDRESS 0x400E399F
 /begin ANNOTATION ANNOTATION_LABEL "Description (coming from AUTOSAR DESC field)" /begin ANNOTATION_TEXT "Data indicating the alarm expiration.\r\n" /end ANNOTATION_TEXT /end ANNOTATION
/end MEASUREMENT
/begin MEASUREMENT MCore_DeExpired_122 "" UBYTE Methods_boolean 1 100 0.0 255.0 MAX_REFRESH 3 5 ECU_ADDRESS 0x400E39A0
 /begin ANNOTATION ANNOTATION_LABEL "Description (coming from AUTOSAR DESC field)" /begin ANNOTATION_TEXT "Data indicating the alarm expiration.\r\n" /end ANNOTATION_TEXT /end ANNOTATION
/end MEASUREMENT
/begin MEASUREMENT MCore_DeExpired_123 "" UBYTE Methods_boolean 1 100 0.0 255.0 MAX_REFRESH 3 5 ECU_ADDRESS 0x400E39A1
 /begin ANNOTATION ANNOTATION_LABEL "Description (coming from AUTOSAR DESC field)" /begin ANNOTATION_TEXT "Data indicating the alarm expiration.\r\n" /end ANNOTATION_TEXT /end ANNOTATION
/end MEASUREMENT
/begin MEASUREMENT MCore_DeExpired_124 "" UBYTE Methods_boolean 1 100 0.0 255.0 MAX_REFRESH 3 5 ECU_ADDRESS 0x400E39A2
 /begin ANNOTATION ANNOTATION_LABEL "Description (coming from AUTOSAR DESC field)" /begin ANNOTATION_TEXT "Data indicating the alarm expiration.\r\n" /end ANNOTATION_TEXT /end ANNOTATION
/end MEASUREMENT
/begin MEASUREMENT MCore_DeExpired_125 "" UBYTE Methods_boolean 1 100 0.0 255.0 MAX_REFRESH 3 5 ECU_ADDRESS 0x400E39A3
 /begin ANNOTATION ANNOTATION_LABEL "Description (coming from AUTOSAR DESC field)" /begin ANNOTATION_TEXT "Data indicating the alarm expiration.\r\n" /end ANNOTATION_TEXT /end ANNOTATION
/end MEASUREMENT
/begin MEASUREMENT MCore_DeExpired_126 "" UBYTE Methods_boolean 1 100 0.0 255.0 MAX_REFRESH 3 5 ECU_ADDRESS 0x400E39A4
 /begin ANNOTATION ANNOTATION_LABEL "Description (coming from AUTOSAR DESC field)" /begin ANNOTATION_TEXT "Data indicating the alarm expiration.\r\n" /end ANNOTATION_TEXT /end ANNOTATION
/end MEASUREMENT
/begin MEASUREMENT MCore_DeExpired_127 "" UBYTE Methods_boolean 1 100 0.0 255.0 MAX_REFRESH 3 5 ECU_ADDRESS 0x400E39A5
 /begin ANNOTATION ANNOTATION_LABEL "Description (coming from AUTOSAR DESC field)" /begin ANNOTATION_TEXT "Data indicating the alarm expiration.\r\n" /end ANNOTATION_TEXT /end ANNOTATION
/end MEASUREMENT
/begin MEASUREMENT MCore_DeExpired_128 "" UBYTE Methods_boolean 1 100 0.0 255.0 MAX_REFRESH 3 5 ECU_ADDRESS 0x400E39A6
 /begin ANNOTATION ANNOTATION_LABEL "Description (coming from AUTOSAR DESC field)" /begin ANNOTATION_TEXT "Data indicating the alarm expiration.\r\n" /end ANNOTATION_TEXT /end ANNOTATION
/end MEASUREMENT
/begin MEASUREMENT MCore_DeExpired_129 "" UBYTE Methods_boolean 1 100 0.0 255.0 MAX_REFRESH 3 5 ECU_ADDRESS 0x400E39A7
 /begin ANNOTATION ANNOTATION_LABEL "Description (coming from AUTOSAR DESC field)" /begin ANNOTATION_TEXT "Data indicating the alarm expiration.\r\n" /end ANNOTATION_TEXT /end ANNOTATION
/end MEASUREMENT
/begin MEASUREMENT MCore_DeExpired_130 "" UBYTE Methods_boolean 1 100 0.0 255.0 MAX_REFRESH 3 5 ECU_ADDRESS 0x400E319A
 /begin ANNOTATION ANNOTATION_LABEL "Description (coming from AUTOSAR DESC field)" /begin ANNOTATION_TEXT "Data indicating the alarm expiration.\r\n" /end ANNOTATION_TEXT /end ANNOTATION
/end MEASUREMENT
/begin MEASUREMENT MCore_DeExpired_131 "" UBYTE Methods_boolean 1 100 0.0 255.0 MAX_REFRESH 3 5 ECU_ADDRESS 0x400E39A8
 /begin ANNOTATION ANNOTATION_LABEL "Description (coming from AUTOSAR DESC field)" /begin ANNOTATION_TEXT "Data indicating the alarm expiration.\r\n" /end ANNOTATION_TEXT /end ANNOTATION
/end MEASUREMENT
/begin MEASUREMENT MCore_DeExpired_132 "" UBYTE Methods_boolean 1 100 0.0 255.0 MAX_REFRESH 3 5 ECU_ADDRESS 0x400E39A9
 /begin ANNOTATION ANNOTATION_LABEL "Description (coming from AUTOSAR DESC field)" /begin ANNOTATION_TEXT "Data indicating the alarm expiration.\r\n" /end ANNOTATION_TEXT /end ANNOTATION
/end MEASUREMENT
/begin MEASUREMENT MCore_DeExpired_133 "" UBYTE Methods_boolean 1 100 0.0 255.0 MAX_REFRESH 3 5 ECU_ADDRESS 0x400E39AA
 /begin ANNOTATION ANNOTATION_LABEL "Description (coming from AUTOSAR DESC field)" /begin ANNOTATION_TEXT "Data indicating the alarm expiration.\r\n" /end ANNOTATION_TEXT /end ANNOTATION
/end MEASUREMENT
/begin MEASUREMENT MCore_DeExpired_134 "" UBYTE Methods_boolean 1 100 0.0 255.0 MAX_REFRESH 3 5 ECU_ADDRESS 0x400E39AB
 /begin ANNOTATION ANNOTATION_LABEL "Description (coming from AUTOSAR DESC field)" /begin ANNOTATION_TEXT "Data indicating the alarm expiration.\r\n" /end ANNOTATION_TEXT /end ANNOTATION
/end MEASUREMENT
/begin MEASUREMENT MCore_DeExpired_135 "" UBYTE Methods_boolean 1 100 0.0 255.0 MAX_REFRESH 3 5 ECU_ADDRESS 0x400E39AC
 /begin ANNOTATION ANNOTATION_LABEL "Description (coming from AUTOSAR DESC field)" /begin ANNOTATION_TEXT "Data indicating the alarm expiration.\r\n" /end ANNOTATION_TEXT /end ANNOTATION
/end MEASUREMENT
/begin MEASUREMENT MCore_DeExpired_136 "" UBYTE Methods_boolean 1 100 0.0 255.0 MAX_REFRESH 3 5 ECU_ADDRESS 0x400E39AD
 /begin ANNOTATION ANNOTATION_LABEL "Description (coming from AUTOSAR DESC field)" /begin ANNOTATION_TEXT "Data indicating the alarm expiration.\r\n" /end ANNOTATION_TEXT /end ANNOTATION
/end MEASUREMENT
/begin MEASUREMENT MCore_DeExpired_137 "" UBYTE Methods_boolean 1 100 0.0 255.0 MAX_REFRESH 3 5 ECU_ADDRESS 0x400E39AE
 /begin ANNOTATION ANNOTATION_LABEL "Description (coming from AUTOSAR DESC field)" /begin ANNOTATION_TEXT "Data indicating the alarm expiration.\r\n" /end ANNOTATION_TEXT /end ANNOTATION
/end MEASUREMENT
/begin MEASUREMENT MCore_DeExpired_138 "" UBYTE Methods_boolean 1 100 0.0 255.0 MAX_REFRESH 3 5 ECU_ADDRESS 0x400E39AF
 /begin ANNOTATION ANNOTATION_LABEL "Description (coming from AUTOSAR DESC field)" /begin ANNOTATION_TEXT "Data indicating the alarm expiration.\r\n" /end ANNOTATION_TEXT /end ANNOTATION
/end MEASUREMENT
/begin MEASUREMENT MCore_DeExpired_139 "" UBYTE Methods_boolean 1 100 0.0 255.0 MAX_REFRESH 3 5 ECU_ADDRESS 0x400E39B0
 /begin ANNOTATION ANNOTATION_LABEL "Description (coming from AUTOSAR DESC field)" /begin ANNOTATION_TEXT "Data indicating the alarm expiration.\r\n" /end ANNOTATION_TEXT /end ANNOTATION
/end MEASUREMENT
/begin MEASUREMENT MCore_DeExpired_140 "" UBYTE Methods_boolean 1 100 0.0 255.0 MAX_REFRESH 3 5 ECU_ADDRESS 0x400E39B1
 /begin ANNOTATION ANNOTATION_LABEL "Description (coming from AUTOSAR DESC field)" /begin ANNOTATION_TEXT "Data indicating the alarm expiration.\r\n" /end ANNOTATION_TEXT /end ANNOTATION
/end MEASUREMENT
/begin MEASUREMENT MCore_DeExpired_141 "" UBYTE Methods_boolean 1 100 0.0 255.0 MAX_REFRESH 3 5 ECU_ADDRESS 0x400E39B2
 /begin ANNOTATION ANNOTATION_LABEL "Description (coming from AUTOSAR DESC field)" /begin ANNOTATION_TEXT "Data indicating the alarm expiration.\r\n" /end ANNOTATION_TEXT /end ANNOTATION
/end MEASUREMENT
/begin MEASUREMENT MCore_DeExpired_142 "" UBYTE Methods_boolean 1 100 0.0 255.0 MAX_REFRESH 3 5 ECU_ADDRESS 0x400E39B3
 /begin ANNOTATION ANNOTATION_LABEL "Description (coming from AUTOSAR DESC field)" /begin ANNOTATION_TEXT "Data indicating the alarm expiration.\r\n" /end ANNOTATION_TEXT /end ANNOTATION
/end MEASUREMENT
/begin MEASUREMENT MCore_Lpms_ResetReason_u8_0 "unsigned integer 8bit" UBYTE VW_BCM_CompuMethods_SC_F1_O0_UNoUnit 1 100 0.0 255.0 MAX_REFRESH 4 1 ECU_ADDRESS 0x400E39B9 /end MEASUREMENT
/begin MEASUREMENT MCore_StMon_369 "" UBYTE DefaultIdenticalCompu 1 100 0.0 255.0 MAX_REFRESH 4 1 ECU_ADDRESS 0x400E39BA
 /begin ANNOTATION ANNOTATION_LABEL "Description (coming from AUTOSAR DESC field)"
  /begin ANNOTATION_TEXT "Application data type for error type data elements. Error types are bit coded\r\n" /end ANNOTATION_TEXT
 /end ANNOTATION
/end MEASUREMENT
/begin MEASUREMENT MCore_STATUS_C1_NCM_SX_NCMCrashSts "Boolean" UBYTE Methods_boolean 1 100 0.0 1.0 MAX_REFRESH 4 1 ECU_ADDRESS 0x400E39BB /end MEASUREMENT
/begin MEASUREMENT MCore_HVB_Crash_Output "Boolean" UBYTE Methods_boolean 1 100 0.0 1.0 MAX_REFRESH 4 1 ECU_ADDRESS 0x400E39BC /end MEASUREMENT
/begin MEASUREMENT MCore_VF005_NBCCrashSts_CORRECT "unsigned integer 8bit" UBYTE DefaultIdenticalCompu 1 100 0.0 255.0 MAX_REFRESH 4 1 ECU_ADDRESS 0x5280D37E /end MEASUREMENT
/begin MEASUREMENT MCore_DE_CentralTunnelLight "" UBYTE Methods_boolean 1 100 0.0 255.0 MAX_REFRESH 4 1 ECU_ADDRESS 0x400E39BD
 /begin ANNOTATION ANNOTATION_LABEL "Description (coming from AUTOSAR DESC field)" /begin ANNOTATION_TEXT "boolean basetype (0 = false, 1 = true)\r\n" /end ANNOTATION_TEXT /end ANNOTATION
/end MEASUREMENT
/begin MEASUREMENT MCore_DE_GloveBoxLight "" UBYTE Methods_boolean 1 100 0.0 255.0 MAX_REFRESH 4 1 ECU_ADDRESS 0x400E39BE
 /begin ANNOTATION ANNOTATION_LABEL "Description (coming from AUTOSAR DESC field)" /begin ANNOTATION_TEXT "boolean basetype (0 = false, 1 = true)\r\n" /end ANNOTATION_TEXT /end ANNOTATION
/end MEASUREMENT
/begin MEASUREMENT MCore_DE_SunVisorLight "" UBYTE Methods_boolean 1 100 0.0 255.0 MAX_REFRESH 4 1 ECU_ADDRESS 0x400E39BF
 /begin ANNOTATION ANNOTATION_LABEL "Description (coming from AUTOSAR DESC field)" /begin ANNOTATION_TEXT "boolean basetype (0 = false, 1 = true)\r\n" /end ANNOTATION_TEXT /end ANNOTATION
/end MEASUREMENT
/begin MEASUREMENT MCore_DE_TwilightSensor_supply "" UBYTE Methods_boolean 1 100 0.0 255.0 MAX_REFRESH 4 1 ECU_ADDRESS 0x400E39C0
 /begin ANNOTATION ANNOTATION_LABEL "Description (coming from AUTOSAR DESC field)" /begin ANNOTATION_TEXT "boolean basetype (0 = false, 1 = true)\r\n" /end ANNOTATION_TEXT /end ANNOTATION
/end MEASUREMENT
/begin MEASUREMENT MCore_TesterValue_4 "Boolean" UBYTE Methods_boolean 1 100 0.0 1.0 MAX_REFRESH 4 1 ECU_ADDRESS 0x400E39C2 /end MEASUREMENT
/begin MEASUREMENT MCore_TesterValue_5 "Boolean" UBYTE Methods_boolean 1 100 0.0 1.0 MAX_REFRESH 4 1 ECU_ADDRESS 0x400E39C4 /end MEASUREMENT
/begin MEASUREMENT MCore_DeBLSActivationSts "" UBYTE VF008_CompuMethod_DT_BLSActivationSts 1 100 0.0 255.0 MAX_REFRESH 4 1 ECU_ADDRESS 0x528081A9 /end MEASUREMENT
/begin MEASUREMENT MCore_DeBatteryVoltageLevel "" UWORD DefaultIdenticalCompu 1 100 0.0 65535.0 MAX_REFRESH 4 1 ECU_ADDRESS 0x52808086 /end MEASUREMENT
/begin MEASUREMENT MCore_DeSBMT_Status "" UBYTE VF008_CompuMethod_DT_SBMT_Status 1 100 0.0 255.0 MAX_REFRESH 4 1 ECU_ADDRESS 0x5280005B /end MEASUREMENT
/begin MEASUREMENT MCore_Unconnected_L_OdometerPulseCounterFailSts "unsigned integer 8bit" UBYTE VW_BCM_CompuMethods_SC_F1_O0_UNoUnit 1 100 0.0 255.0 MAX_REFRESH 4 1 ECU_ADDRESS 0x400E31A3 /end MEASUREMENT
/begin MEASUREMENT MCore_Unconnected_R_OdometerPulseCounterFailSts "unsigned integer 8bit" UBYTE VW_BCM_CompuMethods_SC_F1_O0_UNoUnit 1 100 0.0 255.0 MAX_REFRESH 4 1 ECU_ADDRESS 0x400E31A4 /end MEASUREMENT
/begin MEASUREMENT MCore_CentralLeftRearPositionLight "Boolean" UBYTE Methods_boolean 1 100 0.0 1.0 MAX_REFRESH 4 1 ECU_ADDRESS 0x400AB370 /end MEASUREMENT
/begin MEASUREMENT MCore_CentralRightRearPositionLight "Boolean" UBYTE Methods_boolean 1 100 0.0 1.0 MAX_REFRESH 4 1 ECU_ADDRESS 0x400AB371 /end MEASUREMENT
/begin MEASUREMENT MCore_LeftRearPositionLight_0 "Boolean" UBYTE Methods_boolean 1 100 0.0 1.0 MAX_REFRESH 4 1 ECU_ADDRESS 0x400AB372 /end MEASUREMENT
/begin MEASUREMENT MCore_RightRearPositionLight_0 "Boolean" UBYTE Methods_boolean 1 100 0.0 1.0 MAX_REFRESH 4 1 ECU_ADDRESS 0x400AB373 /end MEASUREMENT
/begin MEASUREMENT MCore_SideMarker_FrontLeftRearRight "Boolean" UBYTE Methods_boolean 1 100 0.0 1.0 MAX_REFRESH 4 1 ECU_ADDRESS 0x400E39C5 /end MEASUREMENT
/begin MEASUREMENT MCore_SideMarker_FrontRightRearLeft "Boolean" UBYTE Methods_boolean 1 100 0.0 1.0 MAX_REFRESH 4 1 ECU_ADDRESS 0x400E39C6 /end MEASUREMENT
/begin MEASUREMENT MCore_Kl30G_VPUP_WAKE_0 "Boolean" UBYTE Methods_boolean 1 100 0.0 1.0 MAX_REFRESH 4 1 ECU_ADDRESS 0x400E39C7 /end MEASUREMENT
/begin MEASUREMENT MCore_TrunkStsHW "Boolean" UBYTE Methods_boolean 1 100 0.0 1.0 MAX_REFRESH 4 1 ECU_ADDRESS 0x400AB374 /end MEASUREMENT
/begin MEASUREMENT MCore_VF027_LHParkTailLightSts_0 "Boolean" UBYTE Methods_boolean 1 100 0.0 1.0 MAX_REFRESH 4 1 ECU_ADDRESS 0x400E39C8 /end MEASUREMENT
/begin MEASUREMENT MCore_VF027_RHParkTailLightSts_0 "Boolean" UBYTE Methods_boolean 1 100 0.0 1.0 MAX_REFRESH 4 1 ECU_ADDRESS 0x400E39C9 /end MEASUREMENT
/begin MEASUREMENT MCore_LeftPartialParkingStatus "Boolean" UBYTE Methods_boolean 1 100 0.0 1.0 MAX_REFRESH 4 1 ECU_ADDRESS 0x400E39CA /end MEASUREMENT
/begin MEASUREMENT MCore_RightPartialParkingStatus "Boolean" UBYTE Methods_boolean 1 100 0.0 1.0 MAX_REFRESH 4 1 ECU_ADDRESS 0x400E39CB /end MEASUREMENT
/begin MEASUREMENT MCore_Unconnected_VF027_LHParkTailLightSts_1 "Boolean" UBYTE Methods_boolean 1 100 0.0 1.0 MAX_REFRESH 4 1 ECU_ADDRESS 0x400E31AC /end MEASUREMENT
/begin MEASUREMENT MCore_Unconnected_VF027_RHParkTailLightSts_1 "Boolean" UBYTE Methods_boolean 1 100 0.0 1.0 MAX_REFRESH 4 1 ECU_ADDRESS 0x400E31AE /end MEASUREMENT
/begin MEASUREMENT MCore_LdirectionSwitchSts_2 "Boolean" UBYTE Methods_boolean 1 100 0.0 1.0 MAX_REFRESH 4 1 ECU_ADDRESS 0x400E39CC /end MEASUREMENT
/begin MEASUREMENT MCore_RdirectionSwitchSts_2 "Boolean" UBYTE Methods_boolean 1 100 0.0 1.0 MAX_REFRESH 4 1 ECU_ADDRESS 0x400E39CD /end MEASUREMENT
/begin MEASUREMENT MCore_StopLightActRq_1 "Boolean" UBYTE Methods_boolean 1 100 0.0 1.0 MAX_REFRESH 4 1 ECU_ADDRESS 0x400E39CE /end MEASUREMENT
/begin MEASUREMENT MCore_ParkingLightCmd "unsigned integer 8bit" UBYTE VW_BCM_CompuMethods_SC_F1_O0_UNoUnit 1 100 0.0 255.0 MAX_REFRESH 4 1 ECU_ADDRESS 0x400E39CF /end MEASUREMENT
/begin MEASUREMENT MCore_DeVF056_NBCBrakePedalStsInfo "Boolean" UBYTE Methods_boolean 1 100 0.0 1.0 MAX_REFRESH 4 1 ECU_ADDRESS 0x400E39D0 /end MEASUREMENT
/begin MEASUREMENT MCore_TesterValue_6 "Boolean" UBYTE Methods_boolean 1 100 0.0 1.0 MAX_REFRESH 4 1 ECU_ADDRESS 0x400E39D2 /end MEASUREMENT
/begin MEASUREMENT MCore_TesterValue_7 "Boolean" UBYTE Methods_boolean 1 100 0.0 1.0 MAX_REFRESH 4 1 ECU_ADDRESS 0x400E39D4 /end MEASUREMENT
/begin MEASUREMENT MCore_TesterValue_8 "Boolean" UBYTE Methods_boolean 1 100 0.0 1.0 MAX_REFRESH 4 1 ECU_ADDRESS 0x400E39D6 /end MEASUREMENT
/begin MEASUREMENT MCore_TesterValue_9 "Boolean" UBYTE Methods_boolean 1 100 0.0 1.0 MAX_REFRESH 4 1 ECU_ADDRESS 0x400E39D8 /end MEASUREMENT
/begin MEASUREMENT MCore_Unconnected_TesterValue_10 "Boolean" UBYTE Methods_boolean 1 100 0.0 1.0 MAX_REFRESH 4 1 ECU_ADDRESS 0x400E31B0 /end MEASUREMENT
/begin MEASUREMENT MCore_RequestActive_56 "Boolean" UBYTE Methods_boolean 1 100 0.0 1.0 MAX_REFRESH 4 1 ECU_ADDRESS 0x400E39D9 /end MEASUREMENT
/begin MEASUREMENT MCore_RequestValue_49 "Boolean" UBYTE Methods_boolean 1 100 0.0 1.0 MAX_REFRESH 4 1 ECU_ADDRESS 0x400E39DA /end MEASUREMENT
/begin MEASUREMENT MCore_TesterValue_11 "Boolean" UBYTE Methods_boolean 1 100 0.0 1.0 MAX_REFRESH 4 1 ECU_ADDRESS 0x400E39DC /end MEASUREMENT
/begin MEASUREMENT MCore_VehicleSpeed "" UWORD DefaultIdenticalCompu 1 100 0.0 512.0 MAX_REFRESH 4 1 ECU_ADDRESS 0x400D90F0 /end MEASUREMENT
/begin MEASUREMENT MCore_VehicleSpeedFailSts "Boolean" UBYTE Methods_boolean 1 100 0.0 1.0 MAX_REFRESH 4 1 ECU_ADDRESS 0x400AB377 /end MEASUREMENT
/begin MEASUREMENT MCore_DePlateLightOut "Boolean" UBYTE Methods_boolean 1 100 0.0 1.0 MAX_REFRESH 4 1 ECU_ADDRESS 0x528081AC /end MEASUREMENT
/begin MEASUREMENT MCore_VF033_actvRightRearFogCmd "Boolean" UBYTE Methods_boolean 1 100 0.0 1.0 MAX_REFRESH 4 1 ECU_ADDRESS 0x400E39DE /end MEASUREMENT
/begin MEASUREMENT MCore_VF033_actvRearFogSts "Boolean" UBYTE Methods_boolean 1 100 0.0 1.0 MAX_REFRESH 4 1 ECU_ADDRESS 0x400E39DF /end MEASUREMENT
/begin MEASUREMENT MCore_TesterValue_12 "Boolean" UBYTE Methods_boolean 1 100 0.0 1.0 MAX_REFRESH 4 1 ECU_ADDRESS 0x400E39E1 /end MEASUREMENT
/begin MEASUREMENT MCore_NFR_Speed_FA_FailSts_3 "Boolean" UBYTE Methods_boolean 1 100 0.0 1.0 MAX_REFRESH 4 1 ECU_ADDRESS 0x400E39E2 /end MEASUREMENT
/begin MEASUREMENT MCore_F041_Backlight "" UWORD DefaultIdenticalCompu 1 100 0.0 100.0 MAX_REFRESH 4 1 ECU_ADDRESS 0x400D90F2 /end MEASUREMENT
/begin MEASUREMENT MCore_F041_BacklightCapoteButton "" UWORD DefaultIdenticalCompu 1 100 0.0 100.0 MAX_REFRESH 4 1 ECU_ADDRESS 0x400D90F4 /end MEASUREMENT
/begin MEASUREMENT MCore_F041_BacklightChildLock "" UWORD DefaultIdenticalCompu 1 100 0.0 100.0 MAX_REFRESH 4 1 ECU_ADDRESS 0x400D90F6 /end MEASUREMENT
/begin MEASUREMENT MCore_F041_BacklightDoorLockUnlockButtonLedAmber "" UWORD DefaultIdenticalCompu 1 100 0.0 100.0 MAX_REFRESH 4 1 ECU_ADDRESS 0x400D90F8 /end MEASUREMENT
/begin MEASUREMENT MCore_F041_BacklightLockUnlockRear "" UWORD DefaultIdenticalCompu 1 100 0.0 100.0 MAX_REFRESH 4 1 ECU_ADDRESS 0x400D90FA /end MEASUREMENT
/begin MEASUREMENT MCore_F041_BacklightRearSeats "" UWORD DefaultIdenticalCompu 1 100 0.0 100.0 MAX_REFRESH 4 1 ECU_ADDRESS 0x400D90FC /end MEASUREMENT
/begin MEASUREMENT MCore_F041_BacklightWindowFront "" UWORD DefaultIdenticalCompu 1 100 0.0 100.0 MAX_REFRESH 4 1 ECU_ADDRESS 0x400D90FE /end MEASUREMENT
/begin MEASUREMENT MCore_F041_BacklightWindowRearLeft "unsigned integer 8bit" UBYTE VW_BCM_CompuMethods_SC_F1_O0_UNoUnit 1 100 0.0 255.0 MAX_REFRESH 4 1 ECU_ADDRESS 0x400AB379 /end MEASUREMENT
/begin MEASUREMENT MCore_F041_BacklightWindowRearPWM "" UWORD DefaultIdenticalCompu 1 100 0.0 100.0 MAX_REFRESH 4 1 ECU_ADDRESS 0x400D9100 /end MEASUREMENT
/begin MEASUREMENT MCore_F041_BacklightWindowRearRight "unsigned integer 8bit" UBYTE VW_BCM_CompuMethods_SC_F1_O0_UNoUnit 1 100 0.0 255.0 MAX_REFRESH 4 1 ECU_ADDRESS 0x400AB37A /end MEASUREMENT
/begin MEASUREMENT MCore_F041_InternalLightLevel "" UBYTE DefaultIdenticalCompu 1 100 0.0 255.0 MAX_REFRESH 4 1 ECU_ADDRESS 0x400AB37C /end MEASUREMENT
/begin MEASUREMENT MCore_F041_InternalLightRdiXLevel "" UBYTE DefaultIdenticalCompu 1 100 0.0 100.0 MAX_REFRESH 4 1 ECU_ADDRESS 0x400AB37D /end MEASUREMENT
/begin MEASUREMENT MCore_TesterValue_13 "Boolean" UBYTE Methods_boolean 1 100 0.0 1.0 MAX_REFRESH 4 1 ECU_ADDRESS 0x400E39E4 /end MEASUREMENT
/begin MEASUREMENT MCore_TesterValue_14 "Boolean" UBYTE Methods_boolean 1 100 0.0 1.0 MAX_REFRESH 4 1 ECU_ADDRESS 0x400E39E6 /end MEASUREMENT
/begin MEASUREMENT MCore_Unconnected_TesterValue_15 "Boolean" UBYTE Methods_boolean 1 100 0.0 1.0 MAX_REFRESH 4 1 ECU_ADDRESS 0x400E31B6 /end MEASUREMENT
/begin MEASUREMENT MCore_Unconnected_TesterValue_16 "Boolean" UBYTE Methods_boolean 1 100 0.0 1.0 MAX_REFRESH 4 1 ECU_ADDRESS 0x400E31B7 /end MEASUREMENT
/begin MEASUREMENT MCore_TesterValue_17 "Boolean" UBYTE Methods_boolean 1 100 0.0 1.0 MAX_REFRESH 4 1 ECU_ADDRESS 0x400E39E8 /end MEASUREMENT
/begin MEASUREMENT MCore_Unconnected_TesterValue_18 "Boolean" UBYTE Methods_boolean 1 100 0.0 1.0 MAX_REFRESH 4 1 ECU_ADDRESS 0x400E31B8 /end MEASUREMENT
/begin MEASUREMENT MCore_TesterValue_19 "Boolean" UBYTE Methods_boolean 1 100 0.0 1.0 MAX_REFRESH 4 1 ECU_ADDRESS 0x400E39EA /end MEASUREMENT
/begin MEASUREMENT MCore_TesterValue_20 "Boolean" UBYTE Methods_boolean 1 100 0.0 1.0 MAX_REFRESH 4 1 ECU_ADDRESS 0x400E39EC /end MEASUREMENT
/begin MEASUREMENT MCore_RequestActive_57 "Boolean" UBYTE Methods_boolean 1 100 0.0 1.0 MAX_REFRESH 4 1 ECU_ADDRESS 0x400E39ED /end MEASUREMENT
/begin MEASUREMENT MCore_RequestValue_50 "Boolean" UBYTE Methods_boolean 1 100 0.0 1.0 MAX_REFRESH 4 1 ECU_ADDRESS 0x400E39EE /end MEASUREMENT
/begin MEASUREMENT MCore_RequestActive_58 "Boolean" UBYTE Methods_boolean 1 100 0.0 1.0 MAX_REFRESH 4 1 ECU_ADDRESS 0x400E39EF /end MEASUREMENT
/begin MEASUREMENT MCore_RequestValue_51 "Boolean" UBYTE Methods_boolean 1 100 0.0 1.0 MAX_REFRESH 4 1 ECU_ADDRESS 0x400E39F0 /end MEASUREMENT
/begin MEASUREMENT MCore_RequestActive_59 "Boolean" UBYTE Methods_boolean 1 100 0.0 1.0 MAX_REFRESH 4 1 ECU_ADDRESS 0x400E39F1 /end MEASUREMENT
/begin MEASUREMENT MCore_RequestValue_52 "Boolean" UBYTE Methods_boolean 1 100 0.0 1.0 MAX_REFRESH 4 1 ECU_ADDRESS 0x400E39F2 /end MEASUREMENT
/begin MEASUREMENT MCore_VF042_LowBeamSts_1 "Boolean" UBYTE Methods_boolean 1 100 0.0 1.0 MAX_REFRESH 4 1 ECU_ADDRESS 0x400E39F3 /end MEASUREMENT
/begin MEASUREMENT MCore_VF042_LBActivation_0 "Boolean" UBYTE Methods_boolean 1 100 0.0 1.0 MAX_REFRESH 4 1 ECU_ADDRESS 0x400E39F4 /end MEASUREMENT
/begin MEASUREMENT MCore_VF042_LowBeamSts_2 "unsigned integer 8bit" UBYTE VW_BCM_CompuMethods_SC_F1_O0_UNoUnit 1 100 0.0 255.0 MAX_REFRESH 4 1 ECU_ADDRESS 0x400E31BD /end MEASUREMENT
/begin MEASUREMENT MCore_Unconnected_VF042_LDirectionSwitchSts "Boolean" UBYTE Methods_boolean 1 100 0.0 1.0 MAX_REFRESH 4 1 ECU_ADDRESS 0x400E31BF /end MEASUREMENT
/begin MEASUREMENT MCore_Unconnected_VF042_RDirectionSwitchSts "Boolean" UBYTE Methods_boolean 1 100 0.0 1.0 MAX_REFRESH 4 1 ECU_ADDRESS 0x400E31BE /end MEASUREMENT
/begin MEASUREMENT MCore_TesterValue_21 "Boolean" UBYTE Methods_boolean 1 100 0.0 1.0 MAX_REFRESH 4 1 ECU_ADDRESS 0x400E39F6 /end MEASUREMENT
/begin MEASUREMENT MCore_Unconnected_CapoteEnable "Boolean" UBYTE Methods_boolean 1 100 0.0 1.0 MAX_REFRESH 4 1 ECU_ADDRESS 0x400E31C1 /end MEASUREMENT
/begin MEASUREMENT MCore_Wing1_Fbk_Pos_FailSts "Boolean" UBYTE Methods_boolean 1 100 0.0 1.0 MAX_REFRESH 4 1 ECU_ADDRESS 0x400E39F8 /end MEASUREMENT
/begin MEASUREMENT MCore_StMon_370 "" UBYTE DefaultIdenticalCompu 1 100 0.0 255.0 MAX_REFRESH 4 1 ECU_ADDRESS 0x400E39F9
 /begin ANNOTATION ANNOTATION_LABEL "Description (coming from AUTOSAR DESC field)"
  /begin ANNOTATION_TEXT "Application data type for error type data elements. Error types are bit coded\r\n" /end ANNOTATION_TEXT
 /end ANNOTATION
/end MEASUREMENT
/begin MEASUREMENT MCore_TesterValue_22 "Boolean" UBYTE Methods_boolean 1 100 0.0 1.0 MAX_REFRESH 4 1 ECU_ADDRESS 0x400E39FB /end MEASUREMENT
/begin MEASUREMENT MCore_HazardLightSts "Boolean" UBYTE Methods_boolean 1 100 0.0 1.0 MAX_REFRESH 4 1 ECU_ADDRESS 0x400E39FC /end MEASUREMENT
/begin MEASUREMENT MCore_TesterValue_23 "Boolean" UBYTE Methods_boolean 1 100 0.0 1.0 MAX_REFRESH 4 1 ECU_ADDRESS 0x400E39FE /end MEASUREMENT
/begin MEASUREMENT MCore_TesterValue_24 "Boolean" UBYTE Methods_boolean 1 100 0.0 1.0 MAX_REFRESH 4 1 ECU_ADDRESS 0x400E3A00 /end MEASUREMENT
/begin MEASUREMENT MCore_TesterValue_25 "Boolean" UBYTE Methods_boolean 1 100 0.0 1.0 MAX_REFRESH 4 1 ECU_ADDRESS 0x400E3A02 /end MEASUREMENT
/begin MEASUREMENT MCore_TesterValue_26 "Boolean" UBYTE Methods_boolean 1 100 0.0 1.0 MAX_REFRESH 4 1 ECU_ADDRESS 0x400E3A04 /end MEASUREMENT
/begin MEASUREMENT MCore_TesterValue_27 "Boolean" UBYTE Methods_boolean 1 100 0.0 1.0 MAX_REFRESH 4 1 ECU_ADDRESS 0x400E3A06 /end MEASUREMENT
/begin MEASUREMENT MCore_Blink_l_Side "unsigned integer 8bit" UBYTE VW_BCM_CompuMethods_SC_F1_O0_UNoUnit 1 100 0.0 255.0 MAX_REFRESH 4 1 ECU_ADDRESS 0x400E3A07 /end MEASUREMENT
/begin MEASUREMENT MCore_CrashNvSts "Boolean" UBYTE Methods_boolean 1 100 0.0 1.0 MAX_REFRESH 4 1 ECU_ADDRESS 0x400E3A08 /end MEASUREMENT
/begin MEASUREMENT MCore_HazardButtonSts "Boolean" UBYTE Methods_boolean 1 100 0.0 1.0 MAX_REFRESH 4 1 ECU_ADDRESS 0x400E3A09 /end MEASUREMENT
/begin MEASUREMENT MCore_NewFuncReq_HazardBtn "Boolean" UBYTE Methods_boolean 1 100 0.0 1.0 MAX_REFRESH 4 1 ECU_ADDRESS 0x400E3A0A /end MEASUREMENT
/begin MEASUREMENT MCore_NewFuncReq_Left "Boolean" UBYTE Methods_boolean 1 100 0.0 1.0 MAX_REFRESH 4 1 ECU_ADDRESS 0x400E3A0B /end MEASUREMENT
/begin MEASUREMENT MCore_NewFuncReq_Right "Boolean" UBYTE Methods_boolean 1 100 0.0 1.0 MAX_REFRESH 4 1 ECU_ADDRESS 0x400E3A0C /end MEASUREMENT
/begin MEASUREMENT MCore_LeftTurnReq "Boolean" UBYTE Methods_boolean 1 100 0.0 1.0 MAX_REFRESH 4 1 ECU_ADDRESS 0x400E3A0D /end MEASUREMENT
/begin MEASUREMENT MCore_RightTurnReq "Boolean" UBYTE Methods_boolean 1 100 0.0 1.0 MAX_REFRESH 4 1 ECU_ADDRESS 0x400E3A0E /end MEASUREMENT
/begin MEASUREMENT MCore_CentralLeftTurnFail "Boolean" UBYTE Methods_boolean 1 100 0.0 1.0 MAX_REFRESH 4 1 ECU_ADDRESS 0x400E3A0F /end MEASUREMENT
/begin MEASUREMENT MCore_CentralRightTurnFail "Boolean" UBYTE Methods_boolean 1 100 0.0 1.0 MAX_REFRESH 4 1 ECU_ADDRESS 0x400E3A10 /end MEASUREMENT
/begin MEASUREMENT MCore_LateralLeftTurnFail "Boolean" UBYTE Methods_boolean 1 100 0.0 1.0 MAX_REFRESH 4 1 ECU_ADDRESS 0x400E3A11 /end MEASUREMENT
/begin MEASUREMENT MCore_LateralRightTurnFail "Boolean" UBYTE Methods_boolean 1 100 0.0 1.0 MAX_REFRESH 4 1 ECU_ADDRESS 0x400E3A12 /end MEASUREMENT
/begin MEASUREMENT MCore_De_TILightDeactivationRqt "" UBYTE VF051_CompuMethods_CM_TILightDeactivationRqt 1 100 0.0 255.0 MAX_REFRESH 4 1 ECU_ADDRESS 0x400E3A13 /end MEASUREMENT
/begin MEASUREMENT MCore_StMon_371 "" UBYTE DefaultIdenticalCompu 1 100 0.0 255.0 MAX_REFRESH 4 1 ECU_ADDRESS 0x400E3A14
 /begin ANNOTATION ANNOTATION_LABEL "Description (coming from AUTOSAR DESC field)"
  /begin ANNOTATION_TEXT "Application data type for error type data elements. Error types are bit coded\r\n" /end ANNOTATION_TEXT
 /end ANNOTATION
/end MEASUREMENT
/begin MEASUREMENT MCore_StMon_372 "" UBYTE DefaultIdenticalCompu 1 100 0.0 255.0 MAX_REFRESH 4 1 ECU_ADDRESS 0x400E3A15
 /begin ANNOTATION ANNOTATION_LABEL "Description (coming from AUTOSAR DESC field)"
  /begin ANNOTATION_TEXT "Application data type for error type data elements. Error types are bit coded\r\n" /end ANNOTATION_TEXT
 /end ANNOTATION
/end MEASUREMENT
/begin MEASUREMENT MCore_StMon_373 "" UBYTE DefaultIdenticalCompu 1 100 0.0 255.0 MAX_REFRESH 4 1 ECU_ADDRESS 0x400E3A16
 /begin ANNOTATION ANNOTATION_LABEL "Description (coming from AUTOSAR DESC field)"
  /begin ANNOTATION_TEXT "Application data type for error type data elements. Error types are bit coded\r\n" /end ANNOTATION_TEXT
 /end ANNOTATION
/end MEASUREMENT
/begin MEASUREMENT MCore_Stop_Central_Left_Light_Fail "unsigned integer 8bit" UBYTE VW_BCM_CompuMethods_SC_F1_O0_UNoUnit 1 100 0.0 255.0 MAX_REFRESH 4 1 ECU_ADDRESS 0x400E3A17 /end MEASUREMENT
/begin MEASUREMENT MCore_Stop_Central_Right_Light_Fail "unsigned integer 8bit" UBYTE VW_BCM_CompuMethods_SC_F1_O0_UNoUnit 1 100 0.0 255.0 MAX_REFRESH 4 1 ECU_ADDRESS 0x400E3A18 /end MEASUREMENT
/begin MEASUREMENT MCore_DeLWS_Angle "" SWORD DefaultIdenticalCompu 1 100 -32768.0 32767.0 MAX_REFRESH 4 1 ECU_ADDRESS 0x1223B08 /end MEASUREMENT
/begin MEASUREMENT MCore_DeLWS_OK "" UBYTE Methods_boolean 1 100 0.0 255.0 MAX_REFRESH 4 1 ECU_ADDRESS 0x5280D37F /end MEASUREMENT
/begin MEASUREMENT MCore_DeVF056_NBCBrakePedalStsInfo_0 "Boolean" UBYTE Methods_boolean 1 100 0.0 1.0 MAX_REFRESH 4 1 ECU_ADDRESS 0x400E3A1F /end MEASUREMENT
/begin MEASUREMENT MCore_DeVF056_NBCHazardReqInfo "Boolean" UBYTE Methods_boolean 1 100 0.0 1.0 MAX_REFRESH 4 1 ECU_ADDRESS 0x400E3A20 /end MEASUREMENT
/begin MEASUREMENT MCore_BrakePedalSts_1 "Boolean" UBYTE Methods_boolean 1 100 0.0 1.0 MAX_REFRESH 4 1 ECU_ADDRESS 0x400E3A21 /end MEASUREMENT
/begin MEASUREMENT MCore_BrakePedalValidData_1 "unsigned integer 8bit" UBYTE VW_BCM_CompuMethods_SC_F1_O0_UNoUnit 1 100 0.0 255.0 MAX_REFRESH 4 1 ECU_ADDRESS 0x400E3A22 /end MEASUREMENT
/begin MEASUREMENT MCore_DriverBrkPressureRqtValidData_0 "unsigned integer 8bit" UBYTE VW_BCM_CompuMethods_SC_F1_O0_UNoUnit 1 100 0.0 255.0 MAX_REFRESH 4 1 ECU_ADDRESS 0x400E3A23 /end MEASUREMENT
/begin MEASUREMENT MCore_StMon_374 "" UBYTE DefaultIdenticalCompu 1 100 0.0 255.0 MAX_REFRESH 4 1 ECU_ADDRESS 0x400E3A24
 /begin ANNOTATION ANNOTATION_LABEL "Description (coming from AUTOSAR DESC field)"
  /begin ANNOTATION_TEXT "Application data type for error type data elements. Error types are bit coded\r\n" /end ANNOTATION_TEXT
 /end ANNOTATION
/end MEASUREMENT
/begin MEASUREMENT MCore_StMon_375 "" UBYTE DefaultIdenticalCompu 1 100 0.0 255.0 MAX_REFRESH 4 1 ECU_ADDRESS 0x400E3A25
 /begin ANNOTATION ANNOTATION_LABEL "Description (coming from AUTOSAR DESC field)"
  /begin ANNOTATION_TEXT "Application data type for error type data elements. Error types are bit coded\r\n" /end ANNOTATION_TEXT
 /end ANNOTATION
/end MEASUREMENT
/begin MEASUREMENT MCore_TesterValue_28 "Boolean" UBYTE Methods_boolean 1 100 0.0 1.0 MAX_REFRESH 4 1 ECU_ADDRESS 0x400E3A27 /end MEASUREMENT
/begin MEASUREMENT MCore_TesterValue_29 "Boolean" UBYTE Methods_boolean 1 100 0.0 1.0 MAX_REFRESH 4 1 ECU_ADDRESS 0x400E3A29 /end MEASUREMENT
/begin MEASUREMENT MCore_ExternalRearLeftStopLightCmd_0 "Boolean" UBYTE Methods_boolean 1 100 0.0 1.0 MAX_REFRESH 4 1 ECU_ADDRESS 0x400AB381 /end MEASUREMENT
/begin MEASUREMENT MCore_ExternalRearRightStopLightCmd_0 "Boolean" UBYTE Methods_boolean 1 100 0.0 1.0 MAX_REFRESH 4 1 ECU_ADDRESS 0x400AB382 /end MEASUREMENT
/begin MEASUREMENT MCore_InternalRearLeftStopLightCmd_0 "Boolean" UBYTE Methods_boolean 1 100 0.0 1.0 MAX_REFRESH 4 1 ECU_ADDRESS 0x400E3A2A /end MEASUREMENT
/begin MEASUREMENT MCore_InternalRearRightStopLightCmd_0 "Boolean" UBYTE Methods_boolean 1 100 0.0 1.0 MAX_REFRESH 4 1 ECU_ADDRESS 0x400E3A2B /end MEASUREMENT
/begin MEASUREMENT MCore_StopLightFault_0 "Boolean" UBYTE Methods_boolean 1 100 0.0 1.0 MAX_REFRESH 4 1 ECU_ADDRESS 0x400E3A2C /end MEASUREMENT
/begin MEASUREMENT MCore_Stop_Central_Left_Light_Fail_0 "unsigned integer 8bit" UBYTE VW_BCM_CompuMethods_SC_F1_O0_UNoUnit 1 100 0.0 255.0 MAX_REFRESH 4 1 ECU_ADDRESS 0x400E31C6 /end MEASUREMENT
/begin MEASUREMENT MCore_Stop_Central_Right_Light_Fail_0 "unsigned integer 8bit" UBYTE VW_BCM_CompuMethods_SC_F1_O0_UNoUnit 1 100 0.0 255.0 MAX_REFRESH 4 1 ECU_ADDRESS 0x400E31C7 /end MEASUREMENT
/begin MEASUREMENT MCore_Stop_Lateral_Left_Light_Fail_0 "unsigned integer 8bit" UBYTE VW_BCM_CompuMethods_SC_F1_O0_UNoUnit 1 100 0.0 255.0 MAX_REFRESH 4 1 ECU_ADDRESS 0x400AB383 /end MEASUREMENT
/begin MEASUREMENT MCore_Stop_Lateral_Right_Light_Fail_0 "unsigned integer 8bit" UBYTE VW_BCM_CompuMethods_SC_F1_O0_UNoUnit 1 100 0.0 255.0 MAX_REFRESH 4 1 ECU_ADDRESS 0x400AB384 /end MEASUREMENT
/begin MEASUREMENT MCore_Stop_Light_Req_0 "Boolean" UBYTE Methods_boolean 1 100 0.0 1.0 MAX_REFRESH 4 1 ECU_ADDRESS 0x400AB385 /end MEASUREMENT
/begin MEASUREMENT MCore_LHStopLightFailSts_0 "Boolean" UBYTE Methods_boolean 1 100 0.0 1.0 MAX_REFRESH 4 1 ECU_ADDRESS 0x400E3A2D /end MEASUREMENT
/begin MEASUREMENT MCore_RHStopLightFailSts_0 "Boolean" UBYTE Methods_boolean 1 100 0.0 1.0 MAX_REFRESH 4 1 ECU_ADDRESS 0x400E3A2E /end MEASUREMENT
/begin MEASUREMENT MCore_ReverseGearLight "Boolean" UBYTE Methods_boolean 1 100 0.0 1.0 MAX_REFRESH 4 1 ECU_ADDRESS 0x400E3A2F /end MEASUREMENT
/begin MEASUREMENT MCore_Unconnected_ReverseGearSts "unsigned integer 8bit" UBYTE VW_BCM_CompuMethods_SC_F1_O0_UNoUnit 1 100 0.0 255.0 MAX_REFRESH 4 1 ECU_ADDRESS 0x400E31CA /end MEASUREMENT
/begin MEASUREMENT MCore_ReverseGearBCSts "unsigned integer 8bit" UBYTE VW_BCM_CompuMethods_SC_F1_O0_UNoUnit 1 100 0.0 255.0 MAX_REFRESH 4 1 ECU_ADDRESS 0x400E3A30 /end MEASUREMENT
/begin MEASUREMENT MCore_TesterValue_30 "Boolean" UBYTE Methods_boolean 1 100 0.0 1.0 MAX_REFRESH 4 1 ECU_ADDRESS 0x400E3A32 /end MEASUREMENT
/begin MEASUREMENT MCore_Unconnected_DriverMirrorHorizPosRsp "unsigned integer 8bit" UBYTE VW_BCM_CompuMethods_SC_F1_O0_UNoUnit 1 100 0.0 255.0 MAX_REFRESH 4 1 ECU_ADDRESS 0x400E31CE /end MEASUREMENT
/begin MEASUREMENT MCore_Unconnected_DriverMirrorHorizPosRspDirection "unsigned integer 8bit" UBYTE VW_BCM_CompuMethods_SC_F1_O0_UNoUnit 1 100 0.0 255.0 MAX_REFRESH 4 1 ECU_ADDRESS 0x400E31D0 /end MEASUREMENT
/begin MEASUREMENT MCore_Unconnected_DriverMirrorVertPosRsp "unsigned integer 8bit" UBYTE VW_BCM_CompuMethods_SC_F1_O0_UNoUnit 1 100 0.0 255.0 MAX_REFRESH 4 1 ECU_ADDRESS 0x400E31CD /end MEASUREMENT
/begin MEASUREMENT MCore_Unconnected_DriverMirrorVertPosRspDirection "unsigned integer 8bit" UBYTE VW_BCM_CompuMethods_SC_F1_O0_UNoUnit 1 100 0.0 255.0 MAX_REFRESH 4 1 ECU_ADDRESS 0x400E31CF /end MEASUREMENT
/begin MEASUREMENT MCore_Unconnected_PsngrMirrorHorizPosRsp "unsigned integer 8bit" UBYTE VW_BCM_CompuMethods_SC_F1_O0_UNoUnit 1 100 0.0 255.0 MAX_REFRESH 4 1 ECU_ADDRESS 0x400E31D2 /end MEASUREMENT
/begin MEASUREMENT MCore_Unconnected_PsngrMirrorHorizPosRspDirection "unsigned integer 8bit" UBYTE VW_BCM_CompuMethods_SC_F1_O0_UNoUnit 1 100 0.0 255.0 MAX_REFRESH 4 1 ECU_ADDRESS 0x400E31D4 /end MEASUREMENT
/begin MEASUREMENT MCore_Unconnected_PsngrMirrorVertPosRsp "unsigned integer 8bit" UBYTE VW_BCM_CompuMethods_SC_F1_O0_UNoUnit 1 100 0.0 255.0 MAX_REFRESH 4 1 ECU_ADDRESS 0x400E31D1 /end MEASUREMENT
/begin MEASUREMENT MCore_Unconnected_PsngrMirrorVertPosRspDirection "unsigned integer 8bit" UBYTE VW_BCM_CompuMethods_SC_F1_O0_UNoUnit 1 100 0.0 255.0 MAX_REFRESH 4 1 ECU_ADDRESS 0x400E31D3 /end MEASUREMENT
/begin MEASUREMENT MCore_Unconnected_DriverSeatBackRestPos "unsigned integer 8bit" UBYTE VW_BCM_CompuMethods_SC_F1_O0_UNoUnit 1 100 0.0 255.0 MAX_REFRESH 4 1 ECU_ADDRESS 0x400E31D7 /end MEASUREMENT
/begin MEASUREMENT MCore_Unconnected_DriverSeatLiftPos "unsigned integer 8bit" UBYTE VW_BCM_CompuMethods_SC_F1_O0_UNoUnit 1 100 0.0 255.0 MAX_REFRESH 4 1 ECU_ADDRESS 0x400E31D8 /end MEASUREMENT
/begin MEASUREMENT MCore_Unconnected_DriverSeatLongitudinalPos "unsigned integer 8bit" UBYTE VW_BCM_CompuMethods_SC_F1_O0_UNoUnit 1 100 0.0 255.0 MAX_REFRESH 4 1 ECU_ADDRESS 0x400E31D5 /end MEASUREMENT
/begin MEASUREMENT MCore_Unconnected_DriverSeatTiltPos "unsigned integer 8bit" UBYTE VW_BCM_CompuMethods_SC_F1_O0_UNoUnit 1 100 0.0 255.0 MAX_REFRESH 4 1 ECU_ADDRESS 0x400E31D6 /end MEASUREMENT
/begin MEASUREMENT MCore_Unconnected_PsngrSeatBackRestPos "unsigned integer 8bit" UBYTE VW_BCM_CompuMethods_SC_F1_O0_UNoUnit 1 100 0.0 255.0 MAX_REFRESH 4 1 ECU_ADDRESS 0x400E31DB /end MEASUREMENT
/begin MEASUREMENT MCore_Unconnected_PsngrSeatLiftPos "unsigned integer 8bit" UBYTE VW_BCM_CompuMethods_SC_F1_O0_UNoUnit 1 100 0.0 255.0 MAX_REFRESH 4 1 ECU_ADDRESS 0x400E31DC /end MEASUREMENT
/begin MEASUREMENT MCore_Unconnected_PsngrSeatLongitudinalPos "unsigned integer 8bit" UBYTE VW_BCM_CompuMethods_SC_F1_O0_UNoUnit 1 100 0.0 255.0 MAX_REFRESH 4 1 ECU_ADDRESS 0x400E31D9 /end MEASUREMENT
/begin MEASUREMENT MCore_Unconnected_PsngrSeatTiltPos "unsigned integer 8bit" UBYTE VW_BCM_CompuMethods_SC_F1_O0_UNoUnit 1 100 0.0 255.0 MAX_REFRESH 4 1 ECU_ADDRESS 0x400E31DA /end MEASUREMENT
/begin MEASUREMENT MCore_Unconnected_RearSeatLeftBackRestPos "unsigned integer 8bit" UBYTE VW_BCM_CompuMethods_SC_F1_O0_UNoUnit 1 100 0.0 255.0 MAX_REFRESH 4 1 ECU_ADDRESS 0x400E31E3 /end MEASUREMENT
/begin MEASUREMENT MCore_Unconnected_RearSeatLeftLiftPos "unsigned integer 8bit" UBYTE VW_BCM_CompuMethods_SC_F1_O0_UNoUnit 1 100 0.0 255.0 MAX_REFRESH 4 1 ECU_ADDRESS 0x400E31E4 /end MEASUREMENT
/begin MEASUREMENT MCore_Unconnected_RearSeatLeftLongitudinalPos "unsigned integer 8bit" UBYTE VW_BCM_CompuMethods_SC_F1_O0_UNoUnit 1 100 0.0 255.0 MAX_REFRESH 4 1 ECU_ADDRESS 0x400E31E1 /end MEASUREMENT
/begin MEASUREMENT MCore_Unconnected_RearSeatLeftTiltPos "unsigned integer 8bit" UBYTE VW_BCM_CompuMethods_SC_F1_O0_UNoUnit 1 100 0.0 255.0 MAX_REFRESH 4 1 ECU_ADDRESS 0x400E31E2 /end MEASUREMENT
/begin MEASUREMENT MCore_Unconnected_RearSeatRightBackRestPos "unsigned integer 8bit" UBYTE VW_BCM_CompuMethods_SC_F1_O0_UNoUnit 1 100 0.0 255.0 MAX_REFRESH 4 1 ECU_ADDRESS 0x400E31DF /end MEASUREMENT
/begin MEASUREMENT MCore_Unconnected_RearSeatRightLiftPos "unsigned integer 8bit" UBYTE VW_BCM_CompuMethods_SC_F1_O0_UNoUnit 1 100 0.0 255.0 MAX_REFRESH 4 1 ECU_ADDRESS 0x400E31E0 /end MEASUREMENT
/begin MEASUREMENT MCore_Unconnected_RearSeatRightLongitudinalPos "unsigned integer 8bit" UBYTE VW_BCM_CompuMethods_SC_F1_O0_UNoUnit 1 100 0.0 255.0 MAX_REFRESH 4 1 ECU_ADDRESS 0x400E31DD /end MEASUREMENT
/begin MEASUREMENT MCore_Unconnected_RearSeatRightTiltPos "unsigned integer 8bit" UBYTE VW_BCM_CompuMethods_SC_F1_O0_UNoUnit 1 100 0.0 255.0 MAX_REFRESH 4 1 ECU_ADDRESS 0x400E31DE /end MEASUREMENT
/begin MEASUREMENT MCore_DriverSeatBackRestPos_0 "unsigned integer 8bit" UBYTE VW_BCM_CompuMethods_SC_F1_O0_UNoUnit 1 100 0.0 255.0 MAX_REFRESH 4 1 ECU_ADDRESS 0x400E3A33 /end MEASUREMENT
/begin MEASUREMENT MCore_DriverSeatLiftPos_0 "unsigned integer 8bit" UBYTE VW_BCM_CompuMethods_SC_F1_O0_UNoUnit 1 100 0.0 255.0 MAX_REFRESH 4 1 ECU_ADDRESS 0x400E3A34 /end MEASUREMENT
/begin MEASUREMENT MCore_DriverSeatLongitudinalPos_0 "unsigned integer 8bit" UBYTE VW_BCM_CompuMethods_SC_F1_O0_UNoUnit 1 100 0.0 255.0 MAX_REFRESH 4 1 ECU_ADDRESS 0x400E3A35 /end MEASUREMENT
/begin MEASUREMENT MCore_DriverSeatTiltPos_0 "unsigned integer 8bit" UBYTE VW_BCM_CompuMethods_SC_F1_O0_UNoUnit 1 100 0.0 255.0 MAX_REFRESH 4 1 ECU_ADDRESS 0x400E3A36 /end MEASUREMENT
/begin MEASUREMENT MCore_PsngrSeatBackRestPos_0 "unsigned integer 8bit" UBYTE VW_BCM_CompuMethods_SC_F1_O0_UNoUnit 1 100 0.0 255.0 MAX_REFRESH 4 1 ECU_ADDRESS 0x400E3A37 /end MEASUREMENT
/begin MEASUREMENT MCore_PsngrSeatLiftPos_0 "unsigned integer 8bit" UBYTE VW_BCM_CompuMethods_SC_F1_O0_UNoUnit 1 100 0.0 255.0 MAX_REFRESH 4 1 ECU_ADDRESS 0x400E3A38 /end MEASUREMENT
/begin MEASUREMENT MCore_PsngrSeatLongitudinalPos_0 "unsigned integer 8bit" UBYTE VW_BCM_CompuMethods_SC_F1_O0_UNoUnit 1 100 0.0 255.0 MAX_REFRESH 4 1 ECU_ADDRESS 0x400E3A39 /end MEASUREMENT
/begin MEASUREMENT MCore_PsngrSeatTiltPos_0 "unsigned integer 8bit" UBYTE VW_BCM_CompuMethods_SC_F1_O0_UNoUnit 1 100 0.0 255.0 MAX_REFRESH 4 1 ECU_ADDRESS 0x400E3A3A /end MEASUREMENT
/begin MEASUREMENT MCore_RearSeatLeftBackRestPos_0 "unsigned integer 8bit" UBYTE VW_BCM_CompuMethods_SC_F1_O0_UNoUnit 1 100 0.0 255.0 MAX_REFRESH 4 1 ECU_ADDRESS 0x400E3A3B /end MEASUREMENT
/begin MEASUREMENT MCore_RearSeatLeftLiftPos_0 "unsigned integer 8bit" UBYTE VW_BCM_CompuMethods_SC_F1_O0_UNoUnit 1 100 0.0 255.0 MAX_REFRESH 4 1 ECU_ADDRESS 0x400E3A3C /end MEASUREMENT
/begin MEASUREMENT MCore_RearSeatLeftLongitudinalPos_0 "unsigned integer 8bit" UBYTE VW_BCM_CompuMethods_SC_F1_O0_UNoUnit 1 100 0.0 255.0 MAX_REFRESH 4 1 ECU_ADDRESS 0x400E3A3D /end MEASUREMENT
/begin MEASUREMENT MCore_RearSeatLeftTiltPos_0 "unsigned integer 8bit" UBYTE VW_BCM_CompuMethods_SC_F1_O0_UNoUnit 1 100 0.0 255.0 MAX_REFRESH 4 1 ECU_ADDRESS 0x400E3A3E /end MEASUREMENT
/begin MEASUREMENT MCore_RearSeatRightBackRestPos_0 "unsigned integer 8bit" UBYTE VW_BCM_CompuMethods_SC_F1_O0_UNoUnit 1 100 0.0 255.0 MAX_REFRESH 4 1 ECU_ADDRESS 0x400E3A3F /end MEASUREMENT
/begin MEASUREMENT MCore_RearSeatRightLiftPos_0 "unsigned integer 8bit" UBYTE VW_BCM_CompuMethods_SC_F1_O0_UNoUnit 1 100 0.0 255.0 MAX_REFRESH 4 1 ECU_ADDRESS 0x400E3A40 /end MEASUREMENT
/begin MEASUREMENT MCore_RearSeatRightLongitudinalPos_0 "unsigned integer 8bit" UBYTE VW_BCM_CompuMethods_SC_F1_O0_UNoUnit 1 100 0.0 255.0 MAX_REFRESH 4 1 ECU_ADDRESS 0x400E3A41 /end MEASUREMENT
/begin MEASUREMENT MCore_RearSeatRightTiltPos_0 "unsigned integer 8bit" UBYTE VW_BCM_CompuMethods_SC_F1_O0_UNoUnit 1 100 0.0 255.0 MAX_REFRESH 4 1 ECU_ADDRESS 0x400E3A42 /end MEASUREMENT
/begin MEASUREMENT MCore_StMon_376 "" UBYTE DefaultIdenticalCompu 1 100 0.0 255.0 MAX_REFRESH 4 1 ECU_ADDRESS 0x400E3A43
 /begin ANNOTATION ANNOTATION_LABEL "Description (coming from AUTOSAR DESC field)"
  /begin ANNOTATION_TEXT "Application data type for error type data elements. Error types are bit coded\r\n" /end ANNOTATION_TEXT
 /end ANNOTATION
/end MEASUREMENT
/begin MEASUREMENT MCore_StMon_377 "" UBYTE DefaultIdenticalCompu 1 100 0.0 255.0 MAX_REFRESH 4 1 ECU_ADDRESS 0x400E3A44
 /begin ANNOTATION ANNOTATION_LABEL "Description (coming from AUTOSAR DESC field)"
  /begin ANNOTATION_TEXT "Application data type for error type data elements. Error types are bit coded\r\n" /end ANNOTATION_TEXT
 /end ANNOTATION
/end MEASUREMENT
/begin MEASUREMENT MCore_StMon_378 "" UBYTE DefaultIdenticalCompu 1 100 0.0 255.0 MAX_REFRESH 4 1 ECU_ADDRESS 0x400E3A45
 /begin ANNOTATION ANNOTATION_LABEL "Description (coming from AUTOSAR DESC field)"
  /begin ANNOTATION_TEXT "Application data type for error type data elements. Error types are bit coded\r\n" /end ANNOTATION_TEXT
 /end ANNOTATION
/end MEASUREMENT
/begin MEASUREMENT MCore_StMon_379 "" UBYTE DefaultIdenticalCompu 1 100 0.0 255.0 MAX_REFRESH 4 1 ECU_ADDRESS 0x400E3A46
 /begin ANNOTATION ANNOTATION_LABEL "Description (coming from AUTOSAR DESC field)"
  /begin ANNOTATION_TEXT "Application data type for error type data elements. Error types are bit coded\r\n" /end ANNOTATION_TEXT
 /end ANNOTATION
/end MEASUREMENT
/begin MEASUREMENT MCore_StMon_380 "" UBYTE DefaultIdenticalCompu 1 100 0.0 255.0 MAX_REFRESH 4 1 ECU_ADDRESS 0x400E3A47
 /begin ANNOTATION ANNOTATION_LABEL "Description (coming from AUTOSAR DESC field)"
  /begin ANNOTATION_TEXT "Application data type for error type data elements. Error types are bit coded\r\n" /end ANNOTATION_TEXT
 /end ANNOTATION
/end MEASUREMENT
/begin MEASUREMENT MCore_StMon_381 "" UBYTE DefaultIdenticalCompu 1 100 0.0 255.0 MAX_REFRESH 4 1 ECU_ADDRESS 0x400E3A48
 /begin ANNOTATION ANNOTATION_LABEL "Description (coming from AUTOSAR DESC field)"
  /begin ANNOTATION_TEXT "Application data type for error type data elements. Error types are bit coded\r\n" /end ANNOTATION_TEXT
 /end ANNOTATION
/end MEASUREMENT
/begin MEASUREMENT MCore_TesterValue_31 "Boolean" UBYTE Methods_boolean 1 100 0.0 1.0 MAX_REFRESH 4 1 ECU_ADDRESS 0x400E3A4A /end MEASUREMENT
/begin MEASUREMENT MCore_TesterValue_32 "Boolean" UBYTE Methods_boolean 1 100 0.0 1.0 MAX_REFRESH 4 1 ECU_ADDRESS 0x400E3A4C /end MEASUREMENT
/begin MEASUREMENT MCore_TesterValue_33 "Boolean" UBYTE Methods_boolean 1 100 0.0 1.0 MAX_REFRESH 4 1 ECU_ADDRESS 0x400E3A4E /end MEASUREMENT
/begin MEASUREMENT MCore_TesterValue_34 "Boolean" UBYTE Methods_boolean 1 100 0.0 1.0 MAX_REFRESH 4 1 ECU_ADDRESS 0x400E3A50 /end MEASUREMENT
/begin MEASUREMENT MCore_TesterValue_35 "Boolean" UBYTE Methods_boolean 1 100 0.0 1.0 MAX_REFRESH 4 1 ECU_ADDRESS 0x400E3A52 /end MEASUREMENT
/begin MEASUREMENT MCore_TesterValue_36 "Boolean" UBYTE Methods_boolean 1 100 0.0 1.0 MAX_REFRESH 4 1 ECU_ADDRESS 0x400E3A54 /end MEASUREMENT
/begin MEASUREMENT MCore_TesterValue_37 "Boolean" UBYTE Methods_boolean 1 100 0.0 1.0 MAX_REFRESH 4 1 ECU_ADDRESS 0x400E3A56 /end MEASUREMENT
/begin MEASUREMENT MCore_TesterValue_38 "Boolean" UBYTE Methods_boolean 1 100 0.0 1.0 MAX_REFRESH 4 1 ECU_ADDRESS 0x400E3A58 /end MEASUREMENT
/begin MEASUREMENT MCore_Unconnected_TesterValue_39 "Boolean" UBYTE Methods_boolean 1 100 0.0 1.0 MAX_REFRESH 4 1 ECU_ADDRESS 0x400E31E7 /end MEASUREMENT
/begin MEASUREMENT MCore_Unconnected_TesterValue_40 "Boolean" UBYTE Methods_boolean 1 100 0.0 1.0 MAX_REFRESH 4 1 ECU_ADDRESS 0x400E31E8 /end MEASUREMENT
/begin MEASUREMENT MCore_TesterValue_u8_1 "unsigned integer 8bit" UBYTE VW_BCM_CompuMethods_SC_F1_O0_UNoUnit 1 100 0.0 255.0 MAX_REFRESH 4 1 ECU_ADDRESS 0x400E3A5A /end MEASUREMENT
/begin MEASUREMENT MCore_TesterValue_u8_2 "unsigned integer 8bit" UBYTE VW_BCM_CompuMethods_SC_F1_O0_UNoUnit 1 100 0.0 255.0 MAX_REFRESH 4 1 ECU_ADDRESS 0x400E3A5C /end MEASUREMENT
/begin MEASUREMENT MCore_RequestActive_60 "Boolean" UBYTE Methods_boolean 1 100 0.0 1.0 MAX_REFRESH 4 1 ECU_ADDRESS 0x400E3A5D /end MEASUREMENT
/begin MEASUREMENT MCore_RequestValue_53 "Boolean" UBYTE Methods_boolean 1 100 0.0 1.0 MAX_REFRESH 4 1 ECU_ADDRESS 0x400E3A5E /end MEASUREMENT
/begin MEASUREMENT MCore_RequestActive_61 "Boolean" UBYTE Methods_boolean 1 100 0.0 1.0 MAX_REFRESH 4 1 ECU_ADDRESS 0x400E3A5F /end MEASUREMENT
/begin MEASUREMENT MCore_RequestValue_54 "Boolean" UBYTE Methods_boolean 1 100 0.0 1.0 MAX_REFRESH 4 1 ECU_ADDRESS 0x400E3A60 /end MEASUREMENT
/begin MEASUREMENT MCore_Unconnected_DeExternalBacklightActivation "" UBYTE DefaultIdenticalCompu 1 100 0.0 255.0 MAX_REFRESH 4 1 ECU_ADDRESS 0x400E31E9 /end MEASUREMENT
/begin MEASUREMENT MCore_DeSBMTEnableDomeLight "" UBYTE CompuMethod_CM_SBMTEnableDomeLight 1 100 0.0 255.0 MAX_REFRESH 4 1 ECU_ADDRESS 0x400E31EA /end MEASUREMENT
/begin MEASUREMENT MCore_IDC_RearLightCommand_Left_0 "Boolean" UBYTE Methods_boolean 1 100 0.0 1.0 MAX_REFRESH 4 1 ECU_ADDRESS 0x400E335F /end MEASUREMENT
/begin MEASUREMENT MCore_Unconnected_DeBacklightsCmd "" UBYTE Methods_boolean 1 100 0.0 255.0 MAX_REFRESH 4 1 ECU_ADDRESS 0x400E31EB /end MEASUREMENT
/begin MEASUREMENT MCore_Unconnected_DeBrightnessAdjustment "" UBYTE CompuMethod_CM_BrightnessAdjustment 1 100 0.0 255.0 MAX_REFRESH 4 1 ECU_ADDRESS 0x400E31EC /end MEASUREMENT
/begin MEASUREMENT MCore_Unconnected_DeDeactivation_DoorOpening_Button "" UBYTE CompuMethod_CM_VF078_Button_Status 1 100 0.0 255.0 MAX_REFRESH 4 1 ECU_ADDRESS 0x400D9209 /end MEASUREMENT
/begin MEASUREMENT MCore_Unconnected_DeRearLightAlignment_Button "" UBYTE CompuMethod_CM_VF078_Button_Status 1 100 0.0 255.0 MAX_REFRESH 4 1 ECU_ADDRESS 0x400D920A /end MEASUREMENT
/begin MEASUREMENT MCore_Unconnected_DeRearLightAlignment_Led "" UBYTE CompuMethod_CM_VF078_On_Off 1 100 0.0 255.0 MAX_REFRESH 4 1 ECU_ADDRESS 0x400E31EE /end MEASUREMENT
/begin MEASUREMENT MCore_DeFuelFillerFlapLock "Boolean" UBYTE Methods_boolean 1 100 0.0 1.0 MAX_REFRESH 4 1 ECU_ADDRESS 0x400E3A63 /end MEASUREMENT
/begin MEASUREMENT MCore_DeFuelFillerFlapUnlock "Boolean" UBYTE Methods_boolean 1 100 0.0 1.0 MAX_REFRESH 4 1 ECU_ADDRESS 0x400E3A64 /end MEASUREMENT
/begin MEASUREMENT MCore_RequestActive_62 "Boolean" UBYTE Methods_boolean 1 100 0.0 1.0 MAX_REFRESH 4 1 ECU_ADDRESS 0x400E3A65 /end MEASUREMENT
/begin MEASUREMENT MCore_RequestValue_55 "Boolean" UBYTE Methods_boolean 1 100 0.0 1.0 MAX_REFRESH 4 1 ECU_ADDRESS 0x400E3A66 /end MEASUREMENT
/begin MEASUREMENT MCore_RequestActive_63 "Boolean" UBYTE Methods_boolean 1 100 0.0 1.0 MAX_REFRESH 4 1 ECU_ADDRESS 0x400E3A67 /end MEASUREMENT
/begin MEASUREMENT MCore_RequestValue_56 "Boolean" UBYTE Methods_boolean 1 100 0.0 1.0 MAX_REFRESH 4 1 ECU_ADDRESS 0x400E3A68 /end MEASUREMENT
/begin MEASUREMENT MCore_Unconnected_TesterValue_41 "Boolean" UBYTE Methods_boolean 1 100 0.0 1.0 MAX_REFRESH 4 1 ECU_ADDRESS 0x400E31F3 /end MEASUREMENT
/begin MEASUREMENT MCore_Unconnected_TesterValue_42 "Boolean" UBYTE Methods_boolean 1 100 0.0 1.0 MAX_REFRESH 4 1 ECU_ADDRESS 0x400E31F4 /end MEASUREMENT
/begin MEASUREMENT MCore_TesterValue_43 "Boolean" UBYTE Methods_boolean 1 100 0.0 1.0 MAX_REFRESH 4 1 ECU_ADDRESS 0x400E3A6A /end MEASUREMENT
/begin MEASUREMENT MCore_TesterValue_44 "Boolean" UBYTE Methods_boolean 1 100 0.0 1.0 MAX_REFRESH 4 1 ECU_ADDRESS 0x400E3A6C /end MEASUREMENT
/begin MEASUREMENT MCore_DE_VF087_PiAlarmState "" UBYTE DataType_DataTypeSemantics_CM_VF087_AlarmState 1 100 0.0 255.0 MAX_REFRESH 4 1 ECU_ADDRESS 0x400E3A6D
 /begin ANNOTATION ANNOTATION_LABEL "Description (coming from AUTOSAR DESC field)" /begin ANNOTATION_TEXT "Source signal range: [0,1]\r\n" /end ANNOTATION_TEXT /end ANNOTATION
/end MEASUREMENT
/begin MEASUREMENT MCore_DE_DeterrenceLedSt "" UBYTE Methods_boolean 1 100 0.0 255.0 MAX_REFRESH 4 1 ECU_ADDRESS 0x400E3A6E
 /begin ANNOTATION ANNOTATION_LABEL "Description (coming from AUTOSAR DESC field)" /begin ANNOTATION_TEXT "boolean basetype (0 = false, 1 = true)\r\n" /end ANNOTATION_TEXT /end ANNOTATION
/end MEASUREMENT
/begin MEASUREMENT MCore_DiagFeedback_205_b "" UBYTE Methods_boolean 1 100 0.0 255.0 MAX_REFRESH 4 1 ECU_ADDRESS 0x400E3A6F
 /begin ANNOTATION ANNOTATION_LABEL "Description (coming from AUTOSAR DESC field)" /begin ANNOTATION_TEXT "boolean basetype (0 = false, 1 = true)\r\n" /end ANNOTATION_TEXT /end ANNOTATION
/end MEASUREMENT
/begin MEASUREMENT MCore_DiagFeedback_F081_b "" UBYTE Methods_boolean 1 100 0.0 255.0 MAX_REFRESH 4 1 ECU_ADDRESS 0x400E3A70
 /begin ANNOTATION ANNOTATION_LABEL "Description (coming from AUTOSAR DESC field)" /begin ANNOTATION_TEXT "boolean basetype (0 = false, 1 = true)\r\n" /end ANNOTATION_TEXT /end ANNOTATION
/end MEASUREMENT
/begin MEASUREMENT MCore_VF087_IoHwDeterrenceLed "" UBYTE Methods_boolean 1 100 0.0 255.0 MAX_REFRESH 4 1 ECU_ADDRESS 0x400E3A71
 /begin ANNOTATION ANNOTATION_LABEL "Description (coming from AUTOSAR DESC field)" /begin ANNOTATION_TEXT "boolean basetype (0 = false, 1 = true)\r\n" /end ANNOTATION_TEXT /end ANNOTATION
/end MEASUREMENT
/begin MEASUREMENT MCore_VF087_LIN2_enabled_b "Boolean" UBYTE Methods_boolean 1 100 0.0 1.0 MAX_REFRESH 4 1 ECU_ADDRESS 0x400E3A72 /end MEASUREMENT
/begin MEASUREMENT MCore_MasterStatus_b "" UBYTE Methods_boolean 1 100 0.0 255.0 MAX_REFRESH 4 1 ECU_ADDRESS 0x400E3A73
 /begin ANNOTATION ANNOTATION_LABEL "Description (coming from AUTOSAR DESC field)" /begin ANNOTATION_TEXT "boolean basetype (0 = false, 1 = true)\r\n" /end ANNOTATION_TEXT /end ANNOTATION
/end MEASUREMENT
/begin MEASUREMENT MCore_SlaveStatus_b "" UBYTE Methods_boolean 1 100 0.0 255.0 MAX_REFRESH 4 1 ECU_ADDRESS 0x400E3A74
 /begin ANNOTATION ANNOTATION_LABEL "Description (coming from AUTOSAR DESC field)" /begin ANNOTATION_TEXT "boolean basetype (0 = false, 1 = true)\r\n" /end ANNOTATION_TEXT /end ANNOTATION
/end MEASUREMENT
/begin MEASUREMENT MCore_VF087_MUW_enabled_u8 "unsigned integer 8bit" UBYTE VW_BCM_CompuMethods_SC_F1_O0_UNoUnit 1 100 0.0 255.0 MAX_REFRESH 4 1 ECU_ADDRESS 0x400E3A75 /end MEASUREMENT
/begin MEASUREMENT MCore_DE_IoHwMUWPwrSply "unsigned integer 8bit" UBYTE VW_BCM_CompuMethods_SC_F1_O0_UNoUnit 1 100 0.0 255.0 MAX_REFRESH 4 1 ECU_ADDRESS 0x400E3A76 /end MEASUREMENT
/begin MEASUREMENT MCore_DE_TheftAlarmStatus "" UBYTE DataType_DataTypeSemantics_CM_VF087_TheftAlarmStatus 1 100 0.0 255.0 MAX_REFRESH 4 1 ECU_ADDRESS 0x52800062
 /begin ANNOTATION ANNOTATION_LABEL "Description (coming from AUTOSAR DESC field)" /begin ANNOTATION_TEXT "Source signal range: [0,1]\r\n" /end ANNOTATION_TEXT /end ANNOTATION
/end MEASUREMENT
/begin MEASUREMENT MCore_DeVPSAlarmBlinkCntrl "" UBYTE DefaultIdenticalCompu 1 100 0.0 255.0 MAX_REFRESH 4 1 ECU_ADDRESS 0x528081B2 /end MEASUREMENT
/begin MEASUREMENT MCore_DeVPSAlarmModeCntrl "" UBYTE DataType_DataTypeSemantics_DT_VF087_VPSAlarmModeCntrl 1 100 0.0 255.0 MAX_REFRESH 4 1 ECU_ADDRESS 0x5280D388 /end MEASUREMENT
/begin MEASUREMENT MCore_DE_VPSAlarmStartWarningCntrl "" UBYTE Methods_boolean 1 100 0.0 255.0 MAX_REFRESH 4 1 ECU_ADDRESS 0x400E3A79
 /begin ANNOTATION ANNOTATION_LABEL "Description (coming from AUTOSAR DESC field)" /begin ANNOTATION_TEXT "boolean basetype (0 = false, 1 = true)\r\n" /end ANNOTATION_TEXT /end ANNOTATION
/end MEASUREMENT
/begin MEASUREMENT MCore_DeOpenCloseDoorPositionLightCmd "" UBYTE Methods_boolean 1 100 0.0 255.0 MAX_REFRESH 4 1 ECU_ADDRESS 0x528081B3
 /begin ANNOTATION ANNOTATION_LABEL "Description (coming from AUTOSAR DESC field)"
  /begin ANNOTATION_TEXT "Boolean has the value space required to support the mathematical concept of binary-valued logic: {true, false}.\r\n" /end ANNOTATION_TEXT
 /end ANNOTATION
/end MEASUREMENT
/begin MEASUREMENT MCore_DeAVHDriverDoorSts_0 "" UBYTE Methods_boolean 1 100 0.0 255.0 MAX_REFRESH 4 1 ECU_ADDRESS 0x5280D389 /end MEASUREMENT
/begin MEASUREMENT MCore_DeDriverDoorSts_0 "" UBYTE Methods_boolean 1 100 0.0 255.0 MAX_REFRESH 4 1 ECU_ADDRESS 0x528081B4
 /begin ANNOTATION ANNOTATION_LABEL "Description (coming from AUTOSAR DESC field)" /begin ANNOTATION_TEXT "This input indicates DriverDoor status\r\n" /end ANNOTATION_TEXT /end ANNOTATION
/end MEASUREMENT
/begin MEASUREMENT MCore_DeDriverDoorSts_CAN_0 "" UBYTE VF091_DataType_DataTypeSemantics_CM_DiverDoorSts 1 100 0.0 255.0 MAX_REFRESH 4 1 ECU_ADDRESS 0x528081B5 /end MEASUREMENT
/begin MEASUREMENT MCore_DePsngrDoorSts_0 "" UBYTE Methods_boolean 1 100 0.0 255.0 MAX_REFRESH 4 1 ECU_ADDRESS 0x528081B6
 /begin ANNOTATION ANNOTATION_LABEL "Description (coming from AUTOSAR DESC field)" /begin ANNOTATION_TEXT "This input indicates PsngrDoorSts status.\r\n" /end ANNOTATION_TEXT /end ANNOTATION
/end MEASUREMENT
/begin MEASUREMENT MCore_DePsngrDoorSts_CAN_0 "" UBYTE VF091_DataType_DataTypeSemantics_CM_PsngrDoorSts_CCAN1 1 100 0.0 255.0 MAX_REFRESH 4 1 ECU_ADDRESS 0x528081B7 /end MEASUREMENT
/begin MEASUREMENT MCore_DeRearLeftDoorSts_0 "" UBYTE Methods_boolean 1 100 0.0 255.0 MAX_REFRESH 4 1 ECU_ADDRESS 0x528081B8
 /begin ANNOTATION ANNOTATION_LABEL "Description (coming from AUTOSAR DESC field)" /begin ANNOTATION_TEXT "This input indicates Rear left door status\r\n" /end ANNOTATION_TEXT /end ANNOTATION
/end MEASUREMENT
/begin MEASUREMENT MCore_DeRearLeftDoorSts_CAN_0 "" UBYTE VF091_DataType_DataTypeSemantics_CM_DiverDoorSts 1 100 0.0 255.0 MAX_REFRESH 4 1 ECU_ADDRESS 0x528081B9 /end MEASUREMENT
/begin MEASUREMENT MCore_DeRearRightDoorSts_0 "" UBYTE VF091_DataType_DataTypeSemantics_CM_PsngrDoorSts_CCAN1 1 100 0.0 255.0 MAX_REFRESH 4 1 ECU_ADDRESS 0x528081BA
 /begin ANNOTATION ANNOTATION_LABEL "Description (coming from AUTOSAR DESC field)" /begin ANNOTATION_TEXT "This input indicates rear right Door status\r\n" /end ANNOTATION_TEXT /end ANNOTATION
/end MEASUREMENT
/begin MEASUREMENT MCore_DeRearRightDoorSts_CAN_0 "" UBYTE VF091_DataType_DataTypeSemantics_CM_DiverDoorSts 1 100 0.0 255.0 MAX_REFRESH 4 1 ECU_ADDRESS 0x528081BB /end MEASUREMENT
/begin MEASUREMENT MCore_DeLockUnlockDoorActivation "Boolean" UBYTE Methods_boolean 1 100 0.0 1.0 MAX_REFRESH 4 1 ECU_ADDRESS 0x400E3A7A /end MEASUREMENT
/begin MEASUREMENT MCore_DeLock_Unlock_ButtonFbkLed "Boolean" UBYTE Methods_boolean 1 100 0.0 1.0 MAX_REFRESH 4 1 ECU_ADDRESS 0x400E3A7B /end MEASUREMENT
/begin MEASUREMENT MCore_DeSBMTEnableDomeLockUnlock "" UBYTE App_VF092_CompuMethod_PiSBMTEnableDomeLockUnlock 1 100 0.0 255.0 MAX_REFRESH 4 1 ECU_ADDRESS 0x400E31F8 /end MEASUREMENT
/begin MEASUREMENT MCore_Unconnected_DeLockUnlockButton_Led "" UBYTE Methods_boolean 1 100 0.0 255.0 MAX_REFRESH 4 1 ECU_ADDRESS 0x400E31F9 /end MEASUREMENT
/begin MEASUREMENT MCore_VF092_actvLockUnlckDoors_Btn "Boolean" UBYTE Methods_boolean 1 100 0.0 1.0 MAX_REFRESH 4 1 ECU_ADDRESS 0x400E3A7C /end MEASUREMENT
/begin MEASUREMENT MCore_DeNBC_LH_Lock "Boolean" UBYTE Methods_boolean 1 100 0.0 1.0 MAX_REFRESH 4 1 ECU_ADDRESS 0x400E31FA /end MEASUREMENT
/begin MEASUREMENT MCore_DeNBC_LV_Lock "Boolean" UBYTE Methods_boolean 1 100 0.0 1.0 MAX_REFRESH 4 1 ECU_ADDRESS 0x400E31FC /end MEASUREMENT
/begin MEASUREMENT MCore_DeNBC_RH_Lock "Boolean" UBYTE Methods_boolean 1 100 0.0 1.0 MAX_REFRESH 4 1 ECU_ADDRESS 0x400E31FB /end MEASUREMENT
/begin MEASUREMENT MCore_DeNBC_RV_Lock "Boolean" UBYTE Methods_boolean 1 100 0.0 1.0 MAX_REFRESH 4 1 ECU_ADDRESS 0x400E31FD /end MEASUREMENT
/begin MEASUREMENT MCore_VF092_actvLockUnlckTrfromLCC "Boolean" UBYTE Methods_boolean 1 100 0.0 1.0 MAX_REFRESH 4 1 ECU_ADDRESS 0x400E3A7D /end MEASUREMENT
/begin MEASUREMENT MCore_VF092_actvTrAutLock "Boolean" UBYTE Methods_boolean 1 100 0.0 1.0 MAX_REFRESH 4 1 ECU_ADDRESS 0x400E3A7E /end MEASUREMENT
/begin MEASUREMENT MCore_DeVPSDoorSts_0 "" UBYTE App_VF092_CompuMethod_DT_VPSDoorSts 1 100 0.0 255.0 MAX_REFRESH 4 1 ECU_ADDRESS 0x400E3A7F /end MEASUREMENT
/begin MEASUREMENT MCore_DeVPSDriverDoorSts "" UBYTE App_VF092_CompuMethod_CM_VPSDriverDoorSts 1 100 0.0 255.0 MAX_REFRESH 4 1 ECU_ADDRESS 0x400AB390 /end MEASUREMENT
/begin MEASUREMENT MCore_DeVPSPsngrDoorSts "" UBYTE App_VF092_CompuMethod_CM_VPSPsngrDoorSts 1 100 0.0 255.0 MAX_REFRESH 4 1 ECU_ADDRESS 0x400AB391 /end MEASUREMENT
/begin MEASUREMENT MCore_DeVPSRearLeftDoorSts "unsigned integer 8bit" UBYTE VW_BCM_CompuMethods_SC_F1_O0_UNoUnit 1 100 0.0 255.0 MAX_REFRESH 4 1 ECU_ADDRESS 0x400AB392 /end MEASUREMENT
/begin MEASUREMENT MCore_DeVPSRearRightDoorSts "unsigned integer 8bit" UBYTE VW_BCM_CompuMethods_SC_F1_O0_UNoUnit 1 100 0.0 255.0 MAX_REFRESH 4 1 ECU_ADDRESS 0x400AB393 /end MEASUREMENT
/begin MEASUREMENT MCore_VF228_stRearButtonDoorLockCtrl "Boolean" UBYTE Methods_boolean 1 100 0.0 1.0 MAX_REFRESH 4 1 ECU_ADDRESS 0x400E3A80 /end MEASUREMENT
/begin MEASUREMENT MCore_VF228_stRearButtonDoorUnlckCtrl "Boolean" UBYTE Methods_boolean 1 100 0.0 1.0 MAX_REFRESH 4 1 ECU_ADDRESS 0x400E3A81 /end MEASUREMENT
/begin MEASUREMENT MCore_Unconnected_DriverCmdCompletedCntrl "Boolean" UBYTE Methods_boolean 1 100 0.0 1.0 MAX_REFRESH 4 1 ECU_ADDRESS 0x400E31FF /end MEASUREMENT
/begin MEASUREMENT MCore_Unconnected_DriverHRWindowsDownSts "Boolean" UBYTE Methods_boolean 1 100 0.0 1.0 MAX_REFRESH 4 1 ECU_ADDRESS 0x400E3201 /end MEASUREMENT
/begin MEASUREMENT MCore_Unconnected_DriverHRWindowsUpSts "Boolean" UBYTE Methods_boolean 1 100 0.0 1.0 MAX_REFRESH 4 1 ECU_ADDRESS 0x400E3200 /end MEASUREMENT
/begin MEASUREMENT MCore_Unconnected_PsngrCmdCompletedCntrl "Boolean" UBYTE Methods_boolean 1 100 0.0 1.0 MAX_REFRESH 4 1 ECU_ADDRESS 0x400E3203 /end MEASUREMENT
/begin MEASUREMENT MCore_Unconnected_PsngrHRWindowsDownSts "Boolean" UBYTE Methods_boolean 1 100 0.0 1.0 MAX_REFRESH 4 1 ECU_ADDRESS 0x400E3205 /end MEASUREMENT
/begin MEASUREMENT MCore_Unconnected_PsngrHRWindowsUpSts "Boolean" UBYTE Methods_boolean 1 100 0.0 1.0 MAX_REFRESH 4 1 ECU_ADDRESS 0x400E3204 /end MEASUREMENT
/begin MEASUREMENT MCore_Unconnected_WLM_CapoteWindowsMovementCmd_LIN4 "unsigned integer 8bit" UBYTE VW_BCM_CompuMethods_SC_F1_O0_UNoUnit 1 100 0.0 255.0 MAX_REFRESH 4 1 ECU_ADDRESS 0x400E3207 /end MEASUREMENT
/begin MEASUREMENT MCore_DeWLML_Movement_Command "" UBYTE VF104_CompuMethod_CM_WLML_Movement_Command 1 100 0.0 255.0 MAX_REFRESH 4 1 ECU_ADDRESS 0x400E3A82 /end MEASUREMENT
/begin MEASUREMENT MCore_DeWLMR_Movement_Command "" UBYTE VF104_CompuMethod_CM_WLMR_Movement_Command 1 100 0.0 255.0 MAX_REFRESH 4 1 ECU_ADDRESS 0x400E3A83 /end MEASUREMENT
/begin MEASUREMENT MCore_DeWMRL_Movement_Command "unsigned integer 8bit" UBYTE VW_BCM_CompuMethods_SC_F1_O0_UNoUnit 1 100 0.0 255.0 MAX_REFRESH 4 1 ECU_ADDRESS 0x400E3A84 /end MEASUREMENT
/begin MEASUREMENT MCore_DeWMRR_Movement_Command "unsigned integer 8bit" UBYTE VW_BCM_CompuMethods_SC_F1_O0_UNoUnit 1 100 0.0 255.0 MAX_REFRESH 4 1 ECU_ADDRESS 0x400E3A85 /end MEASUREMENT
/begin MEASUREMENT MCore_Unconnected_VF916_DriverWindowSts "unsigned integer 8bit" UBYTE VW_BCM_CompuMethods_SC_F1_O0_UNoUnit 1 100 0.0 255.0 MAX_REFRESH 4 1 ECU_ADDRESS 0x400E3208 /end MEASUREMENT
/begin MEASUREMENT MCore_Unconnected_VF916_PsngrWindowSts "unsigned integer 8bit" UBYTE VW_BCM_CompuMethods_SC_F1_O0_UNoUnit 1 100 0.0 255.0 MAX_REFRESH 4 1 ECU_ADDRESS 0x400E3209 /end MEASUREMENT
/begin MEASUREMENT MCore_Unconnected_VF916_RearLeftWindowSts "unsigned integer 8bit" UBYTE VW_BCM_CompuMethods_SC_F1_O0_UNoUnit 1 100 0.0 255.0 MAX_REFRESH 4 1 ECU_ADDRESS 0x400E320A /end MEASUREMENT
/begin MEASUREMENT MCore_Unconnected_VF916_RearRightWindowSts "unsigned integer 8bit" UBYTE VW_BCM_CompuMethods_SC_F1_O0_UNoUnit 1 100 0.0 255.0 MAX_REFRESH 4 1 ECU_ADDRESS 0x400E320B /end MEASUREMENT
/begin MEASUREMENT MCore_VF005_NBCCrashSts_CORRECT_0 "unsigned integer 8bit" UBYTE DefaultIdenticalCompu 1 100 0.0 255.0 MAX_REFRESH 4 1 ECU_ADDRESS 0x400E3A86 /end MEASUREMENT
/begin MEASUREMENT MCore_DriverHRWindowInitializedSts "Boolean" UBYTE Methods_boolean 1 100 0.0 1.0 MAX_REFRESH 4 1 ECU_ADDRESS 0x400E3A87 /end MEASUREMENT
/begin MEASUREMENT MCore_DriverHRWindowsSts "unsigned integer 8bit" UBYTE VW_BCM_CompuMethods_SC_F1_O0_UNoUnit 1 100 0.0 255.0 MAX_REFRESH 4 1 ECU_ADDRESS 0x400E3A88 /end MEASUREMENT
/begin MEASUREMENT MCore_PsgnrHRWindowInitializedSts "Boolean" UBYTE Methods_boolean 1 100 0.0 1.0 MAX_REFRESH 4 1 ECU_ADDRESS 0x400E3A89 /end MEASUREMENT
/begin MEASUREMENT MCore_PsgnrHRWindowsSts "unsigned integer 8bit" UBYTE VW_BCM_CompuMethods_SC_F1_O0_UNoUnit 1 100 0.0 255.0 MAX_REFRESH 4 1 ECU_ADDRESS 0x400E3A8A /end MEASUREMENT
/begin MEASUREMENT MCore_AutomaticDownCntrl "Boolean" UBYTE Methods_boolean 1 100 0.0 1.0 MAX_REFRESH 4 1 ECU_ADDRESS 0x400E3A8B /end MEASUREMENT
/begin MEASUREMENT MCore_DeWindowsFunctionKeyOffSts "" UBYTE Methods_boolean 1 100 0.0 255.0 MAX_REFRESH 4 1 ECU_ADDRESS 0x528081BD /end MEASUREMENT
/begin MEASUREMENT MCore_StMon_382 "" UBYTE DefaultIdenticalCompu 1 100 0.0 255.0 MAX_REFRESH 4 1 ECU_ADDRESS 0x400E3A8E
 /begin ANNOTATION ANNOTATION_LABEL "Description (coming from AUTOSAR DESC field)"
  /begin ANNOTATION_TEXT "Application data type for error type data elements. Error types are bit coded\r\n" /end ANNOTATION_TEXT
 /end ANNOTATION
/end MEASUREMENT
/begin MEASUREMENT MCore_StMon_383 "" UBYTE DefaultIdenticalCompu 1 100 0.0 255.0 MAX_REFRESH 4 1 ECU_ADDRESS 0x400E3A8F
 /begin ANNOTATION ANNOTATION_LABEL "Description (coming from AUTOSAR DESC field)"
  /begin ANNOTATION_TEXT "Application data type for error type data elements. Error types are bit coded\r\n" /end ANNOTATION_TEXT
 /end ANNOTATION
/end MEASUREMENT
/begin MEASUREMENT MCore_NIT_MirrorProfileReq "unsigned integer 8bit" UBYTE VW_BCM_CompuMethods_SC_F1_O0_UNoUnit 1 100 0.0 255.0 MAX_REFRESH 4 1 ECU_ADDRESS 0x400E3A90 /end MEASUREMENT
/begin MEASUREMENT MCore_NPS_MirrorFoldingCommand "Boolean" UBYTE Methods_boolean 1 100 0.0 1.0 MAX_REFRESH 4 1 ECU_ADDRESS 0x400E3A91 /end MEASUREMENT
/begin MEASUREMENT MCore_NPS_MirrorMovementDirectionCommand "unsigned integer 8bit" UBYTE VW_BCM_CompuMethods_SC_F1_O0_UNoUnit 1 100 0.0 255.0 MAX_REFRESH 4 1 ECU_ADDRESS 0x400E3A92 /end MEASUREMENT
/begin MEASUREMENT MCore_NPS_MirrorSelectorLeft "Boolean" UBYTE Methods_boolean 1 100 0.0 1.0 MAX_REFRESH 4 1 ECU_ADDRESS 0x400E3A93 /end MEASUREMENT
/begin MEASUREMENT MCore_NPS_MirrorSelectorRight "Boolean" UBYTE Methods_boolean 1 100 0.0 1.0 MAX_REFRESH 4 1 ECU_ADDRESS 0x400E3A94 /end MEASUREMENT
/begin MEASUREMENT MCore_NAG_DriverMirrorHorizPos "unsigned integer 8bit" UBYTE VW_BCM_CompuMethods_SC_F1_O0_UNoUnit 1 100 0.0 255.0 MAX_REFRESH 4 1 ECU_ADDRESS 0x400E3A95 /end MEASUREMENT
/begin MEASUREMENT MCore_NAG_DriverMirrorVertPos "unsigned integer 8bit" UBYTE VW_BCM_CompuMethods_SC_F1_O0_UNoUnit 1 100 0.0 255.0 MAX_REFRESH 4 1 ECU_ADDRESS 0x400E3A96 /end MEASUREMENT
/begin MEASUREMENT MCore_NAG_MirrorMovementReqCntrl "Boolean" UBYTE Methods_boolean 1 100 0.0 1.0 MAX_REFRESH 4 1 ECU_ADDRESS 0x400E3A97 /end MEASUREMENT
/begin MEASUREMENT MCore_NAG_PsngrMirrorHorizPos "unsigned integer 8bit" UBYTE VW_BCM_CompuMethods_SC_F1_O0_UNoUnit 1 100 0.0 255.0 MAX_REFRESH 4 1 ECU_ADDRESS 0x400E3A98 /end MEASUREMENT
/begin MEASUREMENT MCore_NAG_PsngrMirrorVertPos "unsigned integer 8bit" UBYTE VW_BCM_CompuMethods_SC_F1_O0_UNoUnit 1 100 0.0 255.0 MAX_REFRESH 4 1 ECU_ADDRESS 0x400E3A99 /end MEASUREMENT
/begin MEASUREMENT MCore_Unconnected_DeMirrorSelectorFeedback "" UBYTE VF119_DataType_DataTypeSemantics_CM_MirrorSelectorFeedback 1 100 0.0 255.0 MAX_REFRESH 4 1 ECU_ADDRESS 0x400E3240 /end MEASUREMENT
/begin MEASUREMENT MCore_Unconnected_DeMirror_User_Request "" UBYTE DefaultIdenticalCompu 1 100 0.0 255.0 MAX_REFRESH 4 1 ECU_ADDRESS 0x400E3242 /end MEASUREMENT
/begin MEASUREMENT MCore_DeHeatedWindowCmd "Boolean" UBYTE Methods_boolean 1 100 0.0 1.0 MAX_REFRESH 4 1 ECU_ADDRESS 0x528081C1 /end MEASUREMENT
/begin MEASUREMENT MCore_TesterValue_45 "Boolean" UBYTE Methods_boolean 1 100 0.0 1.0 MAX_REFRESH 4 1 ECU_ADDRESS 0x400E3A9B /end MEASUREMENT
/begin MEASUREMENT MCore_DePowerModeSts_2 "" UBYTE DataType_DataTypeSemantics_CM_PowerModeSts 1 100 0.0 255.0 MAX_REFRESH 4 1 ECU_ADDRESS 0x400E3A9C
 /begin ANNOTATION ANNOTATION_LABEL "Description (coming from AUTOSAR DESC field)"
  /begin ANNOTATION_TEXT "This input indicates if logistic mode is active or\r\n" "not.\r\n" /end ANNOTATION_TEXT
 /end ANNOTATION
/end MEASUREMENT
/begin MEASUREMENT MCore_NewFuncReq_WasherSts "Boolean" UBYTE Methods_boolean 1 100 0.0 1.0 MAX_REFRESH 4 1 ECU_ADDRESS 0x400E3A9D /end MEASUREMENT
/begin MEASUREMENT MCore_RainSensorActive_0 "Boolean" UBYTE Methods_boolean 1 100 0.0 1.0 MAX_REFRESH 4 1 ECU_ADDRESS 0x400E3A9E /end MEASUREMENT
/begin MEASUREMENT MCore_RequestActive_64 "Boolean" UBYTE Methods_boolean 1 100 0.0 1.0 MAX_REFRESH 4 1 ECU_ADDRESS 0x400E3A9F /end MEASUREMENT
/begin MEASUREMENT MCore_RequestValue_57 "Boolean" UBYTE Methods_boolean 1 100 0.0 1.0 MAX_REFRESH 4 1 ECU_ADDRESS 0x400E3AA0 /end MEASUREMENT
/begin MEASUREMENT MCore_Unconnected_TesterValue_46 "Boolean" UBYTE Methods_boolean 1 100 0.0 1.0 MAX_REFRESH 4 1 ECU_ADDRESS 0x400E324C /end MEASUREMENT
/begin MEASUREMENT MCore_TesterValue_47 "Boolean" UBYTE Methods_boolean 1 100 0.0 1.0 MAX_REFRESH 4 1 ECU_ADDRESS 0x400E3AA2 /end MEASUREMENT
/begin MEASUREMENT MCore_TesterValue_48 "Boolean" UBYTE Methods_boolean 1 100 0.0 1.0 MAX_REFRESH 4 1 ECU_ADDRESS 0x400E3AA4 /end MEASUREMENT
/begin MEASUREMENT MCore_DeAutoWindshieldWiperCmd "" UBYTE Methods_boolean 1 100 0.0 255.0 MAX_REFRESH 4 1 ECU_ADDRESS 0x528081C3
 /begin ANNOTATION ANNOTATION_LABEL "Description (coming from AUTOSAR DESC field)" /begin ANNOTATION_TEXT "boolean basetype (0 = false, 1 = true)\r\n" /end ANNOTATION_TEXT /end ANNOTATION
/end MEASUREMENT
/begin MEASUREMENT MCore_NFR_Speed_FA_FailSts_5 "Boolean" UBYTE Methods_boolean 1 100 0.0 1.0 MAX_REFRESH 4 1 ECU_ADDRESS 0x400E3AA5 /end MEASUREMENT
/begin MEASUREMENT MCore_Unconnected_DeFrontWindshieldPark "Boolean" UBYTE Methods_boolean 1 100 0.0 255.0 MAX_REFRESH 4 1 ECU_ADDRESS 0x400E324D /end MEASUREMENT
/begin MEASUREMENT MCore_Unconnected_DeFrontWindshieldWasherSts "" UBYTE Methods_boolean 1 100 0.0 255.0 MAX_REFRESH 4 1 ECU_ADDRESS 0x400E324E /end MEASUREMENT
/begin MEASUREMENT MCore_Unconnected_DeFrontWindshieldWiperSts "" UBYTE DataType_DataTypeSemantics_DT_FrontWindshieldWiperSts 1 100 0.0 255.0 MAX_REFRESH 4 1 ECU_ADDRESS 0x400E324F /end MEASUREMENT
/begin MEASUREMENT MCore_DeWiperInPark "" UBYTE Methods_boolean 1 100 0.0 255.0 MAX_REFRESH 4 1 ECU_ADDRESS 0x400E3250 /end MEASUREMENT
/begin MEASUREMENT MCore_Unconnected_DeWiperSpeed_int "" UBYTE DataType_DataTypeSemantics_DT_WiperSpeed_Internal 1 100 0.0 255.0 MAX_REFRESH 4 1 ECU_ADDRESS 0x400E3251 /end MEASUREMENT
/begin MEASUREMENT MCore_StMon_384 "" UBYTE DefaultIdenticalCompu 1 100 0.0 255.0 MAX_REFRESH 4 1 ECU_ADDRESS 0x400E3AA6
 /begin ANNOTATION ANNOTATION_LABEL "Description (coming from AUTOSAR DESC field)"
  /begin ANNOTATION_TEXT "Application data type for error type data elements. Error types are bit coded\r\n" /end ANNOTATION_TEXT
 /end ANNOTATION
/end MEASUREMENT
/begin MEASUREMENT MCore_Immediate_Stop_0 "" UBYTE DefaultIdenticalCompu 1 100 0.0 255.0 MAX_REFRESH 4 1 ECU_ADDRESS 0x400AB394
 /begin ANNOTATION ANNOTATION_LABEL "Description (coming from AUTOSAR DESC field)" /begin ANNOTATION_TEXT "8 bit unsigned integer basetype\r\n" /end ANNOTATION_TEXT /end ANNOTATION
/end MEASUREMENT
/begin MEASUREMENT MCore_Wiping_Frq_Request_0 "" UBYTE DefaultIdenticalCompu 1 100 0.0 255.0 MAX_REFRESH 4 1 ECU_ADDRESS 0x400E3AA7
 /begin ANNOTATION ANNOTATION_LABEL "Description (coming from AUTOSAR DESC field)" /begin ANNOTATION_TEXT "8 bit unsigned integer basetype\r\n" /end ANNOTATION_TEXT /end ANNOTATION
/end MEASUREMENT
/begin MEASUREMENT MCore_FrontWindshieldWiperMotErrSts "Boolean" UBYTE Methods_boolean 1 100 0.0 255.0 MAX_REFRESH 4 1 ECU_ADDRESS 0x400E3AA8 /end MEASUREMENT
/begin MEASUREMENT MCore_DEWindScreenWasherPumpCmd "Boolean" UBYTE Methods_boolean 1 100 0.0 1.0 MAX_REFRESH 4 1 ECU_ADDRESS 0x400E3AAA /end MEASUREMENT
/begin MEASUREMENT MCore_VF150_WiperWasherActive "Boolean" UBYTE Methods_boolean 1 100 0.0 1.0 MAX_REFRESH 4 1 ECU_ADDRESS 0x400E3AAB /end MEASUREMENT
/begin MEASUREMENT MCore_ASCInfoForDisplay "unsigned integer 8bit" UBYTE VW_BCM_CompuMethods_SC_F1_O0_UNoUnit 1 100 0.0 255.0 MAX_REFRESH 4 1 ECU_ADDRESS 0x5280D38C /end MEASUREMENT
/begin MEASUREMENT MCore_ASCSetupSts "unsigned integer 8bit" UBYTE VW_BCM_CompuMethods_SC_F1_O0_UNoUnit 1 100 0.0 255.0 MAX_REFRESH 4 1 ECU_ADDRESS 0x5280D38D /end MEASUREMENT
/begin MEASUREMENT MCore_NCS_NCSFailSts "unsigned integer 8bit" UBYTE VW_BCM_CompuMethods_SC_F1_O0_UNoUnit 1 100 0.0 3.0 MAX_REFRESH 4 1 ECU_ADDRESS 0x400E3AAC /end MEASUREMENT
/begin MEASUREMENT MCore_NCS_SuspensionModeSts "unsigned integer 8bit" UBYTE VW_BCM_CompuMethods_SC_F1_O0_UNoUnit 1 100 0.0 7.0 MAX_REFRESH 4 1 ECU_ADDRESS 0x400E3AAD /end MEASUREMENT
/begin MEASUREMENT MCore_StMon_385 "" UBYTE DefaultIdenticalCompu 1 100 0.0 255.0 MAX_REFRESH 4 1 ECU_ADDRESS 0x400E3AAE
 /begin ANNOTATION ANNOTATION_LABEL "Description (coming from AUTOSAR DESC field)"
  /begin ANNOTATION_TEXT "Application data type for error type data elements. Error types are bit coded\r\n" /end ANNOTATION_TEXT
 /end ANNOTATION
/end MEASUREMENT
/begin MEASUREMENT MCore_StMon_386 "" UBYTE DefaultIdenticalCompu 1 100 0.0 255.0 MAX_REFRESH 4 1 ECU_ADDRESS 0x400E3AAF
 /begin ANNOTATION ANNOTATION_LABEL "Description (coming from AUTOSAR DESC field)"
  /begin ANNOTATION_TEXT "Application data type for error type data elements. Error types are bit coded\r\n" /end ANNOTATION_TEXT
 /end ANNOTATION
/end MEASUREMENT
/begin MEASUREMENT MCore_Unconnected_DeNCSFailSts "unsigned integer 8bit" UBYTE VW_BCM_CompuMethods_SC_F1_O0_UNoUnit 1 100 0.0 255.0 MAX_REFRESH 4 1 ECU_ADDRESS 0x400E3258 /end MEASUREMENT
/begin MEASUREMENT MCore_Unconnected_DeSuspensionModeSts "unsigned integer 8bit" UBYTE VW_BCM_CompuMethods_SC_F1_O0_UNoUnit 1 100 0.0 255.0 MAX_REFRESH 4 1 ECU_ADDRESS 0x400E3259 /end MEASUREMENT
/begin MEASUREMENT MCore_DeDriverPresence "Boolean" UBYTE Methods_boolean 1 100 0.0 1.0 MAX_REFRESH 4 1 ECU_ADDRESS 0x400E3AB0 /end MEASUREMENT
/begin MEASUREMENT MCore_F228_LChildlockCommandDoorSts_1 "Boolean" UBYTE Methods_boolean 1 100 0.0 1.0 MAX_REFRESH 4 1 ECU_ADDRESS 0x400E3AB1 /end MEASUREMENT
/begin MEASUREMENT MCore_DePassengerPresence "Boolean" UBYTE Methods_boolean 1 100 0.0 1.0 MAX_REFRESH 4 1 ECU_ADDRESS 0x400E3AB2 /end MEASUREMENT
/begin MEASUREMENT MCore_F228_RChildlockCommandDoorSts_1 "Boolean" UBYTE Methods_boolean 1 100 0.0 1.0 MAX_REFRESH 4 1 ECU_ADDRESS 0x400E3AB3 /end MEASUREMENT
/begin MEASUREMENT MCore_DeRearButtonFeedbackLed_0 "Boolean" UBYTE Methods_boolean 1 100 0.0 1.0 MAX_REFRESH 4 1 ECU_ADDRESS 0x400E3AB4 /end MEASUREMENT
/begin MEASUREMENT MCore_DeWAL_Activation "Boolean" UBYTE Methods_boolean 1 100 0.0 1.0 MAX_REFRESH 4 1 ECU_ADDRESS 0x400E3AB5 /end MEASUREMENT
/begin MEASUREMENT MCore_MKR_LockChildLock "Boolean" UBYTE Methods_boolean 1 100 0.0 1.0 MAX_REFRESH 4 1 ECU_ADDRESS 0x5280D38E /end MEASUREMENT
/begin MEASUREMENT MCore_FobSearchResult_1 "unsigned integer 8bit" UBYTE VW_BCM_CompuMethods_SC_F1_O0_UNoUnit 1 100 0.0 255.0 MAX_REFRESH 4 1 ECU_ADDRESS 0x400E3AB6 /end MEASUREMENT
/begin MEASUREMENT MCore_VF228_actvAutoClsSts "Boolean" UBYTE Methods_boolean 1 100 0.0 1.0 MAX_REFRESH 4 1 ECU_ADDRESS 0x400E3AB7 /end MEASUREMENT
/begin MEASUREMENT MCore_VF228_actvAutoOpenSts "Boolean" UBYTE Methods_boolean 1 100 0.0 1.0 MAX_REFRESH 4 1 ECU_ADDRESS 0x400E3AB8 /end MEASUREMENT
/begin MEASUREMENT MCore_VF228_actvLeChdLockCtrl_0 "Boolean" UBYTE Methods_boolean 1 100 0.0 1.0 MAX_REFRESH 4 1 ECU_ADDRESS 0x400AB397 /end MEASUREMENT
/begin MEASUREMENT MCore_VF228_actvLeChdLockCtrlInt_0 "Boolean" UBYTE Methods_boolean 1 100 0.0 1.0 MAX_REFRESH 4 1 ECU_ADDRESS 0x400E3AB9 /end MEASUREMENT
/begin MEASUREMENT MCore_VF228_actvLeChdLockLed_0 "Boolean" UBYTE Methods_boolean 1 100 0.0 1.0 MAX_REFRESH 4 1 ECU_ADDRESS 0x400AB398 /end MEASUREMENT
/begin MEASUREMENT MCore_VF228_actvRiChdLockCtrl_0 "Boolean" UBYTE Methods_boolean 1 100 0.0 1.0 MAX_REFRESH 4 1 ECU_ADDRESS 0x400AB399 /end MEASUREMENT
/begin MEASUREMENT MCore_VF228_actvRiChdLockCtrlInt_0 "Boolean" UBYTE Methods_boolean 1 100 0.0 1.0 MAX_REFRESH 4 1 ECU_ADDRESS 0x400E3ABA /end MEASUREMENT
/begin MEASUREMENT MCore_VF228_actvRiChdLockLed_0 "Boolean" UBYTE Methods_boolean 1 100 0.0 1.0 MAX_REFRESH 4 1 ECU_ADDRESS 0x400AB39A /end MEASUREMENT
/begin MEASUREMENT MCore_DeFobRequest "Boolean" UBYTE Methods_boolean 1 100 0.0 1.0 MAX_REFRESH 4 1 ECU_ADDRESS 0x400E3ABB /end MEASUREMENT
/begin MEASUREMENT MCore_DeInteriorLockAlarm "Boolean" UBYTE Methods_boolean 1 100 0.0 1.0 MAX_REFRESH 4 1 ECU_ADDRESS 0x400E3ABC /end MEASUREMENT
/begin MEASUREMENT MCore_OSC_ErrMonFb_70 "unsigned integer 8bit" UBYTE VW_BCM_CompuMethods_SC_F1_O0_UNoUnit 1 100 0.0 255.0 MAX_REFRESH 4 1 ECU_ADDRESS 0x400E3ABD /end MEASUREMENT
/begin MEASUREMENT MCore_RequestActive_65 "Boolean" UBYTE Methods_boolean 1 100 0.0 1.0 MAX_REFRESH 4 1 ECU_ADDRESS 0x400E3ABE /end MEASUREMENT
/begin MEASUREMENT MCore_RequestValue_58 "Boolean" UBYTE Methods_boolean 1 100 0.0 1.0 MAX_REFRESH 4 1 ECU_ADDRESS 0x400E3ABF /end MEASUREMENT
/begin MEASUREMENT MCore_DeRFTrunk_VPSTrunkUnlockCntrl "" UBYTE Methods_boolean 1 100 0.0 255.0 MAX_REFRESH 4 1 ECU_ADDRESS 0x528081C7
 /begin ANNOTATION ANNOTATION_LABEL "Description (coming from AUTOSAR DESC field)"
  /begin ANNOTATION_TEXT "Boolean has the value space required to support the mathematical concept of binary-valued logic: {true, false}.\r\n" /end ANNOTATION_TEXT
 /end ANNOTATION
/end MEASUREMENT
/begin MEASUREMENT MCore_DeRF_VPSTrunkLockCntrl "" UBYTE VF228_CompuMethod_DT_RF_VPSTrunkLockCntrl 1 100 0.0 255.0 MAX_REFRESH 4 1 ECU_ADDRESS 0x528081C8 /end MEASUREMENT
/begin MEASUREMENT MCore_DeRF_VPSTrunkReleaseReqCntrl "" UBYTE VF228_CompuMethod_DT_RF_VPSTrunkReleaseReqCntrl 1 100 0.0 255.0 MAX_REFRESH 4 1 ECU_ADDRESS 0x400E325A /end MEASUREMENT
/begin MEASUREMENT MCore_DeRF_VPSTrunkUnlockCntrl "" UBYTE VF228_CompuMethod_DT_RF_VPSTrunkUnlockCntrl 1 100 0.0 255.0 MAX_REFRESH 4 1 ECU_ADDRESS 0x528081CA /end MEASUREMENT
/begin MEASUREMENT MCore_Unconnected_VF228_stRearButtonDoorLockCtrl_0 "Boolean" UBYTE Methods_boolean 1 100 0.0 1.0 MAX_REFRESH 4 1 ECU_ADDRESS 0x400E325B /end MEASUREMENT
/begin MEASUREMENT MCore_Unconnected_VF228_stRearButtonDoorUnlckCtrl_0 "Boolean" UBYTE Methods_boolean 1 100 0.0 1.0 MAX_REFRESH 4 1 ECU_ADDRESS 0x400E325C /end MEASUREMENT
/begin MEASUREMENT MCore_DeTrunkCloseLockCmd "Boolean" UBYTE Methods_boolean 1 100 0.0 1.0 MAX_REFRESH 4 1 ECU_ADDRESS 0x400E3AC0 /end MEASUREMENT
/begin MEASUREMENT MCore_DeTrunkOpenCmd "" UBYTE VF228_CompuMethod_DT_TrunkOpenCmd 1 100 0.0 255.0 MAX_REFRESH 4 1 ECU_ADDRESS 0x528081CB /end MEASUREMENT
/begin MEASUREMENT MCore_Unconnected_TesterValue_49 "Boolean" UBYTE Methods_boolean 1 100 0.0 1.0 MAX_REFRESH 4 1 ECU_ADDRESS 0x400E325D /end MEASUREMENT
/begin MEASUREMENT MCore_DeVPSAlarmOFFCntrl "" UBYTE VF228_CompuMethod_DT_VPSAlarmOFFCntrl 1 100 0.0 255.0 MAX_REFRESH 4 1 ECU_ADDRESS 0x400E325E /end MEASUREMENT
/begin MEASUREMENT MCore_DeVPSAlarmOFFCntrl_NoMUW "" UBYTE VF228_CompuMethod_DT_VPSAlarmOFFCntrl 1 100 0.0 255.0 MAX_REFRESH 4 1 ECU_ADDRESS 0x400E3AC1 /end MEASUREMENT
/begin MEASUREMENT MCore_DeVPSAlarmONCntrl "" UBYTE VF228_CompuMethod_DT_VPSAlarmONCntrl 1 100 0.0 255.0 MAX_REFRESH 4 1 ECU_ADDRESS 0x400E325F /end MEASUREMENT
/begin MEASUREMENT MCore_DeVPSAlarmONCntrl_NoMUW "" UBYTE VF228_CompuMethod_DT_VPSAlarmONCntrl 1 100 0.0 255.0 MAX_REFRESH 4 1 ECU_ADDRESS 0x400E3AC2 /end MEASUREMENT
/begin MEASUREMENT MCore_VF228_actvVPSBlinkLockCtrl "Boolean" UBYTE Methods_boolean 1 100 0.0 1.0 MAX_REFRESH 4 1 ECU_ADDRESS 0x400E3AC3 /end MEASUREMENT
/begin MEASUREMENT MCore_VF228_actvVPSBlinkUnlckCtrl "Boolean" UBYTE Methods_boolean 1 100 0.0 1.0 MAX_REFRESH 4 1 ECU_ADDRESS 0x400E3AC4 /end MEASUREMENT
/begin MEASUREMENT MCore_DeVPSDoorLockCntrl "" UBYTE Methods_boolean 1 100 0.0 255.0 MAX_REFRESH 4 1 ECU_ADDRESS 0x400AB2E6
 /begin ANNOTATION ANNOTATION_LABEL "Description (coming from AUTOSAR DESC field)"
  /begin ANNOTATION_TEXT "Boolean has the value space required to support the mathematical concept of binary-valued logic: {true, false}.\r\n" /end ANNOTATION_TEXT
 /end ANNOTATION
/end MEASUREMENT
/begin MEASUREMENT MCore_DeVPSDoorLockCntrl2 "Boolean" UBYTE Methods_boolean 1 100 0.0 1.0 MAX_REFRESH 4 1 ECU_ADDRESS 0x400AB39C /end MEASUREMENT
/begin MEASUREMENT MCore_DeVPSExtMirrorLockCntrl "" UBYTE Methods_boolean 1 100 0.0 255.0 MAX_REFRESH 4 1 ECU_ADDRESS 0x400AB39D
 /begin ANNOTATION ANNOTATION_LABEL "Description (coming from AUTOSAR DESC field)"
  /begin ANNOTATION_TEXT "Boolean has the value space required to support the mathematical concept of binary-valued logic: {true, false}.\r\n" /end ANNOTATION_TEXT
 /end ANNOTATION
/end MEASUREMENT
/begin MEASUREMENT MCore_DeVPSDoorUnlockCntrl "" UBYTE Methods_boolean 1 100 0.0 255.0 MAX_REFRESH 4 1 ECU_ADDRESS 0x5280006D
 /begin ANNOTATION ANNOTATION_LABEL "Description (coming from AUTOSAR DESC field)"
  /begin ANNOTATION_TEXT "Boolean has the value space required to support the mathematical concept of binary-valued logic: {true, false}.\r\n" /end ANNOTATION_TEXT
 /end ANNOTATION
/end MEASUREMENT
/begin MEASUREMENT MCore_DeVPSExtMirrorUnlockCntrl "" UBYTE Methods_boolean 1 100 0.0 255.0 MAX_REFRESH 4 1 ECU_ADDRESS 0x400AB39E
 /begin ANNOTATION ANNOTATION_LABEL "Description (coming from AUTOSAR DESC field)"
  /begin ANNOTATION_TEXT "Boolean has the value space required to support the mathematical concept of binary-valued logic: {true, false}.\r\n" /end ANNOTATION_TEXT
 /end ANNOTATION
/end MEASUREMENT
/begin MEASUREMENT MCore_DeVPSModeDoorUnlockCntrl "" UBYTE VF228_CompuMethod_DT_VPSModeDoorUnlockCntrl 1 100 0.0 255.0 MAX_REFRESH 4 1 ECU_ADDRESS 0x400E3260 /end MEASUREMENT
/begin MEASUREMENT MCore_DeVPSModeDoorUnlockIntCntrl "" UBYTE VF228_CompuMethod_DT_VPSModeDoorUnlockIntCntrl 1 100 0.0 255.0 MAX_REFRESH 4 1 ECU_ADDRESS 0x400E3261 /end MEASUREMENT
/begin MEASUREMENT MCore_DeVPSTrunkUnlockCntrl "" UBYTE DefaultIdenticalCompu 1 100 0.0 255.0 MAX_REFRESH 4 1 ECU_ADDRESS 0x528081D2 /end MEASUREMENT
/begin MEASUREMENT MCore_Unconnected_DeWalkAwayEnable "Boolean" UBYTE Methods_boolean 1 100 0.0 1.0 MAX_REFRESH 4 1 ECU_ADDRESS 0x400E3262 /end MEASUREMENT
/begin MEASUREMENT MCore_VF228_actvWelcomeInCarCtrl "Boolean" UBYTE Methods_boolean 1 100 0.0 1.0 MAX_REFRESH 4 1 ECU_ADDRESS 0x400E3AC5 /end MEASUREMENT
/begin MEASUREMENT MCore_VF228_actvWelcomeInCarDisactCtrl "Boolean" UBYTE Methods_boolean 1 100 0.0 1.0 MAX_REFRESH 4 1 ECU_ADDRESS 0x400E3AC6 /end MEASUREMENT
/begin MEASUREMENT MCore_DeExpired_143 "" UBYTE Methods_boolean 1 100 0.0 255.0 MAX_REFRESH 4 1 ECU_ADDRESS 0x400E3AC7
 /begin ANNOTATION ANNOTATION_LABEL "Description (coming from AUTOSAR DESC field)" /begin ANNOTATION_TEXT "Data indicating the alarm expiration.\r\n" /end ANNOTATION_TEXT /end ANNOTATION
/end MEASUREMENT
/begin MEASUREMENT MCore_DeExpired_144 "" UBYTE Methods_boolean 1 100 0.0 255.0 MAX_REFRESH 4 1 ECU_ADDRESS 0x400E3AC8
 /begin ANNOTATION ANNOTATION_LABEL "Description (coming from AUTOSAR DESC field)" /begin ANNOTATION_TEXT "Data indicating the alarm expiration.\r\n" /end ANNOTATION_TEXT /end ANNOTATION
/end MEASUREMENT
/begin MEASUREMENT MCore_DeExpired_145 "" UBYTE Methods_boolean 1 100 0.0 255.0 MAX_REFRESH 4 1 ECU_ADDRESS 0x400E3AC9
 /begin ANNOTATION ANNOTATION_LABEL "Description (coming from AUTOSAR DESC field)" /begin ANNOTATION_TEXT "Data indicating the alarm expiration.\r\n" /end ANNOTATION_TEXT /end ANNOTATION
/end MEASUREMENT
/begin MEASUREMENT MCore_DeExpired_146 "" UBYTE Methods_boolean 1 100 0.0 255.0 MAX_REFRESH 4 1 ECU_ADDRESS 0x400E3ACA
 /begin ANNOTATION ANNOTATION_LABEL "Description (coming from AUTOSAR DESC field)" /begin ANNOTATION_TEXT "Data indicating the alarm expiration.\r\n" /end ANNOTATION_TEXT /end ANNOTATION
/end MEASUREMENT
/begin MEASUREMENT MCore_DeComfortEnable "" UBYTE DataType_DataTypeSemantics_DT_ComfortEnable 1 100 0.0 255.0 MAX_REFRESH 4 1 ECU_ADDRESS 0x5280D38F /end MEASUREMENT
/begin MEASUREMENT MCore_Unconnected_DePNLP_SlaveECUProg "" UBYTE Methods_boolean 1 100 0.0 255.0 MAX_REFRESH 4 1 ECU_ADDRESS 0x400E3264
 /begin ANNOTATION ANNOTATION_LABEL "Description (coming from AUTOSAR DESC field)"
  /begin ANNOTATION_TEXT "Boolean has the value space required to support the mathematical concept of binary-valued logic: {true, false}.\r\n" /end ANNOTATION_TEXT
 /end ANNOTATION
/end MEASUREMENT
/begin MEASUREMENT MCore_DeGenericFailSts_NCM "" UBYTE Methods_boolean 1 100 0.0 255.0 MAX_REFRESH 4 1 ECU_ADDRESS 0x5280D390 /end MEASUREMENT
/begin MEASUREMENT MCore_DeExtPuddleLigthtsCmd "Boolean" UBYTE Methods_boolean 1 100 0.0 1.0 MAX_REFRESH 4 1 ECU_ADDRESS 0x400E3AD3 /end MEASUREMENT
/begin MEASUREMENT MCore_DeHeadlampRelay1_0 "Boolean" UBYTE Methods_boolean 1 100 0.0 1.0 MAX_REFRESH 4 1 ECU_ADDRESS 0x400E3AD4 /end MEASUREMENT
/begin MEASUREMENT MCore_DeHeadlampRelay2_0 "Boolean" UBYTE Methods_boolean 1 100 0.0 1.0 MAX_REFRESH 4 1 ECU_ADDRESS 0x400E3AD5 /end MEASUREMENT
/begin MEASUREMENT MCore_DeLCUPowerSupply "unsigned integer 8bit" UBYTE VW_BCM_CompuMethods_SC_F1_O0_UNoUnit 1 100 0.0 255.0 MAX_REFRESH 4 1 ECU_ADDRESS 0x400E3AD6 /end MEASUREMENT
/begin MEASUREMENT MCore_TesterValue_50 "Boolean" UBYTE Methods_boolean 1 100 0.0 1.0 MAX_REFRESH 4 1 ECU_ADDRESS 0x400E3AD8 /end MEASUREMENT
/begin MEASUREMENT MCore_TesterValue_51 "Boolean" UBYTE Methods_boolean 1 100 0.0 1.0 MAX_REFRESH 4 1 ECU_ADDRESS 0x400E3ADA /end MEASUREMENT
/begin MEASUREMENT MCore_TesterValue_52 "Boolean" UBYTE Methods_boolean 1 100 0.0 1.0 MAX_REFRESH 4 1 ECU_ADDRESS 0x400E3ADC /end MEASUREMENT
/begin MEASUREMENT MCore_DeAFSReq "" UBYTE Methods_boolean 1 100 0.0 255.0 MAX_REFRESH 4 1 ECU_ADDRESS 0x528081D3 /end MEASUREMENT
/begin MEASUREMENT MCore_DeFrontPosLightCmd "" UBYTE VF247_DataType_DataTypeSemantics_DT_FrontPosLightCmd 1 100 0.0 255.0 MAX_REFRESH 4 1 ECU_ADDRESS 0x528081D4 /end MEASUREMENT
/begin MEASUREMENT MCore_DeHighBeamCmd "" UBYTE VF247_DataType_DataTypeSemantics_DT_HighBeamCmd 1 100 0.0 255.0 MAX_REFRESH 4 1 ECU_ADDRESS 0x528081D5 /end MEASUREMENT
/begin MEASUREMENT MCore_DeHighBeamFlashCmd "" UBYTE VF247_DataType_DataTypeSemantics_DT_HighBeamFlashCmd 1 100 0.0 255.0 MAX_REFRESH 4 1 ECU_ADDRESS 0x528081D6 /end MEASUREMENT
/begin MEASUREMENT MCore_DeLCU_Ready "" UBYTE Methods_boolean 1 100 0.0 255.0 MAX_REFRESH 4 1 ECU_ADDRESS 0x528081D7
 /begin ANNOTATION ANNOTATION_LABEL "Description (coming from AUTOSAR DESC field)"
  /begin ANNOTATION_TEXT "Boolean has the value space required to support the mathematical concept of binary-valued logic: {true, false}.\r\n" /end ANNOTATION_TEXT
 /end ANNOTATION
/end MEASUREMENT
/begin MEASUREMENT MCore_DeLowBeamCmd "" UBYTE VF247_DataType_DataTypeSemantics_DT_LowBeamCmd 1 100 0.0 255.0 MAX_REFRESH 4 1 ECU_ADDRESS 0x528081D8 /end MEASUREMENT
/begin MEASUREMENT MCore_DeParkLightCmd "" UBYTE VF247_DataType_DataTypeSemantics_DT_ParkLightCmd 1 100 0.0 255.0 MAX_REFRESH 4 1 ECU_ADDRESS 0x5280006F /end MEASUREMENT
/begin MEASUREMENT MCore_DeRearFogCmd "" UBYTE VF247_DataType_DataTypeSemantics_DT_RearFogCmd 1 100 0.0 255.0 MAX_REFRESH 4 1 ECU_ADDRESS 0x528081DA /end MEASUREMENT
/begin MEASUREMENT MCore_DeRearPositionNightCmd "" UBYTE VF247_DataType_DataTypeSemantics_DT_RearPositionNightCmd 1 100 0.0 255.0 MAX_REFRESH 4 1 ECU_ADDRESS 0x528081DB /end MEASUREMENT
/begin COMPU_METHOD Methods_boolean "" TAB_VERB "%10.5" "" COMPU_TAB_REF Methods_boolean /end COMPU_METHOD
/begin COMPU_METHOD VW_BCM_CompuMethods_SC_F1_O0_UNoUnit "" RAT_FUNC "%10.5" "" COEFFS 0.0 -1.0 0.0 0.0 0.0 -1.0 /end COMPU_METHOD
/begin COMPU_METHOD App_VF092_CompuMethod_CM_STS_DRS_DriverLatchsts "" TAB_VERB "%10.5" "" COMPU_TAB_REF App_VF092_CompuMethod_CM_STS_DRS_DriverLatchsts /end COMPU_METHOD
/begin COMPU_METHOD App_VF092_CompuMethod_CM_STS_DRS_PsngrLatchsts "" TAB_VERB "%10.5" "" COMPU_TAB_REF App_VF092_CompuMethod_CM_STS_DRS_PsngrLatchsts /end COMPU_METHOD
/begin COMPU_METHOD VF091_DataType_DataTypeSemantics_CM_PsngrDoorSts_CCAN1 "" TAB_VERB "%10.5" "" COMPU_TAB_REF VF091_DataType_DataTypeSemantics_CM_PsngrDoorSts_CCAN1 /end COMPU_METHOD
/begin COMPU_METHOD DataType_DataTypeSemantics_DT_KeySwitchSts "" TAB_VERB "%10.5" "" COMPU_TAB_REF DataType_DataTypeSemantics_DT_KeySwitchSts /end COMPU_METHOD
/begin COMPU_METHOD RB_RBD_ModeM_SounderLin_Interface_CompuMethod_CM_LIN2_Transmission_Error "" TAB_VERB "%10.5" "" COMPU_TAB_REF RB_RBD_ModeM_SounderLin_Interface_CompuMethod_CM_LIN2_Transmission_Error /end COMPU_METHOD
/begin COMPU_METHOD BCGW_ModeM_CompuMethods_ModeM_RequestEcuModeType "" TAB_VERB "%10.5" "" COMPU_TAB_REF BCGW_ModeM_CompuMethods_ModeM_RequestEcuModeType REF_UNIT BCGW_ModeM_Units_NoUnit /end COMPU_METHOD
/begin COMPU_METHOD DataType_DataTypeSemantics_KOSMXACDOXIHEATDLSTUXELACIGSMHMO "" TAB_VERB "%10.5" "" COMPU_TAB_REF DataType_DataTypeSemantics_KOSMXACDOXIHEATDLSTUXELACIGSMHMO /end COMPU_METHOD
/begin COMPU_METHOD DataType_DataTypeSemantics_AXOECGKIAISMEKUELOHCDKLKTTSUKOKT "" TAB_VERB "%10.5" "" COMPU_TAB_REF DataType_DataTypeSemantics_AXOECGKIAISMEKUELOHCDKLKTTSUKOKT /end COMPU_METHOD
/begin COMPU_METHOD CompuMethod_CM_VF078_Button_Status "" TAB_VERB "%10.5" "" COMPU_TAB_REF CompuMethod_CM_VF078_Button_Status /end COMPU_METHOD
/begin COMPU_METHOD App_3rdParty_CompuMethode_CM_RimHeatingFbk "" TAB_VERB "%10.5" "" COMPU_TAB_REF App_3rdParty_CompuMethode_CM_RimHeatingFbk /end COMPU_METHOD
/begin COMPU_METHOD VF008_CompuMethod_DT_BLSActivationSts "" TAB_VERB "%10.5" "" COMPU_TAB_REF VF008_CompuMethod_DT_BLSActivationSts /end COMPU_METHOD
/begin COMPU_METHOD VF008_CompuMethod_DT_SBMT_Status "" TAB_VERB "%10.5" "" COMPU_TAB_REF VF008_CompuMethod_DT_SBMT_Status /end COMPU_METHOD
/begin COMPU_METHOD VF051_CompuMethods_CM_TILightDeactivationRqt "" TAB_VERB "%10.5" "" COMPU_TAB_REF VF051_CompuMethods_CM_TILightDeactivationRqt /end COMPU_METHOD
/begin COMPU_METHOD CompuMethod_CM_SBMTEnableDomeLight "" TAB_VERB "%10.5" "" COMPU_TAB_REF CompuMethod_CM_SBMTEnableDomeLight /end COMPU_METHOD
/begin COMPU_METHOD CompuMethod_CM_BrightnessAdjustment "" TAB_VERB "%10.5" "" COMPU_TAB_REF CompuMethod_CM_BrightnessAdjustment /end COMPU_METHOD
/begin COMPU_METHOD CompuMethod_CM_VF078_On_Off "" TAB_VERB "%10.5" "" COMPU_TAB_REF CompuMethod_CM_VF078_On_Off /end COMPU_METHOD
/begin COMPU_METHOD DataType_DataTypeSemantics_CM_VF087_AlarmState "" TAB_VERB "%10.5" "" COMPU_TAB_REF DataType_DataTypeSemantics_CM_VF087_AlarmState /end COMPU_METHOD
/begin COMPU_METHOD DataType_DataTypeSemantics_CM_VF087_TheftAlarmStatus "" TAB_VERB "%10.5" "" COMPU_TAB_REF DataType_DataTypeSemantics_CM_VF087_TheftAlarmStatus /end COMPU_METHOD
/begin COMPU_METHOD DataType_DataTypeSemantics_DT_VF087_VPSAlarmModeCntrl "" TAB_VERB "%10.5" "" COMPU_TAB_REF DataType_DataTypeSemantics_DT_VF087_VPSAlarmModeCntrl /end COMPU_METHOD
/begin COMPU_METHOD VF091_DataType_DataTypeSemantics_CM_DiverDoorSts "" TAB_VERB "%10.5" "" COMPU_TAB_REF VF091_DataType_DataTypeSemantics_CM_DiverDoorSts /end COMPU_METHOD
/begin COMPU_METHOD App_VF092_CompuMethod_PiSBMTEnableDomeLockUnlock "" TAB_VERB "%10.5" "" COMPU_TAB_REF App_VF092_CompuMethod_PiSBMTEnableDomeLockUnlock /end COMPU_METHOD
/begin COMPU_METHOD App_VF092_CompuMethod_DT_VPSDoorSts "" TAB_VERB "%10.5" "" COMPU_TAB_REF App_VF092_CompuMethod_DT_VPSDoorSts /end COMPU_METHOD
/begin COMPU_METHOD App_VF092_CompuMethod_CM_VPSDriverDoorSts "" TAB_VERB "%10.5" "" COMPU_TAB_REF App_VF092_CompuMethod_CM_VPSDriverDoorSts /end COMPU_METHOD
/begin COMPU_METHOD App_VF092_CompuMethod_CM_VPSPsngrDoorSts "" TAB_VERB "%10.5" "" COMPU_TAB_REF App_VF092_CompuMethod_CM_VPSPsngrDoorSts /end COMPU_METHOD
/begin COMPU_METHOD VF104_CompuMethod_CM_WLML_Movement_Command "" TAB_VERB "%10.5" "" COMPU_TAB_REF VF104_CompuMethod_CM_WLML_Movement_Command /end COMPU_METHOD
/begin COMPU_METHOD VF104_CompuMethod_CM_WLMR_Movement_Command "" TAB_VERB "%10.5" "" COMPU_TAB_REF VF104_CompuMethod_CM_WLMR_Movement_Command /end COMPU_METHOD
/begin COMPU_METHOD VF119_DataType_DataTypeSemantics_CM_MirrorSelectorFeedback "" TAB_VERB "%10.5" "" COMPU_TAB_REF VF119_DataType_DataTypeSemantics_CM_MirrorSelectorFeedback /end COMPU_METHOD
/begin COMPU_METHOD DataType_DataTypeSemantics_CM_PowerModeSts "" TAB_VERB "%10.5" "" COMPU_TAB_REF DataType_DataTypeSemantics_CM_PowerModeSts /end COMPU_METHOD
/begin COMPU_METHOD DataType_DataTypeSemantics_DT_FrontWindshieldWiperSts "" TAB_VERB "%10.5" "" COMPU_TAB_REF DataType_DataTypeSemantics_DT_FrontWindshieldWiperSts /end COMPU_METHOD
/begin COMPU_METHOD DataType_DataTypeSemantics_DT_WiperSpeed_Internal "" TAB_VERB "%10.5" "" COMPU_TAB_REF DataType_DataTypeSemantics_DT_WiperSpeed_Internal /end COMPU_METHOD
/begin COMPU_METHOD VF228_CompuMethod_DT_RF_VPSTrunkLockCntrl "" TAB_VERB "%10.5" "" COMPU_TAB_REF VF228_CompuMethod_DT_RF_VPSTrunkLockCntrl /end COMPU_METHOD
/begin COMPU_METHOD VF228_CompuMethod_DT_RF_VPSTrunkReleaseReqCntrl "" TAB_VERB "%10.5" "" COMPU_TAB_REF VF228_CompuMethod_DT_RF_VPSTrunkReleaseReqCntrl /end COMPU_METHOD
/begin COMPU_METHOD VF228_CompuMethod_DT_RF_VPSTrunkUnlockCntrl "" TAB_VERB "%10.5" "" COMPU_TAB_REF VF228_CompuMethod_DT_RF_VPSTrunkUnlockCntrl /end COMPU_METHOD
/begin COMPU_METHOD VF228_CompuMethod_DT_TrunkOpenCmd "" TAB_VERB "%10.5" "" COMPU_TAB_REF VF228_CompuMethod_DT_TrunkOpenCmd /end COMPU_METHOD
/begin COMPU_METHOD VF228_CompuMethod_DT_VPSAlarmOFFCntrl "" TAB_VERB "%10.5" "" COMPU_TAB_REF VF228_CompuMethod_DT_VPSAlarmOFFCntrl /end COMPU_METHOD
/begin COMPU_METHOD VF228_CompuMethod_DT_VPSAlarmONCntrl "" TAB_VERB "%10.5" "" COMPU_TAB_REF VF228_CompuMethod_DT_VPSAlarmONCntrl /end COMPU_METHOD
/begin COMPU_METHOD VF228_CompuMethod_DT_VPSModeDoorUnlockCntrl "" TAB_VERB "%10.5" "" COMPU_TAB_REF VF228_CompuMethod_DT_VPSModeDoorUnlockCntrl /end COMPU_METHOD
/begin COMPU_METHOD VF228_CompuMethod_DT_VPSModeDoorUnlockIntCntrl "" TAB_VERB "%10.5" "" COMPU_TAB_REF VF228_CompuMethod_DT_VPSModeDoorUnlockIntCntrl /end COMPU_METHOD
/begin COMPU_METHOD DataType_DataTypeSemantics_DT_ComfortEnable "" TAB_VERB "%10.5" "" COMPU_TAB_REF DataType_DataTypeSemantics_DT_ComfortEnable /end COMPU_METHOD
/begin COMPU_METHOD VF247_DataType_DataTypeSemantics_DT_FrontPosLightCmd "" TAB_VERB "%10.5" "" COMPU_TAB_REF VF247_DataType_DataTypeSemantics_DT_FrontPosLightCmd /end COMPU_METHOD
/begin COMPU_METHOD VF247_DataType_DataTypeSemantics_DT_HighBeamCmd "" TAB_VERB "%10.5" "" COMPU_TAB_REF VF247_DataType_DataTypeSemantics_DT_HighBeamCmd /end COMPU_METHOD
/begin COMPU_METHOD VF247_DataType_DataTypeSemantics_DT_HighBeamFlashCmd "" TAB_VERB "%10.5" "" COMPU_TAB_REF VF247_DataType_DataTypeSemantics_DT_HighBeamFlashCmd /end COMPU_METHOD
/begin COMPU_METHOD VF247_DataType_DataTypeSemantics_DT_LowBeamCmd "" TAB_VERB "%10.5" "" COMPU_TAB_REF VF247_DataType_DataTypeSemantics_DT_LowBeamCmd /end COMPU_METHOD
/begin COMPU_METHOD VF247_DataType_DataTypeSemantics_DT_ParkLightCmd "" TAB_VERB "%10.5" "" COMPU_TAB_REF VF247_DataType_DataTypeSemantics_DT_ParkLightCmd /end COMPU_METHOD
/begin COMPU_METHOD VF247_DataType_DataTypeSemantics_DT_RearFogCmd "" TAB_VERB "%10.5" "" COMPU_TAB_REF VF247_DataType_DataTypeSemantics_DT_RearFogCmd /end COMPU_METHOD
/begin COMPU_METHOD VF247_DataType_DataTypeSemantics_DT_RearPositionNightCmd "" TAB_VERB "%10.5" "" COMPU_TAB_REF VF247_DataType_DataTypeSemantics_DT_RearPositionNightCmd /end COMPU_METHOD
/begin COMPU_METHOD DefaultIdenticalCompu "" RAT_FUNC "%10.5" "" COEFFS 0.0 1.0 0.0 0.0 0.0 1.0 /end COMPU_METHOD
/begin UNIT BCGW_ModeM_Units_NoUnit "" "" EXTENDED_SI /end UNIT
/begin COMPU_VTAB Methods_boolean "" TAB_VERB 2 0 "FALSE" 1 "TRUE" /end COMPU_VTAB
/begin COMPU_VTAB App_VF092_CompuMethod_CM_STS_DRS_DriverLatchsts "" TAB_VERB 4 0 "Cx0_init" 1 "Cx1_Unlocked" 2 "Cx2_Locked" 3 "Cx3_SNA" /end COMPU_VTAB
/begin COMPU_VTAB App_VF092_CompuMethod_CM_STS_DRS_PsngrLatchsts "" TAB_VERB 4 0 "Cx0_init" 1 "Cx1_Unlocked" 2 "Cx2_Locked" 3 "Cx3_SNA" /end COMPU_VTAB
/begin COMPU_VTAB VF091_DataType_DataTypeSemantics_CM_PsngrDoorSts_CCAN1 "" TAB_VERB 4 0 "Cx0_SNA" 1 "Cx1_close" 2 "Cx2_Ajar" 3 "Cx3_Open" /end COMPU_VTAB
/begin COMPU_VTAB DataType_DataTypeSemantics_DT_KeySwitchSts "" TAB_VERB 2 0 "VF040_M_KEY_OFF" 1 "VF040_M_KEY_ON" /end COMPU_VTAB
/begin COMPU_VTAB RB_RBD_ModeM_SounderLin_Interface_CompuMethod_CM_LIN2_Transmission_Error "" TAB_VERB 4 0 "SOUNDERLIN_LIN2_NO_ERROR" 1 "SOUNDERLIN_LIN2_TX_ERR" 2 "SOUNDERLIN_LIN2_RX_NAP_ERR" 3 "SOUNDERLIN_LIN2_RX_NACK_ERR" /end COMPU_VTAB
/begin COMPU_VTAB BCGW_ModeM_CompuMethods_ModeM_RequestEcuModeType "" TAB_VERB 3 1 "MODEM_REQUEST_ECUM_MODE_RUN" 0 "MODEM_REQUEST_ECUM_MODE_POST_RUN" 2 "MODEM_REQUEST_ECUM_MODE_SHUTDOWN" /end COMPU_VTAB
/begin COMPU_VTAB DataType_DataTypeSemantics_KOSMXACDOXIHEATDLSTUXELACIGSMHMO "" TAB_VERB 2 0 "BSWM_BSWM_MODENOTIFICATION_CAN_BH_Offline" 1 "BSWM_BSWM_MODENOTIFICATION_CAN_BH_Online" /end COMPU_VTAB
/begin COMPU_VTAB DataType_DataTypeSemantics_AXOECGKIAISMEKUELOHCDKLKTTSUKOKT "" TAB_VERB 2 0 "BSWM_BSWM_MODENOTIFICATION_CAN_C1_Offline" 1 "BSWM_BSWM_MODENOTIFICATION_CAN_C1_Online" /end COMPU_VTAB
/begin COMPU_VTAB CompuMethod_CM_VF078_Button_Status "" TAB_VERB 2 0 "VF078_Not_Pressed" 1 "VF078_Pressed" /end COMPU_VTAB
/begin COMPU_VTAB App_3rdParty_CompuMethode_CM_RimHeatingFbk "" TAB_VERB 3 0 "Cx0_Off" 1 "Cx1_On" 2 "Cx2_Fail" /end COMPU_VTAB
/begin COMPU_VTAB VF008_CompuMethod_DT_BLSActivationSts "" TAB_VERB 2 0 "VF008_BLSACTIVATION_OFF" 1 "VF008_BLSACTIVATION_ON" /end COMPU_VTAB
/begin COMPU_VTAB VF008_CompuMethod_DT_SBMT_Status "" TAB_VERB 2 0 "SBMT_NotActive" 1 "SBMT_Active" /end COMPU_VTAB
/begin COMPU_VTAB VF051_CompuMethods_CM_TILightDeactivationRqt "" TAB_VERB 4 0 "OFF" 1 "ON_LEFT" 2 "ON_RIGHT" 3 "ON" /end COMPU_VTAB
/begin COMPU_VTAB CompuMethod_CM_SBMTEnableDomeLight "" TAB_VERB 2 0 "VF078_DOME_NOT_ACTIVE" 1 "VF078_DOME_ACTIVE" /end COMPU_VTAB
/begin COMPU_VTAB CompuMethod_CM_BrightnessAdjustment "" TAB_VERB 16 0 "VF078_Level1" 1 "VF078_Level2" 2 "VF078_Level3" 3 "VF078_Level4" 4 "VF078_Level5" 5 "VF078_Level6" 6 "VF078_Level7" 7 "VF078_Level8" 8 "VF078_Level9" 9 "VF078_Level10" 10 "VF078_Level11" 11 "VF078_Level12" 12 "VF078_Level13" 13 "VF078_Level14" 14 "VF078_Level15" 15 "VF078_Level16" /end COMPU_VTAB
/begin COMPU_VTAB CompuMethod_CM_VF078_On_Off "" TAB_VERB 2 0 "VF078_Off" 1 "VF078_On" /end COMPU_VTAB
/begin COMPU_VTAB DataType_DataTypeSemantics_CM_VF087_AlarmState "" TAB_VERB 9 0 "Cx0_Alarm_OFF" 1 "Cx1_Alarm_IDLE" 2 "Cx2_Alarm_ARMING" 3 "Cx3_Alarm_SURVEILLANCE" 4 "Cx4_Alarm_ACTIVE" 5 "Cx5_Alarm_DISARMING" 6 "Cx6_Alarm_DEACTIVATED" 7 "Cx7_Alarm_SERVICE" 8 "Cx8_Alarm_PROGRAMMING" /end COMPU_VTAB
/begin COMPU_VTAB DataType_DataTypeSemantics_CM_VF087_TheftAlarmStatus "" TAB_VERB 8 0 "Cx0_VTA_DISARM" 1 "Cx1_VTA_PREARM" 2 "Cx2_VTA_ARM" 3 "Cx3_VTA_LGT" 4 "Cx4_VTA_LGT_HORN" 5 "Cx5_VTA_TAMP" 6 "Cx6_VTA_ITM_Alarm" 7 "Cx7_SNA" /end COMPU_VTAB
/begin COMPU_VTAB DataType_DataTypeSemantics_DT_VF087_VPSAlarmModeCntrl "" TAB_VERB 8 0 "VF087_CC_NOT_USED" 1 "VF087_CC_CEE" 2 "VF087_CC_GB" 3 "VF087_CC_BELGIUM" 4 "VF087_CC_NETHERLAND" 5 "VF087_CC_WORLD_USA_JPN" 6 "VF087_CC_TEMP" 7 "VF087_CC_RANGE" /end COMPU_VTAB
/begin COMPU_VTAB VF091_DataType_DataTypeSemantics_CM_DiverDoorSts "" TAB_VERB 4 0 "Cx0_SNA" 1 "Cx1_close" 2 "Cx2_Ajar" 3 "Cx3_Open" /end COMPU_VTAB
/begin COMPU_VTAB App_VF092_CompuMethod_PiSBMTEnableDomeLockUnlock "" TAB_VERB 2 0 "VF092_DOME_NOT_ACTIVE" 1 "VF092_DOME_ACTIVE" /end COMPU_VTAB
/begin COMPU_VTAB App_VF092_CompuMethod_DT_VPSDoorSts "" TAB_VERB 4 0 "VF092_VPSDOORSTS_UNLOCKEDEXTERNAL" 1 "VF092_VPSDOORSTS_LOCKEDEXTERNAL" 2 "VF092_VPSDOORSTS_UNLOCKEDINTERNAL" 3 "VF092_VPSDOORSTS_LOCKEDINTERNAL" /end COMPU_VTAB
/begin COMPU_VTAB App_VF092_CompuMethod_CM_VPSDriverDoorSts "" TAB_VERB 5 0 "Cx0_Closed_Unlocked" 1 "Cx1_Closed_Locked" 2 "Cx2_Open_Unlocked" 3 "Cx3_Open_Locked" 4 "Cx4_SNA" /end COMPU_VTAB
/begin COMPU_VTAB App_VF092_CompuMethod_CM_VPSPsngrDoorSts "" TAB_VERB 5 0 "Cx0_Closed_Unlocked" 1 "Cx1_Closed_Locked" 2 "Cx2_Open_Unlocked" 3 "Cx3_Open_Locked" 4 "Cx4_SNA" /end COMPU_VTAB
/begin COMPU_VTAB VF104_CompuMethod_CM_WLML_Movement_Command "" TAB_VERB 8 0 "Cx0_No_Command" 1 "Cx1_Up_Manual" 2 "Cx2_Down_Manual" 3 "Cx3_Up_Auto" 4 "Cx4_Down_Auto" 5 "Cx5_Stop_Movement" 6 "Cx6_NA" 7 "Cx7_SNA" /end COMPU_VTAB
/begin COMPU_VTAB VF104_CompuMethod_CM_WLMR_Movement_Command "" TAB_VERB 8 0 "Cx0_No_Command" 1 "Cx1_Up_Manual" 2 "Cx2_Down_Manual" 3 "Cx3_Up_Auto" 4 "Cx4_Down_Auto" 5 "Cx5_Stop_Movement" 6 "Cx6_NA" 7 "Cx7_SNA" /end COMPU_VTAB
/begin COMPU_VTAB VF119_DataType_DataTypeSemantics_CM_MirrorSelectorFeedback "" TAB_VERB 4 0 "Cx0_No_selection" 1 "Cx1_Left" 2 "Cx2_Right" 3 "Cx3_Not_used" /end COMPU_VTAB
/begin COMPU_VTAB DataType_DataTypeSemantics_CM_PowerModeSts "" TAB_VERB 4 0 "Cx0_Standard_Power" 1 "Cx1_Logistic_Mode_ON" 2 "Cx2_Not_used" 3 "Cx3_Not_used" /end COMPU_VTAB
/begin COMPU_VTAB DataType_DataTypeSemantics_DT_FrontWindshieldWiperSts "" TAB_VERB 3 0 "VF150_FWWIS_NOT_ACTIVE" 1 "VF150_FWWIS_ACTIVE" 2 "VF150_FWWIS_AUTO" /end COMPU_VTAB
/begin COMPU_VTAB DataType_DataTypeSemantics_DT_WiperSpeed_Internal "" TAB_VERB 5 0 "Off" 1 "Speed_1" 2 "Speed_2" 3 "RLS_Error" 4 "SNA" /end COMPU_VTAB
/begin COMPU_VTAB VF228_CompuMethod_DT_RF_VPSTrunkLockCntrl "" TAB_VERB 2 0 "VF228_RF_VPSTRUNKLOCK_NOTACTIVE" 1 "VF228_RF_VPSTRUNKLOCK_ACTIVE" /end COMPU_VTAB
/begin COMPU_VTAB VF228_CompuMethod_DT_RF_VPSTrunkReleaseReqCntrl "" TAB_VERB 2 0 "VF228_RF_TRUNKRELEASEREQ_NOTACTIVE" 1 "VF228_RF_TRUNKRELEASEREQ_ACTIVE" /end COMPU_VTAB
/begin COMPU_VTAB VF228_CompuMethod_DT_RF_VPSTrunkUnlockCntrl "" TAB_VERB 2 0 "VF228_RF_VPSTRUNKUNLOCK_NOTACTIVE" 1 "VF228_RF_VPSTRUNKUNLOCK_ACTIVE" /end COMPU_VTAB
/begin COMPU_VTAB VF228_CompuMethod_DT_TrunkOpenCmd "" TAB_VERB 3 0 "VF228_TRUNKOPENCMD_IDLE" 1 "VF228_TRUNKOPENCMD_OPEN" 3 "VF228_TRUNKOPENCMD_CLOSE" /end COMPU_VTAB
/begin COMPU_VTAB VF228_CompuMethod_DT_VPSAlarmOFFCntrl "" TAB_VERB 2 0 "VF228_ALARM_OFF_NOT_ACTIVE" 1 "VF228_ALARM_OFF_ACTIVE" /end COMPU_VTAB
/begin COMPU_VTAB VF228_CompuMethod_DT_VPSAlarmONCntrl "" TAB_VERB 2 0 "VF228_ALARM_ON_NOT_ACTIVE" 1 "VF228_ALARM_ON_ACTIVE" /end COMPU_VTAB
/begin COMPU_VTAB VF228_CompuMethod_DT_VPSModeDoorUnlockCntrl "" TAB_VERB 3 0 "VF228_MODEDOORUNLOCK_NO_ACTION" 1 "VF228_MODEDOORUNLOCK_ALL_DOORS" 2 "VF228_MODEDOORUNLOCK_DRV_ONLY" /end COMPU_VTAB
/begin COMPU_VTAB VF228_CompuMethod_DT_VPSModeDoorUnlockIntCntrl "" TAB_VERB 3 0 "VF228_MODEDOORUNLOCK_NO_ACTION" 1 "VF228_MODEDOORUNLOCK_ALL_DOORS" 2 "VF228_MODEDOORUNLOCK_DRV_ONLY" /end COMPU_VTAB
/begin COMPU_VTAB DataType_DataTypeSemantics_DT_ComfortEnable "" TAB_VERB 2 0 "VF003_CE_NOT_ACTIVE" 1 "VF003_CE_ACTIVE" /end COMPU_VTAB
/begin COMPU_VTAB VF247_DataType_DataTypeSemantics_DT_FrontPosLightCmd "" TAB_VERB 2 0 "VF247_FRONT_POS_LIGHT_OFF" 1 "VF247_FRONT_POS_LIGHT_ON" /end COMPU_VTAB
/begin COMPU_VTAB VF247_DataType_DataTypeSemantics_DT_HighBeamCmd "" TAB_VERB 2 0 "VF247_HB_CMD_OFF" 1 "VF247_HB_CMD_ON" /end COMPU_VTAB
/begin COMPU_VTAB VF247_DataType_DataTypeSemantics_DT_HighBeamFlashCmd "" TAB_VERB 2 0 "VF247_FB_CMD_OFF" 1 "VF247_FB_CMD_ON" /end COMPU_VTAB
/begin COMPU_VTAB VF247_DataType_DataTypeSemantics_DT_LowBeamCmd "" TAB_VERB 2 0 "VF247_LOWBEAMCMD_OFF" 1 "VF247_LOWBEAMCMD_ON" /end COMPU_VTAB
/begin COMPU_VTAB VF247_DataType_DataTypeSemantics_DT_ParkLightCmd "" TAB_VERB 2 0 "VF247_PARK_LIGHT_OFF" 1 "VF247_PARK_LIGHT_ON" /end COMPU_VTAB
/begin COMPU_VTAB VF247_DataType_DataTypeSemantics_DT_RearFogCmd "" TAB_VERB 2 0 "VF247_REAR_FOG_OFF" 1 "VF247_REAR_FOG_ON" /end COMPU_VTAB
/begin COMPU_VTAB VF247_DataType_DataTypeSemantics_DT_RearPositionNightCmd "" TAB_VERB 2 0 "VF247_REAR_POS_NIGHT_OFF" 1 "VF247_REAR_POS_NIGHT_ON" /end COMPU_VTAB
/end MODULE
/end PROJECT

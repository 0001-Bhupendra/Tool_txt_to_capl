/* @@@@ File written by CANAPE_VERSION 13 0 0 @@@@ */
ASAP2_VERSION 1 61
/begin PROJECT prjDemo ""
/begin HEADER "" PROJECT_NO prjDemo_1_0 VERSION "AR_A2L_1.0" /end HEADER
/begin MODULE modFinalDemo ""
/begin MOD_COMMON "" BYTE_ORDER MSB_FIRST ALIGNMENT_BYTE 1 ALIGNMENT_WORD 1 ALIGNMENT_LONG 1 ALIGNMENT_INT64 1 ALIGNMENT_FLOAT32_IEEE 1 ALIGNMENT_FLOAT64_IEEE 4 /end MOD_COMMON
/begin IF_DATA XCP
 /begin PROTOCOL_LAYER 0x0100 0xFA 0xFA 0x00 0x00 0x00 0x00 0x00 0x15 0x15 BYTE_ORDER_MSB_LAST ADDRESS_GRANULARITY_BYTE OPTIONAL_CMD ALLOC_ODT_ENTRY OPTIONAL_CMD ALLOC_ODT OPTIONAL_CMD ALLOC_DAQ OPTIONAL_CMD FREE_DAQ OPTIONAL_CMD GET_DAQ_CLOCK OPTIONAL_CMD START_STOP_SYNCH OPTIONAL_CMD START_STOP_DAQ_LIST OPTIONAL_CMD GET_DAQ_LIST_MODE OPTIONAL_CMD SET_DAQ_LIST_MODE OPTIONAL_CMD WRITE_DAQ OPTIONAL_CMD SET_DAQ_PTR OPTIONAL_CMD CLEAR_DAQ_LIST OPTIONAL_CMD DOWNLOAD_MAX OPTIONAL_CMD DOWNLOAD_NEXT OPTIONAL_CMD DOWNLOAD OPTIONAL_CMD BUILD_CHECKSUM OPTIONAL_CMD SHORT_UPLOAD OPTIONAL_CMD UPLOAD OPTIONAL_CMD SET_MTA OPTIONAL_CMD UNLOCK OPTIONAL_CMD GET_SEED OPTIONAL_CMD GET_ID /end PROTOCOL_LAYER
 /begin DAQ DYNAMIC 0x00 0x03 0x00 OPTIMISATION_TYPE_MAX_ENTRY_SIZE ADDRESS_EXTENSION_FREE IDENTIFICATION_FIELD_TYPE_ABSOLUTE GRANULARITY_ODT_ENTRY_SIZE_DAQ_BYTE 0x07 OVERLOAD_INDICATION_EVENT PRESCALER_SUPPORTED
  /begin EVENT "2ms time synchronous" "2ms time " 0x00 DAQ 0x01 0x02 0x06 0x07 /end EVENT
  /begin EVENT "10ms time synchronous" "10ms time" 0x01 DAQ 0x01 0x0A 0x06 0x06 /end EVENT
  /begin EVENT "100ms time synchronous" "100ms tim" 0x02 DAQ 0x01 0x64 0x06 0x05 /end EVENT
 /end DAQ
 /begin PAG 0x00 /end PAG
 /begin PGM PGM_MODE_ABSOLUTE 0x00 0x00 /end PGM
 /begin XCP_ON_CAN 0x0103 CAN_ID_MASTER 0x9EDEAD00 CAN_ID_SLAVE 0x9EDEAD01 BAUDRATE 0x07A120 SAMPLE_POINT 0x4B SAMPLE_RATE SINGLE BTL_CYCLES 0x08 SJW 0x02 SYNC_EDGE SINGLE MAX_DLC_REQUIRED /end XCP_ON_CAN
 /begin XCP_ON_UDP_IP 0x0103 0x5555 ADDRESS "10.50.0.60" MAX_BUS_LOAD 0x50 MAX_BIT_RATE 0x64 /end XCP_ON_UDP_IP
/end IF_DATA
/begin MOD_PAR "" /*********** Start of merged MOD_PAR blocks ***********/ /*********** End of merged MOD_PAR blocks ***********/ /end MOD_PAR
/*********** Start of merged RECORD_LAYOUT blocks ***********/
/begin RECORD_LAYOUT DefaultValueRecordLayout_uint32 FNC_VALUES 1 ULONG COLUMN_DIR DIRECT STATIC_RECORD_LAYOUT /end RECORD_LAYOUT
/begin RECORD_LAYOUT DefaultValueRecordLayout_uint16 FNC_VALUES 1 UWORD COLUMN_DIR DIRECT STATIC_RECORD_LAYOUT /end RECORD_LAYOUT
/begin RECORD_LAYOUT DefaultValueRecordLayout_uint8 FNC_VALUES 1 UBYTE COLUMN_DIR DIRECT STATIC_RECORD_LAYOUT /end RECORD_LAYOUT
/begin RECORD_LAYOUT __UBYTE_Z_s1 FNC_VALUES 1 UBYTE ROW_DIR DIRECT /end RECORD_LAYOUT
/begin RECORD_LAYOUT __UWORD_Z_s1 FNC_VALUES 1 UWORD ROW_DIR DIRECT /end RECORD_LAYOUT
/begin RECORD_LAYOUT __ULONG_Z_s1 FNC_VALUES 1 ULONG ROW_DIR DIRECT /end RECORD_LAYOUT
/begin RECORD_LAYOUT __SBYTE_Z_s1 FNC_VALUES 1 SBYTE ROW_DIR DIRECT /end RECORD_LAYOUT
/begin RECORD_LAYOUT __SWORD_Z_s1 FNC_VALUES 1 SWORD ROW_DIR DIRECT /end RECORD_LAYOUT
/begin RECORD_LAYOUT __SLONG_Z_s1 FNC_VALUES 1 SLONG ROW_DIR DIRECT /end RECORD_LAYOUT
/*********** Start of merged MEASUREMENT blocks ***********/
/begin MEASUREMENT MCore_RequestComMode "unsigned integer 8bit" UBYTE BCGW_ModeM_CompuMethods_ModeM_RequestComModeType 1 100 0.0 255.0 MAX_REFRESH 1000 1 ECU_ADDRESS 0x400E3518 /end MEASUREMENT
/begin MEASUREMENT MCore_RequestComMode_0 "unsigned integer 8bit" UBYTE BCGW_ModeM_CompuMethods_ModeM_RequestComModeType 1 100 0.0 255.0 MAX_REFRESH 1000 1 ECU_ADDRESS 0x400E3519 /end MEASUREMENT
/begin MEASUREMENT MCore_RequestComMode_1 "unsigned integer 8bit" UBYTE BCGW_ModeM_CompuMethods_ModeM_RequestComModeType 1 100 0.0 255.0 MAX_REFRESH 1000 1 ECU_ADDRESS 0x400E351A /end MEASUREMENT
/begin MEASUREMENT MCore_RequestComMode_2 "unsigned integer 8bit" UBYTE BCGW_ModeM_CompuMethods_ModeM_RequestComModeType 1 100 0.0 255.0 MAX_REFRESH 1000 1 ECU_ADDRESS 0x400E351B /end MEASUREMENT
/begin MEASUREMENT MCore_RequestComMode_3 "unsigned integer 8bit" UBYTE BCGW_ModeM_CompuMethods_ModeM_RequestComModeType 1 100 0.0 255.0 MAX_REFRESH 1000 1 ECU_ADDRESS 0x400E351C /end MEASUREMENT
/begin MEASUREMENT MCore_RequestComMode_4 "unsigned integer 8bit" UBYTE BCGW_ModeM_CompuMethods_ModeM_RequestComModeType 1 100 0.0 255.0 MAX_REFRESH 1000 1 ECU_ADDRESS 0x400E351D /end MEASUREMENT
/begin MEASUREMENT MCore_RequestComMode_5 "unsigned integer 8bit" UBYTE BCGW_ModeM_CompuMethods_ModeM_RequestComModeType 1 100 0.0 255.0 MAX_REFRESH 1000 1 ECU_ADDRESS 0x400E351E /end MEASUREMENT
/begin MEASUREMENT MCore_RequestComMode_6 "unsigned integer 8bit" UBYTE BCGW_ModeM_CompuMethods_ModeM_RequestComModeType 1 100 0.0 255.0 MAX_REFRESH 1000 1 ECU_ADDRESS 0x400E351F /end MEASUREMENT
/begin MEASUREMENT MCore_RequestComMode_7 "unsigned integer 8bit" UBYTE BCGW_ModeM_CompuMethods_ModeM_RequestComModeType 1 100 0.0 255.0 MAX_REFRESH 1000 1 ECU_ADDRESS 0x400E3520 /end MEASUREMENT
/begin MEASUREMENT MCore_RequestComMode_8 "unsigned integer 8bit" UBYTE BCGW_ModeM_CompuMethods_ModeM_RequestComModeType 1 100 0.0 255.0 MAX_REFRESH 1000 1 ECU_ADDRESS 0x400E3521 /end MEASUREMENT
/begin MEASUREMENT MCore_RequestComMode_9 "unsigned integer 8bit" UBYTE BCGW_ModeM_CompuMethods_ModeM_RequestComModeType 1 100 0.0 255.0 MAX_REFRESH 1000 1 ECU_ADDRESS 0x400E3522 /end MEASUREMENT
/begin MEASUREMENT MCore_RequestComMode_10 "unsigned integer 8bit" UBYTE BCGW_ModeM_CompuMethods_ModeM_RequestComModeType 1 100 0.0 255.0 MAX_REFRESH 1000 1 ECU_ADDRESS 0x400E3523 /end MEASUREMENT
/begin MEASUREMENT MCore_RequestComMode_11 "unsigned integer 8bit" UBYTE BCGW_ModeM_CompuMethods_ModeM_RequestComModeType 1 100 0.0 255.0 MAX_REFRESH 1000 1 ECU_ADDRESS 0x400E3524 /end MEASUREMENT
/begin MEASUREMENT MCore_RequestComMode_12 "unsigned integer 8bit" UBYTE BCGW_ModeM_CompuMethods_ModeM_RequestComModeType 1 100 0.0 255.0 MAX_REFRESH 1000 1 ECU_ADDRESS 0x400E3525 /end MEASUREMENT
/begin MEASUREMENT MCore_RequestComMode_13 "unsigned integer 8bit" UBYTE BCGW_ModeM_CompuMethods_ModeM_RequestComModeType 1 100 0.0 255.0 MAX_REFRESH 1000 1 ECU_ADDRESS 0x400E3526 /end MEASUREMENT
/begin MEASUREMENT MCore_RequestComMode_14 "unsigned integer 8bit" UBYTE BCGW_ModeM_CompuMethods_ModeM_RequestComModeType 1 100 0.0 255.0 MAX_REFRESH 1000 1 ECU_ADDRESS 0x400E3527 /end MEASUREMENT
/begin MEASUREMENT MCore_RequestComMode_15 "unsigned integer 8bit" UBYTE BCGW_ModeM_CompuMethods_ModeM_RequestComModeType 1 100 0.0 255.0 MAX_REFRESH 1000 1 ECU_ADDRESS 0x400E3528 /end MEASUREMENT
/begin MEASUREMENT MCore_RequestComMode_16 "unsigned integer 8bit" UBYTE BCGW_ModeM_CompuMethods_ModeM_RequestComModeType 1 100 0.0 255.0 MAX_REFRESH 1000 1 ECU_ADDRESS 0x400E3529 /end MEASUREMENT
/begin MEASUREMENT MCore_RequestComMode_17 "unsigned integer 8bit" UBYTE BCGW_ModeM_CompuMethods_ModeM_RequestComModeType 1 100 0.0 255.0 MAX_REFRESH 1000 1 ECU_ADDRESS 0x400E352A /end MEASUREMENT
/begin MEASUREMENT MCore_RequestComMode_18 "unsigned integer 8bit" UBYTE BCGW_ModeM_CompuMethods_ModeM_RequestComModeType 1 100 0.0 255.0 MAX_REFRESH 1000 1 ECU_ADDRESS 0x400E352B /end MEASUREMENT
/begin MEASUREMENT MCore_RequestComMode_19 "unsigned integer 8bit" UBYTE BCGW_ModeM_CompuMethods_ModeM_RequestComModeType 1 100 0.0 255.0 MAX_REFRESH 1000 1 ECU_ADDRESS 0x400E352C /end MEASUREMENT
/begin MEASUREMENT MCore_RequestComMode_20 "unsigned integer 8bit" UBYTE BCGW_ModeM_CompuMethods_ModeM_RequestComModeType 1 100 0.0 255.0 MAX_REFRESH 1000 1 ECU_ADDRESS 0x400E352D /end MEASUREMENT
/begin MEASUREMENT MCore_RequestComMode_21 "unsigned integer 8bit" UBYTE BCGW_ModeM_CompuMethods_ModeM_RequestComModeType 1 100 0.0 255.0 MAX_REFRESH 1000 1 ECU_ADDRESS 0x400E352E /end MEASUREMENT
/begin MEASUREMENT MCore_RequestComMode_22 "unsigned integer 8bit" UBYTE BCGW_ModeM_CompuMethods_ModeM_RequestComModeType 1 100 0.0 255.0 MAX_REFRESH 1000 1 ECU_ADDRESS 0x400E352F /end MEASUREMENT
/begin MEASUREMENT MCore_RequestComMode_23 "unsigned integer 8bit" UBYTE BCGW_ModeM_CompuMethods_ModeM_RequestComModeType 1 100 0.0 255.0 MAX_REFRESH 1000 1 ECU_ADDRESS 0x400E3530 /end MEASUREMENT
/begin MEASUREMENT MCore_RequestComMode_24 "unsigned integer 8bit" UBYTE BCGW_ModeM_CompuMethods_ModeM_RequestComModeType 1 100 0.0 255.0 MAX_REFRESH 1000 1 ECU_ADDRESS 0x400E3531 /end MEASUREMENT
/begin MEASUREMENT MCore_RequestComMode_25 "unsigned integer 8bit" UBYTE BCGW_ModeM_CompuMethods_ModeM_RequestComModeType 1 100 0.0 255.0 MAX_REFRESH 1000 1 ECU_ADDRESS 0x400E3532 /end MEASUREMENT
/begin MEASUREMENT MCore_RequestComMode_26 "unsigned integer 8bit" UBYTE BCGW_ModeM_CompuMethods_ModeM_RequestComModeType 1 100 0.0 255.0 MAX_REFRESH 1000 1 ECU_ADDRESS 0x400E3533 /end MEASUREMENT
/begin MEASUREMENT MCore_RequestComMode_27 "unsigned integer 8bit" UBYTE BCGW_ModeM_CompuMethods_ModeM_RequestComModeType 1 100 0.0 255.0 MAX_REFRESH 1000 1 ECU_ADDRESS 0x400E3534 /end MEASUREMENT
/begin MEASUREMENT MCore_RequestComMode_28 "unsigned integer 8bit" UBYTE BCGW_ModeM_CompuMethods_ModeM_RequestComModeType 1 100 0.0 255.0 MAX_REFRESH 1000 1 ECU_ADDRESS 0x400E3535 /end MEASUREMENT
/begin MEASUREMENT MCore_enDIAGAnfStatus "unsigned integer 8bit" UBYTE VW_BCM_CompuMethods_CM_TXTenDIAGAnfStatus 1 100 0.0 255.0 MAX_REFRESH 4 1 ECU_ADDRESS 0x528081A1 /end MEASUREMENT
/begin MEASUREMENT MCore_enSPNAnfKlemme15 "unsigned integer 8bit" UBYTE VW_BCM_CompuMethods_CM_TXTenSPNAnfKlemme15 1 100 0.0 255.0 MAX_REFRESH 4 1 ECU_ADDRESS 0x528081A2 /end MEASUREMENT
/begin MEASUREMENT MCore_enSPNAnfStatus "unsigned integer 8bit" UBYTE VW_BCM_CompuMethods_CM_TXTenSPNAnfStatus 1 100 0.0 255.0 MAX_REFRESH 4 1 ECU_ADDRESS 0x528081A3 /end MEASUREMENT
/begin MEASUREMENT MCore_enSPNAnfWFSFreigabe "unsigned integer 8bit" UBYTE VW_BCM_CompuMethods_CM_TXTenSPNAnfWFSFreigabe 1 100 0.0 255.0 MAX_REFRESH 4 1 ECU_ADDRESS 0x528081A4 /end MEASUREMENT
/begin MEASUREMENT MCore_Unconnected_enComUserRequestReasonSpnSen "unsigned integer 8bit" UBYTE VW_BCM_CompuMethods_CM_TXTenComUserRequestReasonSpnSen 1 100 0.0 255.0 MAX_REFRESH 4 1 ECU_ADDRESS 0x400E312D /end MEASUREMENT
/begin MEASUREMENT MCore_Unconnected_bAnfKlemme15 "Boolean" UBYTE Methods_boolean 1 100 0.0 1.0 MAX_REFRESH 4 1 ECU_ADDRESS 0x400E3130 /end MEASUREMENT
/begin MEASUREMENT MCore_Unconnected_bAnfKlemmeS "Boolean" UBYTE Methods_boolean 1 100 0.0 1.0 MAX_REFRESH 4 1 ECU_ADDRESS 0x400E312F /end MEASUREMENT
/begin MEASUREMENT MCore_Unconnected_bAnfKlemmeStartwunsch "Boolean" UBYTE Methods_boolean 1 100 0.0 1.0 MAX_REFRESH 4 1 ECU_ADDRESS 0x400E3131 /end MEASUREMENT
/begin MEASUREMENT MCore_Unconnected_bAnfKlemmenfreigabeELV "Boolean" UBYTE Methods_boolean 1 100 0.0 1.0 MAX_REFRESH 4 1 ECU_ADDRESS 0x400E3132 /end MEASUREMENT
/begin MEASUREMENT MCore_Unconnected_bAnfKlemmenfreigabeWFS "Boolean" UBYTE Methods_boolean 1 100 0.0 1.0 MAX_REFRESH 4 1 ECU_ADDRESS 0x400E3133 /end MEASUREMENT
/begin MEASUREMENT MCore_Unconnected_bAnzeigeSpnFehlermode2 "Boolean" UBYTE Methods_boolean 1 100 0.0 1.0 MAX_REFRESH 4 1 ECU_ADDRESS 0x400E3136 /end MEASUREMENT
/begin MEASUREMENT MCore_Unconnected_bAnzeigeWegrollwarnung "Boolean" UBYTE Methods_boolean 1 100 0.0 1.0 MAX_REFRESH 4 1 ECU_ADDRESS 0x400E3137 /end MEASUREMENT
/begin MEASUREMENT MCore_Unconnected_bElvEntriegelt "Boolean" UBYTE Methods_boolean 1 100 0.0 1.0 MAX_REFRESH 4 1 ECU_ADDRESS 0x400E313B /end MEASUREMENT
/begin MEASUREMENT MCore_Unconnected_bEspWecken "Boolean" UBYTE Methods_boolean 1 100 0.0 1.0 MAX_REFRESH 4 1 ECU_ADDRESS 0x400E3139 /end MEASUREMENT
/begin MEASUREMENT MCore_Unconnected_bHinweisKomfortabschaltung "Boolean" UBYTE Methods_boolean 1 100 0.0 1.0 MAX_REFRESH 4 1 ECU_ADDRESS 0x400E3134 /end MEASUREMENT
/begin MEASUREMENT MCore_Unconnected_bHinweisNotabschaltung "Boolean" UBYTE Methods_boolean 1 100 0.0 1.0 MAX_REFRESH 4 1 ECU_ADDRESS 0x400E3135 /end MEASUREMENT
/begin MEASUREMENT MCore_Unconnected_bKlemmenHochschaltSperren "Boolean" UBYTE Methods_boolean 1 100 0.0 1.0 MAX_REFRESH 4 1 ECU_ADDRESS 0x400E313A /end MEASUREMENT
/begin MEASUREMENT MCore_Unconnected_bKlemmenfreigabeWFSintern "Boolean" UBYTE Methods_boolean 1 100 0.0 1.0 MAX_REFRESH 4 1 ECU_ADDRESS 0x400E313E /end MEASUREMENT
/begin MEASUREMENT MCore_Unconnected_bMotorLaeuft "Boolean" UBYTE Methods_boolean 1 100 0.0 1.0 MAX_REFRESH 4 1 ECU_ADDRESS 0x400E3138 /end MEASUREMENT
/begin MEASUREMENT MCore_Unconnected_bMotordrehzahlUngueltigErrSt "Boolean" UBYTE Methods_boolean 1 100 0.0 1.0 MAX_REFRESH 4 1 ECU_ADDRESS 0x400E313D
 /begin ANNOTATION ANNOTATION_LABEL "Description (coming from AUTOSAR DESC field)" /begin ANNOTATION_TEXT "Motordrehzahl Invalid\r\n" /end ANNOTATION_TEXT /end ANNOTATION
/end MEASUREMENT
/begin MEASUREMENT MCore_Unconnected_bMotordrehzahlVeraltetErrSt "Boolean" UBYTE Methods_boolean 1 100 0.0 1.0 MAX_REFRESH 4 1 ECU_ADDRESS 0x400E313C
 /begin ANNOTATION ANNOTATION_LABEL "Description (coming from AUTOSAR DESC field)" /begin ANNOTATION_TEXT "Motordrehzahl outdated\r\n" /end ANNOTATION_TEXT /end ANNOTATION
/end MEASUREMENT
/begin MEASUREMENT MCore_Unconnected_bZATbetaetigt "Boolean" UBYTE Methods_boolean 1 100 0.0 1.0 MAX_REFRESH 4 1 ECU_ADDRESS 0x400E312E /end MEASUREMENT
/begin MEASUREMENT MCore_Unconnected_bAntriebsstrangaktivierungErlauben "Boolean" UBYTE Methods_boolean 1 100 0.0 1.0 MAX_REFRESH 4 1 ECU_ADDRESS 0x400E3141 /end MEASUREMENT
/begin MEASUREMENT MCore_Unconnected_bKlemmenkoordFreigabeIntern "Boolean" UBYTE Methods_boolean 1 100 0.0 1.0 MAX_REFRESH 4 1 ECU_ADDRESS 0x400E3144 /end MEASUREMENT
/begin MEASUREMENT MCore_Unconnected_bSpnFehlermode2aktiv "Boolean" UBYTE Methods_boolean 1 100 0.0 1.0 MAX_REFRESH 4 1 ECU_ADDRESS 0x400E313F /end MEASUREMENT
/begin MEASUREMENT MCore_Unconnected_bTriggerKlemmenkoordAusIntern "Boolean" UBYTE Methods_boolean 1 100 0.0 1.0 MAX_REFRESH 4 1 ECU_ADDRESS 0x400E3147 /end MEASUREMENT
/begin MEASUREMENT MCore_Unconnected_bTriggerKlemmenkoordDiagIntern "Boolean" UBYTE Methods_boolean 1 100 0.0 1.0 MAX_REFRESH 4 1 ECU_ADDRESS 0x400E3146 /end MEASUREMENT
/begin MEASUREMENT MCore_Unconnected_bTriggerKlemmenkoordIntern "Boolean" UBYTE Methods_boolean 1 100 0.0 1.0 MAX_REFRESH 4 1 ECU_ADDRESS 0x400E3145 /end MEASUREMENT
/begin MEASUREMENT MCore_Unconnected_bZat1Spn "Boolean" UBYTE Methods_boolean 1 100 0.0 1.0 MAX_REFRESH 4 1 ECU_ADDRESS 0x400E3142 /end MEASUREMENT
/begin MEASUREMENT MCore_Unconnected_bZat2Spn "Boolean" UBYTE Methods_boolean 1 100 0.0 1.0 MAX_REFRESH 4 1 ECU_ADDRESS 0x400E3143 /end MEASUREMENT
/begin MEASUREMENT MCore_Unconnected_enElvVerbaut "unsigned integer 8bit" UBYTE VW_BCM_CompuMethods_CM_TXTenElvVerbaut 1 100 0.0 255.0 MAX_REFRESH 4 1 ECU_ADDRESS 0x400E3140 /end MEASUREMENT
/begin MEASUREMENT MCore_Spn_bFzgTimeoutDeaktivieren_COV "Boolean" UBYTE Methods_boolean 1 100 0.0 1.0 MAX_REFRESH 4 1 ECU_ADDRESS 0x5280D329 /end MEASUREMENT
/begin MEASUREMENT MCore_Spn_bTriggerKlemmenkoordinator_COV "Boolean" UBYTE Methods_boolean 1 100 0.0 1.0 MAX_REFRESH 4 1 ECU_ADDRESS 0x5280D32A /end MEASUREMENT
/begin MEASUREMENT MCore_Spn_enAnfKlemme15Diag_COV "unsigned integer 8bit" UBYTE VW_BCM_CompuMethods_SC_F1_O0_UNoUnit 1 100 0.0 255.0 MAX_REFRESH 4 1 ECU_ADDRESS 0x5280D32B /end MEASUREMENT
/begin MEASUREMENT MCore_Spn_enInitKlemme15Diag_COV "unsigned integer 32bit" ULONG VW_BCM_CompuMethods_SC_F1_O0_UNoUnit 1 100 0.0 4.294967295E9 MAX_REFRESH 4 1 ECU_ADDRESS 0x1219654 /end MEASUREMENT
/begin MEASUREMENT MCore_ZV_bKessyAktiv_COV "Boolean" UBYTE Methods_boolean 1 100 0.0 1.0 MAX_REFRESH 4 1 ECU_ADDRESS 0x5280D32C /end MEASUREMENT
/begin MEASUREMENT MCore_ZV_bKessyIO_COV "Boolean" UBYTE Methods_boolean 1 100 0.0 1.0 MAX_REFRESH 4 1 ECU_ADDRESS 0x400E392C /end MEASUREMENT
/begin MEASUREMENT MCore_Spn_numZatFehler_AV "unsigned integer 16bit" UWORD VW_BCM_CompuMethods_SC_F1_O0_UNoUnit 1 100 1.0 50.0 MAX_REFRESH 4 1 ECU_ADDRESS 0x1223AF0 /end MEASUREMENT
/begin MEASUREMENT MCore_Spn_numZatMehrfach_AV "unsigned integer 16bit" UWORD VW_BCM_CompuMethods_SC_F1_O0_UNoUnit 1 100 2.0 5.0 MAX_REFRESH 4 1 ECU_ADDRESS 0x1223AF2 /end MEASUREMENT
/begin MEASUREMENT MCore_Spn_rpmMotorLaeuft_AV "unsigned integer 16bit" UWORD App_SpnSen_CompuMethods_SC_F10_O0_Urpm 1 100 0.0 1000.0 MAX_REFRESH 4 1 ECU_ADDRESS 0x1223AF4 /end MEASUREMENT
/begin MEASUREMENT MCore_Spn_tHinweisNotabschaltung_AV "unsigned integer 16bit" UWORD App_SpnSen_CompuMethods_SC_F100_O0_Ums 1 100 0.0 5100.0 MAX_REFRESH 4 1 ECU_ADDRESS 0x1223AF6 /end MEASUREMENT
/begin MEASUREMENT MCore_Spn_tHinweisSpnFehlermode2_AV "unsigned integer 16bit" UWORD VW_BCM_CompuMethods_SC_F1_O0_USec 1 100 0.0 20.0 MAX_REFRESH 4 1 ECU_ADDRESS 0x1223AF8 /end MEASUREMENT
/begin MEASUREMENT MCore_Spn_tKlemme50min_AV "unsigned integer 16bit" UWORD App_Tc_CompuMethods_SC_F10_O0_Ums 1 100 0.0 2550.0 MAX_REFRESH 4 1 ECU_ADDRESS 0x1223AFA /end MEASUREMENT
/begin MEASUREMENT MCore_Spn_tTimeoutKlemmeS_AV "unsigned integer 16bit" UWORD DefaultIdenticalCompu 1 100 0.0 65535.0 MAX_REFRESH 4 1 ECU_ADDRESS 0x1223AFC /end MEASUREMENT
/begin MEASUREMENT MCore_Spn_tTriggerKlemmenkoordVerwerfen_AV "unsigned integer 8bit" UBYTE App_SpnSen_CompuMethods_SC_F100_O0_Ums 1 100 0.0 5100.0 MAX_REFRESH 4 1 ECU_ADDRESS 0x400E392D /end MEASUREMENT
/begin MEASUREMENT MCore_Spn_tTriggerWfsFreigabe_AV "unsigned integer 8bit" UBYTE App_SpnSen_CompuMethods_SC_F200_O0_Ums 1 100 0.0 40000.0 MAX_REFRESH 4 1 ECU_ADDRESS 0x5280D32D /end MEASUREMENT
/begin MEASUREMENT MCore_Spn_tTriggerZuendungVerwerfen_AV "unsigned integer 16bit" UWORD VW_BCM_CompuMethods_SC_F1_O0_USec 1 100 0.0 40.0 MAX_REFRESH 4 1 ECU_ADDRESS 0x1223AFE /end MEASUREMENT
/begin MEASUREMENT MCore_Spn_tZatEinschaltErkennung_AV "unsigned integer 8bit" UBYTE App_SpnSen_CompuMethods_SC_F100_O0_Ums 1 100 0.0 25500.0 MAX_REFRESH 4 1 ECU_ADDRESS 0x5280D32E /end MEASUREMENT
/begin MEASUREMENT MCore_Spn_tZatEntprellung_AV "unsigned integer 8bit" UBYTE App_SpnSen_CompuMethods_SC_F5_O0_Ums 1 100 0.0 100.0 MAX_REFRESH 4 1 ECU_ADDRESS 0x5280D32F /end MEASUREMENT
/begin MEASUREMENT MCore_Spn_tZatKurzschluss_AV "unsigned integer 8bit" UBYTE VW_BCM_CompuMethods_SC_F1_O0_USec 1 100 0.0 255.0 MAX_REFRESH 4 1 ECU_ADDRESS 0x5280D330 /end MEASUREMENT
/begin MEASUREMENT MCore_Spn_tZatLang_AV "unsigned integer 8bit" UBYTE App_SpnSen_CompuMethods_SC_F100_O0_Ums 1 100 0.0 25500.0 MAX_REFRESH 4 1 ECU_ADDRESS 0x5280D331 /end MEASUREMENT
/begin MEASUREMENT MCore_Spn_tZatMehrfach_AV "unsigned integer 8bit" UBYTE App_SpnSen_CompuMethods_SC_F100_O0_Ums 1 100 0.0 25500.0 MAX_REFRESH 4 1 ECU_ADDRESS 0x5280D332 /end MEASUREMENT
/begin MEASUREMENT MCore_Spn_tZatSperreNachNotaus_AV "unsigned integer 8bit" UBYTE App_SpnSen_CompuMethods_SC_F50_O0_Ums 1 100 350.0 12750.0 MAX_REFRESH 4 1 ECU_ADDRESS 0x5280D333 /end MEASUREMENT
/begin MEASUREMENT MCore_Spn_tZatSperreNachZuendungAus_AV "unsigned integer 8bit" UBYTE App_SpnSen_CompuMethods_SC_F50_O0_Ums 1 100 350.0 12750.0 MAX_REFRESH 4 1 ECU_ADDRESS 0x5280D334 /end MEASUREMENT
/begin MEASUREMENT MCore_Spn_tZatUnterbrechung_AV "unsigned integer 8bit" UBYTE App_Tc_CompuMethods_SC_F10_O0_Ums 1 100 0.0 2550.0 MAX_REFRESH 4 1 ECU_ADDRESS 0x5280D335 /end MEASUREMENT
/begin MEASUREMENT MCore_Spn_vKlemme15Aus_AV "unsigned integer 8bit" UBYTE App_SpnSen_CompuMethods_SC_F0pt1_O0_Ukmh 1 100 0.0 25.5 MAX_REFRESH 4 1 ECU_ADDRESS 0x5280D336 /end MEASUREMENT
/begin MEASUREMENT MCore_Spn_vStartwunsch_AV "unsigned integer 8bit" UBYTE App_Tc_CompuMethods_SC_F1_O0_Ukmh 1 100 0.0 20.0 MAX_REFRESH 4 1 ECU_ADDRESS 0x5280D337 /end MEASUREMENT
/begin MEASUREMENT MCore_evFTVerrSoll "Boolean" UBYTE Methods_boolean 1 100 0.0 1.0 MAX_REFRESH 4 1 ECU_ADDRESS 0x5280D338 /end MEASUREMENT
/begin MEASUREMENT MCore_evZentSafenSoll "Boolean" UBYTE Methods_boolean 1 100 0.0 1.0 MAX_REFRESH 4 1 ECU_ADDRESS 0x5280D339 /end MEASUREMENT
/begin MEASUREMENT MCore_bZExtVerSoll "Boolean" UBYTE Methods_boolean 1 100 0.0 1.0 MAX_REFRESH 4 1 ECU_ADDRESS 0x5280D33A /end MEASUREMENT
/begin MEASUREMENT MCore_bElvAbbruchAnfKlemmenfreigabe "Boolean" UBYTE Methods_boolean 1 100 0.0 1.0 MAX_REFRESH 4 1 ECU_ADDRESS 0x5280D33B /end MEASUREMENT
/begin MEASUREMENT MCore_bElvEntriegelt_0 "Boolean" UBYTE Methods_boolean 1 100 0.0 1.0 MAX_REFRESH 4 1 ECU_ADDRESS 0x5280D33C /end MEASUREMENT
/begin MEASUREMENT MCore_bElvKlemmenfreigabe "Boolean" UBYTE Methods_boolean 1 100 0.0 1.0 MAX_REFRESH 4 1 ECU_ADDRESS 0x5280D33D /end MEASUREMENT
/begin MEASUREMENT MCore_bElvVerriegelt "Boolean" UBYTE Methods_boolean 1 100 0.0 1.0 MAX_REFRESH 4 1 ECU_ADDRESS 0x5280D33E /end MEASUREMENT
/begin MEASUREMENT MCore_enELV01ErrSt "unsigned integer 8bit" UBYTE VW_BCM_CompuMethods_CM_TXTenErrStatus 1 100 0.0 255.0 MAX_REFRESH 4 1 ECU_ADDRESS 0x5280D33F
 /begin ANNOTATION ANNOTATION_LABEL "Description (coming from AUTOSAR DESC field)" /begin ANNOTATION_TEXT "Communication state of PDU ELV_01\r\n" /end ANNOTATION_TEXT /end ANNOTATION
/end MEASUREMENT
/begin MEASUREMENT MCore_StESPErrTyp "unsigned integer 8bit" UBYTE DefaultIdenticalCompu 1 100 0.0 255.0 MAX_REFRESH 4 1 ECU_ADDRESS 0x5280D340
 /begin ANNOTATION ANNOTATION_LABEL "Description (coming from AUTOSAR DESC field)" /begin ANNOTATION_TEXT "Error bitfield for ESP_21 message\r\n" /end ANNOTATION_TEXT /end ANNOTATION
/end MEASUREMENT
/begin MEASUREMENT MCore_bFzgGeschwQBitErr "Boolean" UBYTE Methods_boolean 1 100 0.0 1.0 MAX_REFRESH 4 1 ECU_ADDRESS 0x5280D341 /end MEASUREMENT
/begin MEASUREMENT MCore_enESCvSigQualifizierung "unsigned integer 8bit" UBYTE VW_BCM_CompuMethods_CM_TXTenESCvSigQualifizierung 1 100 0.0 255.0 MAX_REFRESH 4 1 ECU_ADDRESS 0x5280D342 /end MEASUREMENT
/begin MEASUREMENT MCore_envFzgErrSt "unsigned integer 8bit" UBYTE VW_BCM_CompuMethods_CM_TXTenErrStatus 1 100 0.0 255.0 MAX_REFRESH 4 1 ECU_ADDRESS 0x5280D343 /end MEASUREMENT
/begin MEASUREMENT MCore_vFzg "unsigned integer 16bit" UWORD DefaultIdenticalCompu 1 100 0.0 65535.0 MAX_REFRESH 4 1 ECU_ADDRESS 0x1223B00 /end MEASUREMENT
/begin MEASUREMENT MCore_bStFTOffen "Boolean" UBYTE Methods_boolean 1 100 0.0 1.0 MAX_REFRESH 4 1 ECU_ADDRESS 0x5280D344 /end MEASUREMENT
/begin MEASUREMENT MCore_bMotor12alt "Boolean" UBYTE Methods_boolean 1 100 0.0 1.0 MAX_REFRESH 4 1 ECU_ADDRESS 0x5280D345 /end MEASUREMENT
/begin MEASUREMENT MCore_bMOKl50_1 "Boolean" UBYTE Methods_boolean 1 100 0.0 1.0 MAX_REFRESH 4 1 ECU_ADDRESS 0x5280D346 /end MEASUREMENT
/begin MEASUREMENT MCore_bMoHybFahrbereitschaft_0 "Boolean" UBYTE Methods_boolean 1 100 0.0 1.0 MAX_REFRESH 4 1 ECU_ADDRESS 0x5280D347
 /begin ANNOTATION ANNOTATION_LABEL "Description (coming from AUTOSAR DESC field)" /begin ANNOTATION_TEXT "Motor hybrid driving\r\n" /end ANNOTATION_TEXT /end ANNOTATION
/end MEASUREMENT
/begin MEASUREMENT MCore_bMotorStoppAktivSSF "Boolean" UBYTE Methods_boolean 1 100 0.0 1.0 MAX_REFRESH 4 1 ECU_ADDRESS 0x5280D348 /end MEASUREMENT
/begin MEASUREMENT MCore_bMotordrehzQBitErr "Boolean" UBYTE Methods_boolean 1 100 0.0 1.0 MAX_REFRESH 4 1 ECU_ADDRESS 0x5280D349 /end MEASUREMENT
/begin MEASUREMENT MCore_enMoStartVoraussErfuellt "unsigned integer 8bit" UBYTE VW_BCM_CompuMethods_CM_TXTenMoStartVoraussErfuellt 1 100 0.0 255.0 MAX_REFRESH 4 1 ECU_ADDRESS 0x5280D34A /end MEASUREMENT
/begin MEASUREMENT MCore_enMotor14ErrSt "unsigned integer 8bit" UBYTE VW_BCM_CompuMethods_CM_TXTenErrStatus 1 100 0.0 255.0 MAX_REFRESH 4 1 ECU_ADDRESS 0x5280D34B
 /begin ANNOTATION ANNOTATION_LABEL "Description (coming from AUTOSAR DESC field)" /begin ANNOTATION_TEXT "Communication state of PDU Motor_14\r\n" /end ANNOTATION_TEXT /end ANNOTATION
/end MEASUREMENT
/begin MEASUREMENT MCore_enMotorStoppStatusSSF "unsigned integer 8bit" UBYTE VW_BCM_CompuMethods_SC_F1_O0_UNoUnit 1 100 0.0 3.0 MAX_REFRESH 4 1 ECU_ADDRESS 0x5280D34C /end MEASUREMENT
/begin MEASUREMENT MCore_enNumMotordrehzErrSt "unsigned integer 8bit" UBYTE VW_BCM_CompuMethods_CM_TXTenErrStatus 1 100 0.0 255.0 MAX_REFRESH 4 1 ECU_ADDRESS 0x5280D34D /end MEASUREMENT
/begin MEASUREMENT MCore_numMotordrehz "unsigned integer 16bit" UWORD VW_BCM_CompuMethods_SC_F0pt25_O0_URpm 1 100 0.0 16383.0 MAX_REFRESH 4 1 ECU_ADDRESS 0x1223B02 /end MEASUREMENT
/begin MEASUREMENT MCore_bStKlemme50pmode "Boolean" UBYTE Methods_boolean 1 100 0.0 1.0 MAX_REFRESH 4 1 ECU_ADDRESS 0x5280D34E /end MEASUREMENT
/begin MEASUREMENT MCore_USGSpannung "unsigned integer 8bit" UBYTE VW_BCM_CompuMethods_SC_F0pt1_O0_UVolt 1 100 0.0 25.5 MAX_REFRESH 4 1 ECU_ADDRESS 0x5280D34F /end MEASUREMENT
/begin MEASUREMENT MCore_bPMode "Boolean" UBYTE Methods_boolean 1 100 0.0 1.0 MAX_REFRESH 4 1 ECU_ADDRESS 0x5280D350 /end MEASUREMENT
/begin MEASUREMENT MCore_enWeckgrund "unsigned integer 8bit" UBYTE VW_BCM_CompuMethods_CM_TXTenWeckgrund 1 100 0.0 255.0 MAX_REFRESH 4 1 ECU_ADDRESS 0x5280D351 /end MEASUREMENT
/begin MEASUREMENT MCore_bKlemme15AbschaltEmpfehlung "Boolean" UBYTE Methods_boolean 1 100 0.0 1.0 MAX_REFRESH 4 1 ECU_ADDRESS 0x5280D352
 /begin ANNOTATION ANNOTATION_LABEL "Description (coming from AUTOSAR DESC field)" /begin ANNOTATION_TEXT "Request to switch OFF Klemme15\r\n" /end ANNOTATION_TEXT /end ANNOTATION
/end MEASUREMENT
/begin MEASUREMENT MCore_bKlemmeSAbschaltEmpfehlung "Boolean" UBYTE Methods_boolean 1 100 0.0 1.0 MAX_REFRESH 4 1 ECU_ADDRESS 0x5280D353
 /begin ANNOTATION ANNOTATION_LABEL "Description (coming from AUTOSAR DESC field)" /begin ANNOTATION_TEXT "Request to switch OFF KlemmeS\r\n" /end ANNOTATION_TEXT /end ANNOTATION
/end MEASUREMENT
/begin MEASUREMENT MCore_bKlemmenfreigabeWFS "Boolean" UBYTE Methods_boolean 1 100 0.0 1.0 MAX_REFRESH 4 1 ECU_ADDRESS 0x5280D354 /end MEASUREMENT
/begin MEASUREMENT MCore_bVerbauinfoElv "Boolean" UBYTE Methods_boolean 1 100 0.0 1.0 MAX_REFRESH 4 1 ECU_ADDRESS 0x5280D355 /end MEASUREMENT
/begin MEASUREMENT MCore_numLebenszustand "unsigned integer 8bit" UBYTE VW_BCM_CompuMethods_SC_F1_O0_UNoUnit 1 100 0.0 99.0 MAX_REFRESH 4 1 ECU_ADDRESS 0x5280D356 /end MEASUREMENT
/begin MEASUREMENT MCore_numSchluesselIst "unsigned integer 8bit" UBYTE VW_BCM_CompuMethods_SC_F1_O0_UNoUnit 1 100 0.0 8.0 MAX_REFRESH 4 1 ECU_ADDRESS 0x5280D357 /end MEASUREMENT
/begin MEASUREMENT MCore_Unconnected_MajorVersion "" UBYTE VW_BCM_CompuMethods_SC_F1_O0_UNoUnit 1 100 0.0 255.0 ARRAY_SIZE 4 ECU_ADDRESS 0x400D8C88 /end MEASUREMENT
/begin MEASUREMENT MCore_Unconnected_MinorVersion "" UBYTE VW_BCM_CompuMethods_SC_F1_O0_UNoUnit 1 100 0.0 255.0 ARRAY_SIZE 4 ECU_ADDRESS 0x400D8C8C /end MEASUREMENT
/begin MEASUREMENT MCore_Unconnected_PatchVersion "" UBYTE VW_BCM_CompuMethods_SC_F1_O0_UNoUnit 1 100 0.0 255.0 ARRAY_SIZE 4 ECU_ADDRESS 0x400D8C90 /end MEASUREMENT
/begin MEASUREMENT MCore_Unconnected_SwcoNumber "" UBYTE VW_BCM_CompuMethods_SC_F1_O0_UNoUnit 1 100 0.0 255.0 ARRAY_SIZE 8 ECU_ADDRESS 0x400E2C18 /end MEASUREMENT
/begin MEASUREMENT MCore_Unconnected_SwcoSysName "" UBYTE VW_BCM_CompuMethods_SC_F1_O0_UNoUnit 1 100 0.0 255.0 ARRAY_SIZE 13 ECU_ADDRESS 0x400D9133 /end MEASUREMENT
/begin MEASUREMENT MCore_Unconnected_VendorID "" UBYTE VW_BCM_CompuMethods_SC_F1_O0_UNoUnit 1 100 0.0 255.0 ARRAY_SIZE 2 ECU_ADDRESS 0x400E2F34 /end MEASUREMENT
/begin MEASUREMENT MCore_Unconnected_VwSparePartNumber "" UBYTE VW_BCM_CompuMethods_SC_F1_O0_UNoUnit 1 100 0.0 255.0 ARRAY_SIZE 11 ECU_ADDRESS 0x400D9140 /end MEASUREMENT
/begin MEASUREMENT MCore_PIM_NIR_SpnKlemmenstatus.numKlemmeSZat "" UBYTE App_Tc_CompuMethods_CM_TXTenKlemmenstatusNir 1 100 0.0 255.0 ECU_ADDRESS 0x400E2200 /end MEASUREMENT
/begin MEASUREMENT MCore_PIM_NIR_SpnKlemmenstatus.numKlemmeSZatInv "" UBYTE App_Tc_CompuMethods_CM_TXTenKlemmenstatusNir 1 100 0.0 255.0 ECU_ADDRESS 0x400E2201 /end MEASUREMENT
/begin MEASUREMENT MCore_PIM_NIR_SpnKlemmenstatus.numKlemme15Zat "" UBYTE App_Tc_CompuMethods_CM_TXTenKlemmenstatusNir 1 100 0.0 255.0 ECU_ADDRESS 0x400E2202 /end MEASUREMENT
/begin MEASUREMENT MCore_PIM_NIR_SpnKlemmenstatus.numKlemme15ZatInv "" UBYTE App_Tc_CompuMethods_CM_TXTenKlemmenstatusNir 1 100 0.0 255.0 ECU_ADDRESS 0x400E2203 /end MEASUREMENT
/begin MEASUREMENT MCore_PIM_NIR_SpnKlemmenstatus.numKlemmeStartwunschZat "" UBYTE App_Tc_CompuMethods_CM_TXTenKlemmenstatusNir 1 100 0.0 255.0 ECU_ADDRESS 0x400E2204 /end MEASUREMENT
/begin MEASUREMENT MCore_PIM_NIR_SpnKlemmenstatus.numKlemmeStartwunschZatInv "" UBYTE App_Tc_CompuMethods_CM_TXTenKlemmenstatusNir 1 100 0.0 255.0 ECU_ADDRESS 0x400E2205 /end MEASUREMENT
/begin MEASUREMENT MCore_PIM_NIR_SpnKlemmenstatus.numZatBetaetigt "" UBYTE App_Tc_CompuMethods_CM_TXTenKlemmenstatusNir 1 100 0.0 255.0 ECU_ADDRESS 0x400E2206 /end MEASUREMENT
/begin MEASUREMENT MCore_PIM_NIR_SpnKlemmenstatus.numZatBetaetigtInv "" UBYTE App_Tc_CompuMethods_CM_TXTenKlemmenstatusNir 1 100 0.0 255.0 ECU_ADDRESS 0x400E2207 /end MEASUREMENT
/begin MEASUREMENT MCore_PIM_NIR_SpnKlemmenstatus.numPowerOnErkannt "" UBYTE App_Tc_CompuMethods_CM_TXTenKlemmenstatusNir 1 100 0.0 255.0 ECU_ADDRESS 0x400E2208 /end MEASUREMENT
/begin MEASUREMENT MCore_PIM_NIR_SpnKlemmenstatus.numPowerOnErkanntInv "" UBYTE App_Tc_CompuMethods_CM_TXTenKlemmenstatusNir 1 100 0.0 255.0 ECU_ADDRESS 0x400E2209 /end MEASUREMENT
/begin MEASUREMENT MCore_PIM_NIR_SpnKlemmenstatus.numCounterZat1 "" UBYTE VW_BCM_CompuMethods_SC_F1_O0_UNoUnit 1 100 0.0 255.0 ECU_ADDRESS 0x400E220A /end MEASUREMENT
/begin MEASUREMENT MCore_PIM_NIR_SpnKlemmenstatus.numCounterZat1tInv "" UBYTE VW_BCM_CompuMethods_SC_F1_O0_UNoUnit 1 100 0.0 255.0 ECU_ADDRESS 0x400E220B /end MEASUREMENT
/begin MEASUREMENT MCore_PIM_NIR_SpnKlemmenstatus.numCounterZat2 "" UBYTE VW_BCM_CompuMethods_SC_F1_O0_UNoUnit 1 100 0.0 255.0 ECU_ADDRESS 0x400E220C /end MEASUREMENT
/begin MEASUREMENT MCore_PIM_NIR_SpnKlemmenstatus.numCounterZat2tInv "" UBYTE VW_BCM_CompuMethods_SC_F1_O0_UNoUnit 1 100 0.0 255.0 ECU_ADDRESS 0x400E220D /end MEASUREMENT
/begin MEASUREMENT MCore_PIM_NIR_SpnKlemmenstatus.numKurzschlussZat1Zat2 "" UBYTE App_Tc_CompuMethods_CM_TXTenKlemmenstatusNir 1 100 0.0 255.0 ECU_ADDRESS 0x400E220E /end MEASUREMENT
/begin MEASUREMENT MCore_PIM_NIR_SpnKlemmenstatus.numKurzschlussZat1Zat2Inv "" UBYTE App_Tc_CompuMethods_CM_TXTenKlemmenstatusNir 1 100 0.0 255.0 ECU_ADDRESS 0x400E220F /end MEASUREMENT
/begin MEASUREMENT MCore_bKlemme15Zat_INIT "Boolean" UBYTE Methods_boolean 1 100 0.0 1.0 MAX_REFRESH 4 1 ECU_ADDRESS 0x52808097 /end MEASUREMENT
/begin MEASUREMENT MCore_bKlemmeSZat_INIT "Boolean" UBYTE Methods_boolean 1 100 0.0 1.0 MAX_REFRESH 4 1 ECU_ADDRESS 0x52808098 /end MEASUREMENT
/begin MEASUREMENT MCore_bKlemmeStartwunschZat_INIT "Boolean" UBYTE Methods_boolean 1 100 0.0 1.0 MAX_REFRESH 4 1 ECU_ADDRESS 0x52808099 /end MEASUREMENT
/begin MEASUREMENT MCore_bKurzschlussZat1Zat2_INIT "Boolean" UBYTE Methods_boolean 1 100 0.0 1.0 MAX_REFRESH 4 1 ECU_ADDRESS 0x5280809A /end MEASUREMENT
/begin MEASUREMENT MCore_bMWAntriebsstrangAktErlauben "Boolean" UBYTE Methods_boolean 1 100 0.0 1.0 MAX_REFRESH 4 1 ECU_ADDRESS 0x5280809B /end MEASUREMENT
/begin MEASUREMENT MCore_bMWKlemmenfreigabeWfsIntern "Boolean" UBYTE Methods_boolean 1 100 0.0 1.0 MAX_REFRESH 4 1 ECU_ADDRESS 0x5280809C /end MEASUREMENT
/begin MEASUREMENT MCore_bMWKlkFreigabeIntern "Boolean" UBYTE Methods_boolean 1 100 0.0 1.0 MAX_REFRESH 4 1 ECU_ADDRESS 0x5280809D /end MEASUREMENT
/begin MEASUREMENT MCore_bMWTriggerKlkFreigabeDiag "Boolean" UBYTE Methods_boolean 1 100 0.0 1.0 MAX_REFRESH 4 1 ECU_ADDRESS 0x5280809E /end MEASUREMENT
/begin MEASUREMENT MCore_bMWTriggerKlkFreigabeZuendungAus "Boolean" UBYTE Methods_boolean 1 100 0.0 1.0 MAX_REFRESH 4 1 ECU_ADDRESS 0x5280809F /end MEASUREMENT
/begin MEASUREMENT MCore_bMWTriggerKlkFreigabeZuendungEin "Boolean" UBYTE Methods_boolean 1 100 0.0 1.0 MAX_REFRESH 4 1 ECU_ADDRESS 0x528080A0 /end MEASUREMENT
/begin MEASUREMENT MCore_CPT_SpnSen_bNoIniRamValid_INIT "Boolean" UBYTE Methods_boolean 1 100 0.0 1.0 MAX_REFRESH 4 1 ECU_ADDRESS 0x528080A1 /end MEASUREMENT
/begin MEASUREMENT MCore_bPowerOnErkannt_INIT "Boolean" UBYTE Methods_boolean 1 100 0.0 1.0 MAX_REFRESH 4 1 ECU_ADDRESS 0x528080A2 /end MEASUREMENT
/begin MEASUREMENT MCore_bZatBetaetigt_INIT "Boolean" UBYTE Methods_boolean 1 100 0.0 1.0 MAX_REFRESH 4 1 ECU_ADDRESS 0x528080A3 /end MEASUREMENT
/begin MEASUREMENT MCore_enMWAnfKlemmenfreigabeWfs "unsigned integer 8bit" UBYTE App_Tc_CompuMethods_CM_TXTenNotactiveActive 1 100 0.0 255.0 MAX_REFRESH 4 1 ECU_ADDRESS 0x528080A4 /end MEASUREMENT
/begin MEASUREMENT MCore_enMWElvAnfKlemmenfreigabe "unsigned integer 8bit" UBYTE App_Tc_CompuMethods_CM_TXTenNotactiveActiveNotinstalled 1 100 0.0 255.0 MAX_REFRESH 4 1 ECU_ADDRESS 0x528080A5 /end MEASUREMENT
/begin MEASUREMENT MCore_enMWElvEntriegelt "unsigned integer 8bit" UBYTE App_Tc_CompuMethods_CM_TXTenNoYes 1 100 0.0 255.0 MAX_REFRESH 4 1 ECU_ADDRESS 0x528080A6 /end MEASUREMENT
/begin MEASUREMENT MCore_enMWElvKlemmenfreigabe "unsigned integer 8bit" UBYTE App_Tc_CompuMethods_CM_TXTenNotactiveActiveNotinstalled 1 100 0.0 255.0 MAX_REFRESH 4 1 ECU_ADDRESS 0x528080A7 /end MEASUREMENT
/begin MEASUREMENT MCore_enMWElvVerriegelt "unsigned integer 8bit" UBYTE App_Tc_CompuMethods_CM_TXTenNotactiveActiveNotinstalled 1 100 0.0 255.0 MAX_REFRESH 4 1 ECU_ADDRESS 0x528080A8 /end MEASUREMENT
/begin MEASUREMENT MCore_enMWFehlermode2 "unsigned integer 8bit" UBYTE App_Tc_CompuMethods_CM_TXTenNotactiveActive 1 100 0.0 255.0 MAX_REFRESH 4 1 ECU_ADDRESS 0x528080A9 /end MEASUREMENT
/begin MEASUREMENT MCore_enMWFzggeschwSignalzust "unsigned integer 16bit" UWORD App_SpnSen_CompuMethods_CM_TXTenFzggeschwSignalzust 1 100 0.0 65535.0 MAX_REFRESH 4 1 ECU_ADDRESS 0x52808074 /end MEASUREMENT
/begin MEASUREMENT MCore_enMWKlemmenHochschaltenSperren "unsigned integer 8bit" UBYTE App_Tc_CompuMethods_CM_TXTenNotactiveActive 1 100 0.0 255.0 MAX_REFRESH 4 1 ECU_ADDRESS 0x528080AA /end MEASUREMENT
/begin MEASUREMENT MCore_enMWKlemmenfreigabeWfs "unsigned integer 8bit" UBYTE App_Tc_CompuMethods_CM_TXTenNotactiveActive 1 100 0.0 255.0 MAX_REFRESH 4 1 ECU_ADDRESS 0x528080AB /end MEASUREMENT
/begin MEASUREMENT MCore_enMWMotorLaeuft "unsigned integer 8bit" UBYTE App_Tc_CompuMethods_CM_TXTenNotactiveActive 1 100 0.0 255.0 MAX_REFRESH 4 1 ECU_ADDRESS 0x528080AC /end MEASUREMENT
/begin MEASUREMENT MCore_enMWMotorStoppmode "unsigned integer 8bit" UBYTE App_Tc_CompuMethods_CM_TXTenNotactiveActiveTimeout 1 100 0.0 255.0 MAX_REFRESH 4 1 ECU_ADDRESS 0x528080AD /end MEASUREMENT
/begin MEASUREMENT MCore_enMWNotabschaltung "unsigned integer 8bit" UBYTE App_Tc_CompuMethods_CM_TXTenNotactiveActive 1 100 0.0 255.0 MAX_REFRESH 4 1 ECU_ADDRESS 0x528080AE /end MEASUREMENT
/begin MEASUREMENT MCore_enMWSpnAnfKlemme15 "unsigned integer 8bit" UBYTE App_Tc_CompuMethods_CM_TXTenOffOn 1 100 0.0 255.0 MAX_REFRESH 4 1 ECU_ADDRESS 0x528080AF /end MEASUREMENT
/begin MEASUREMENT MCore_enMWSpnAnfKlemme50 "unsigned integer 8bit" UBYTE App_Tc_CompuMethods_CM_TXTenOffOn 1 100 0.0 255.0 MAX_REFRESH 4 1 ECU_ADDRESS 0x528080B0 /end MEASUREMENT
/begin MEASUREMENT MCore_enMWSpnAnfKlemmeS "unsigned integer 8bit" UBYTE App_Tc_CompuMethods_CM_TXTenOffOn 1 100 0.0 255.0 MAX_REFRESH 4 1 ECU_ADDRESS 0x528080B1 /end MEASUREMENT
/begin MEASUREMENT MCore_enMWStartwunsch "unsigned integer 8bit" UBYTE App_Tc_CompuMethods_CM_TXTenNotactiveActive 1 100 0.0 255.0 MAX_REFRESH 4 1 ECU_ADDRESS 0x528080B2 /end MEASUREMENT
/begin MEASUREMENT MCore_enMWVlkAbschaltungKlemme15 "unsigned integer 8bit" UBYTE App_Tc_CompuMethods_CM_TXTenNotactiveActive 1 100 0.0 255.0 MAX_REFRESH 4 1 ECU_ADDRESS 0x528080B3 /end MEASUREMENT
/begin MEASUREMENT MCore_numCounterZat1_INIT "unsigned integer 8bit" UBYTE VW_BCM_CompuMethods_SC_F1_O0_UNoUnit 1 100 0.0 255.0 MAX_REFRESH 4 1 ECU_ADDRESS 0x528080B4 /end MEASUREMENT
/begin MEASUREMENT MCore_numCounterZat2_INIT "unsigned integer 8bit" UBYTE VW_BCM_CompuMethods_SC_F1_O0_UNoUnit 1 100 0.0 255.0 MAX_REFRESH 4 1 ECU_ADDRESS 0x528080B5 /end MEASUREMENT
/begin MEASUREMENT MCore_numMWAnzSchluesselGelernt "unsigned integer 8bit" UBYTE VW_BCM_CompuMethods_SC_F1_O0_UNoUnit 1 100 0.0 8.0 MAX_REFRESH 4 1 ECU_ADDRESS 0x528080B6 /end MEASUREMENT
/begin MEASUREMENT MCore_tMWZeitBisFahrzeugdeakt "unsigned integer 32bit" ULONG VW_BCM_CompuMethods_SC_F1_O0_USec 1 100 0.0 4.294967295E9 MAX_REFRESH 4 1 ECU_ADDRESS 0x52808070 /end MEASUREMENT
/begin MEASUREMENT MCore_tMWZeitKlemme15Diag "unsigned integer 16bit" UWORD VW_BCM_CompuMethods_SC_F1_O0_USec 1 100 0.0 65535.0 MAX_REFRESH 4 1 ECU_ADDRESS 0x52808076 /end MEASUREMENT
/begin MEASUREMENT MCore_vMWFzggeschw "unsigned integer 16bit" UWORD DefaultIdenticalCompu 1 100 0.0 65535.0 MAX_REFRESH 4 1 ECU_ADDRESS 0x52808078 /end MEASUREMENT
/begin MEASUREMENT MCore_bFahrbereitschaft "Boolean" UBYTE Methods_boolean 1 100 0.0 1.0 MAX_REFRESH 4 1 ECU_ADDRESS 0x52800044 /end MEASUREMENT
/begin MEASUREMENT MCore_bKlemme15 "Boolean" UBYTE Methods_boolean 1 100 0.0 1.0 MAX_REFRESH 4 1 ECU_ADDRESS 0x52800045 /end MEASUREMENT
/begin MEASUREMENT MCore_bKlemme15Err "Boolean" UBYTE Methods_boolean 1 100 0.0 1.0 MAX_REFRESH 4 1 ECU_ADDRESS 0x400E3148 /end MEASUREMENT
/begin MEASUREMENT MCore_bKlemme15vFzg "Boolean" UBYTE Methods_boolean 1 100 0.0 1.0 MAX_REFRESH 4 1 ECU_ADDRESS 0x52800046 /end MEASUREMENT
/begin MEASUREMENT MCore_bKlemme15vFzg_S "Boolean" UBYTE Methods_boolean 1 100 0.0 1.0 MAX_REFRESH 4 1 ECU_ADDRESS 0x400E314B /end MEASUREMENT
/begin MEASUREMENT MCore_bKlemme50 "Boolean" UBYTE Methods_boolean 1 100 0.0 1.0 MAX_REFRESH 4 1 ECU_ADDRESS 0x52800047 /end MEASUREMENT
/begin MEASUREMENT MCore_bKlemme505s "Boolean" UBYTE Methods_boolean 1 100 0.0 1.0 MAX_REFRESH 4 1 ECU_ADDRESS 0x52800048 /end MEASUREMENT
/begin MEASUREMENT MCore_bKlemme75 "Boolean" UBYTE Methods_boolean 1 100 0.0 1.0 MAX_REFRESH 4 1 ECU_ADDRESS 0x52800049
 /begin ANNOTATION ANNOTATION_LABEL "Description (coming from AUTOSAR DESC field)" /begin ANNOTATION_TEXT "Current state of Terminal 75X (diagnostics)\r\n" /end ANNOTATION_TEXT /end ANNOTATION
/end MEASUREMENT
/begin MEASUREMENT MCore_bKlemme75ErrTyp "unsigned integer 8bit" UBYTE DefaultIdenticalCompu 1 100 0.0 255.0 MAX_REFRESH 4 1 ECU_ADDRESS 0x400E3149
 /begin ANNOTATION ANNOTATION_LABEL "Description (coming from AUTOSAR DESC field)" /begin ANNOTATION_TEXT "Error bitfield for s_KL_75 signal\r\n" /end ANNOTATION_TEXT /end ANNOTATION
/end MEASUREMENT
/begin MEASUREMENT MCore_bKlemme75a "Boolean" UBYTE Methods_boolean 1 100 0.0 1.0 MAX_REFRESH 4 1 ECU_ADDRESS 0x5280004A /end MEASUREMENT
/begin MEASUREMENT MCore_bKlemme75aErrTyp "unsigned integer 8bit" UBYTE DefaultIdenticalCompu 1 100 0.0 255.0 MAX_REFRESH 4 1 ECU_ADDRESS 0x400E314A
 /begin ANNOTATION ANNOTATION_LABEL "Description (coming from AUTOSAR DESC field)" /begin ANNOTATION_TEXT "Error bitfield for s_KL_75a signal\r\n" /end ANNOTATION_TEXT /end ANNOTATION
/end MEASUREMENT
/begin MEASUREMENT MCore_bKlemme75avFzg "Boolean" UBYTE Methods_boolean 1 100 0.0 1.0 MAX_REFRESH 4 1 ECU_ADDRESS 0x400E314D /end MEASUREMENT
/begin MEASUREMENT MCore_bKlemme75vFzg "Boolean" UBYTE Methods_boolean 1 100 0.0 1.0 MAX_REFRESH 4 1 ECU_ADDRESS 0x400E314C /end MEASUREMENT
/begin MEASUREMENT MCore_bKlemmeS "Boolean" UBYTE Methods_boolean 1 100 0.0 1.0 MAX_REFRESH 4 1 ECU_ADDRESS 0x5280004B /end MEASUREMENT
/begin MEASUREMENT MCore_bKlemmeSErr "Boolean" UBYTE Methods_boolean 1 100 0.0 1.0 MAX_REFRESH 4 1 ECU_ADDRESS 0x5280004C /end MEASUREMENT
/begin MEASUREMENT MCore_bKlemmeStartwunsch "Boolean" UBYTE Methods_boolean 1 100 0.0 1.0 MAX_REFRESH 4 1 ECU_ADDRESS 0x5280004D /end MEASUREMENT
/begin MEASUREMENT MCore_bKstWarnP2Zstdef "Boolean" UBYTE Methods_boolean 1 100 0.0 1.0 MAX_REFRESH 4 1 ECU_ADDRESS 0x400E314E /end MEASUREMENT
/begin MEASUREMENT MCore_enKSTZuendungswarnung "unsigned integer 8bit" UBYTE VW_BCM_CompuMethods_CM_TXTenKSTZuendungswarnung 1 100 0.0 255.0 MAX_REFRESH 4 1 ECU_ADDRESS 0x400E314F
 /begin ANNOTATION ANNOTATION_LABEL "Description (coming from AUTOSAR DESC field)" /begin ANNOTATION_TEXT "Communication state of PDU Motor_26\r\n" /end ANNOTATION_TEXT /end ANNOTATION
/end MEASUREMENT
/begin MEASUREMENT MCore_enAnfKlemme15Sz "unsigned integer 8bit" UBYTE VW_BCM_CompuMethods_CM_TXTenAnfKlemme15Sz 1 100 0.0 255.0 MAX_REFRESH 4 1 ECU_ADDRESS 0x528081A5 /end MEASUREMENT
/begin MEASUREMENT MCore_enKSTSonderzustandAnforderung "unsigned integer 8bit" UBYTE VW_BCM_CompuMethods_CM_TXTenKSTSonderzustandAnforderung 1 100 0.0 255.0 MAX_REFRESH 4 1 ECU_ADDRESS 0x5280004E /end MEASUREMENT
/begin MEASUREMENT MCore_enKSTSonderzustandStatus "unsigned integer 8bit" UBYTE VW_BCM_CompuMethods_CM_TXTenKSTSonderzustandStatus 1 100 0.0 255.0 MAX_REFRESH 4 1 ECU_ADDRESS 0x5280004F /end MEASUREMENT
/begin MEASUREMENT MCore_enKSTWFSFahrfreigabeAnforderung "unsigned integer 8bit" UBYTE VW_BCM_CompuMethods_CM_TXTenKSTWFSFahrfreigabeAnforderung 1 100 0.0 255.0 MAX_REFRESH 4 1 ECU_ADDRESS 0x52800050 /end MEASUREMENT
/begin MEASUREMENT MCore_Unconnected_enComUserRequestReasonTc "unsigned integer 8bit" UBYTE VW_BCM_CompuMethods_CM_TXTenComUserRequestReasonTc 1 100 0.0 255.0 MAX_REFRESH 4 1 ECU_ADDRESS 0x400E3150 /end MEASUREMENT
/begin MEASUREMENT MCore_Tc_bKlemmenFehlerAusgeben_COV "Boolean" UBYTE Methods_boolean 1 100 0.0 1.0 MAX_REFRESH 4 1 ECU_ADDRESS 0x5280D358 /end MEASUREMENT
/begin MEASUREMENT MCore_Tc_bZasWfsAktiv_COV "Boolean" UBYTE Methods_boolean 1 100 0.0 1.0 MAX_REFRESH 4 1 ECU_ADDRESS 0x5280D359 /end MEASUREMENT
/begin MEASUREMENT MCore_Tc_enZuendungAktivMeldung_COV "unsigned integer 8bit" UBYTE VW_BCM_CompuMethods_SC_F1_O0_UNoUnit 1 100 0.0 2.0 MAX_REFRESH 4 1 ECU_ADDRESS 0x5280D35A /end MEASUREMENT
/begin MEASUREMENT MCore_ZV_bKessyAktiv_COV_0 "Boolean" UBYTE Methods_boolean 1 100 0.0 1.0 MAX_REFRESH 4 1 ECU_ADDRESS 0x5280D35B /end MEASUREMENT
/begin MEASUREMENT MCore_Tc_tAusrollEnde_AV "unsigned integer 8bit" UBYTE App_Tc_CompuMethods_SC_F0pt1_O0_USec 1 100 0.0 25.5 MAX_REFRESH 4 1 ECU_ADDRESS 0x5280D35C /end MEASUREMENT
/begin MEASUREMENT MCore_bKSTUnterdrZuendungsmeldung "Boolean" UBYTE Methods_boolean 1 100 0.0 1.0 MAX_REFRESH 4 1 ECU_ADDRESS 0x5280D35E /end MEASUREMENT
/begin MEASUREMENT MCore_enELV01ErrSt_0 "unsigned integer 8bit" UBYTE VW_BCM_CompuMethods_CM_TXTenErrStatus 1 100 0.0 255.0 MAX_REFRESH 4 1 ECU_ADDRESS 0x5280D35F
 /begin ANNOTATION ANNOTATION_LABEL "Description (coming from AUTOSAR DESC field)" /begin ANNOTATION_TEXT "Communication state of PDU ELV_01\r\n" /end ANNOTATION_TEXT /end ANNOTATION
/end MEASUREMENT
/begin MEASUREMENT MCore_StESPErrTyp_0 "unsigned integer 8bit" UBYTE DefaultIdenticalCompu 1 100 0.0 255.0 MAX_REFRESH 4 1 ECU_ADDRESS 0x5280D360
 /begin ANNOTATION ANNOTATION_LABEL "Description (coming from AUTOSAR DESC field)" /begin ANNOTATION_TEXT "Error bitfield for ESP_21 message\r\n" /end ANNOTATION_TEXT /end ANNOTATION
/end MEASUREMENT
/begin MEASUREMENT MCore_bFzgGeschwQBitErr_0 "Boolean" UBYTE Methods_boolean 1 100 0.0 1.0 MAX_REFRESH 4 1 ECU_ADDRESS 0x400E39B4 /end MEASUREMENT
/begin MEASUREMENT MCore_enESCvSigQualifizierung_0 "unsigned integer 8bit" UBYTE VW_BCM_CompuMethods_CM_TXTenESCvSigQualifizierung 1 100 0.0 255.0 MAX_REFRESH 4 1 ECU_ADDRESS 0x400E39B5 /end MEASUREMENT
/begin MEASUREMENT MCore_envFzgErrSt_0 "unsigned integer 8bit" UBYTE VW_BCM_CompuMethods_CM_TXTenErrStatus 1 100 0.0 255.0 MAX_REFRESH 4 1 ECU_ADDRESS 0x400E39B6 /end MEASUREMENT
/begin MEASUREMENT MCore_vFzg_0 "unsigned integer 16bit" UWORD DefaultIdenticalCompu 1 100 0.0 65535.0 MAX_REFRESH 4 1 ECU_ADDRESS 0x1223B04 /end MEASUREMENT
/begin MEASUREMENT MCore_envFzgErrSt_1 "unsigned integer 8bit" UBYTE VW_BCM_CompuMethods_CM_TXTenErrStatus 1 100 0.0 255.0 MAX_REFRESH 4 1 ECU_ADDRESS 0x400E39B7 /end MEASUREMENT
/begin MEASUREMENT MCore_bStFTOffen_0 "Boolean" UBYTE Methods_boolean 1 100 0.0 1.0 MAX_REFRESH 4 1 ECU_ADDRESS 0x5280D361 /end MEASUREMENT
/begin MEASUREMENT MCore_bUnterdrZuendungsmeldung "Boolean" UBYTE Methods_boolean 1 100 0.0 1.0 MAX_REFRESH 4 1 ECU_ADDRESS 0x5280D362 /end MEASUREMENT
/begin MEASUREMENT MCore_bMOKl50_2 "Boolean" UBYTE Methods_boolean 1 100 0.0 1.0 MAX_REFRESH 4 1 ECU_ADDRESS 0x5280D363 /end MEASUREMENT
/begin MEASUREMENT MCore_bMoHybFahrbereitschaft_1 "Boolean" UBYTE Methods_boolean 1 100 0.0 1.0 MAX_REFRESH 4 1 ECU_ADDRESS 0x5280D364
 /begin ANNOTATION ANNOTATION_LABEL "Description (coming from AUTOSAR DESC field)" /begin ANNOTATION_TEXT "Motor hybrid driving\r\n" /end ANNOTATION_TEXT /end ANNOTATION
/end MEASUREMENT
/begin MEASUREMENT MCore_bMoTextMotorstart "unsigned integer 8bit" UBYTE VW_BCM_CompuMethods_SC_F1_O0_UNoUnit 1 100 0.0 15.0 MAX_REFRESH 4 1 ECU_ADDRESS 0x5280D365 /end MEASUREMENT
/begin MEASUREMENT MCore_bMotor14MoKl75Can "Boolean" UBYTE Methods_boolean 1 100 0.0 1.0 MAX_REFRESH 4 1 ECU_ADDRESS 0x5280D366
 /begin ANNOTATION ANNOTATION_LABEL "Description (coming from AUTOSAR DESC field)" /begin ANNOTATION_TEXT "Klemme 75 received on KCAN.\r\n" /end ANNOTATION_TEXT /end ANNOTATION
/end MEASUREMENT
/begin MEASUREMENT MCore_bMotorLaeuft_0 "Boolean" UBYTE Methods_boolean 1 100 0.0 1.0 MAX_REFRESH 4 1 ECU_ADDRESS 0x5280D367 /end MEASUREMENT
/begin MEASUREMENT MCore_bMotorStoppAktivSSF_0 "Boolean" UBYTE Methods_boolean 1 100 0.0 1.0 MAX_REFRESH 4 1 ECU_ADDRESS 0x5280D368 /end MEASUREMENT
/begin MEASUREMENT MCore_bMotorStoppWiederstartSSF_0 "Boolean" UBYTE Methods_boolean 1 100 0.0 1.0 MAX_REFRESH 4 1 ECU_ADDRESS 0x5280D369 /end MEASUREMENT
/begin MEASUREMENT MCore_enMotor14ErrSt_0 "unsigned integer 8bit" UBYTE VW_BCM_CompuMethods_CM_TXTenErrStatus 1 100 0.0 255.0 MAX_REFRESH 4 1 ECU_ADDRESS 0x5280D36A
 /begin ANNOTATION ANNOTATION_LABEL "Description (coming from AUTOSAR DESC field)" /begin ANNOTATION_TEXT "Communication state of PDU Motor_14\r\n" /end ANNOTATION_TEXT /end ANNOTATION
/end MEASUREMENT
/begin MEASUREMENT MCore_enMotor26ErrSt "unsigned integer 8bit" UBYTE VW_BCM_CompuMethods_CM_TXTenErrStatus 1 100 0.0 255.0 MAX_REFRESH 4 1 ECU_ADDRESS 0x5280D36B
 /begin ANNOTATION ANNOTATION_LABEL "Description (coming from AUTOSAR DESC field)" /begin ANNOTATION_TEXT "Communication state of PDU Motor_26\r\n" /end ANNOTATION_TEXT /end ANNOTATION
/end MEASUREMENT
/begin MEASUREMENT MCore_bStPmodeKlemme15 "Boolean" UBYTE Methods_boolean 1 100 0.0 1.0 MAX_REFRESH 4 1 ECU_ADDRESS 0x5280D36C /end MEASUREMENT
/begin MEASUREMENT MCore_bPMode_0 "Boolean" UBYTE Methods_boolean 1 100 0.0 1.0 MAX_REFRESH 4 1 ECU_ADDRESS 0x5280D36D /end MEASUREMENT
/begin MEASUREMENT MCore_bAnfKlemme15_0 "Boolean" UBYTE Methods_boolean 1 100 0.0 1.0 MAX_REFRESH 4 1 ECU_ADDRESS 0x5280D36E /end MEASUREMENT
/begin MEASUREMENT MCore_bAnfKlemmeS_0 "Boolean" UBYTE Methods_boolean 1 100 0.0 1.0 MAX_REFRESH 4 1 ECU_ADDRESS 0x5280D36F /end MEASUREMENT
/begin MEASUREMENT MCore_bAnfKlemmeStartwunsch_0 "Boolean" UBYTE Methods_boolean 1 100 0.0 1.0 MAX_REFRESH 4 1 ECU_ADDRESS 0x5280D370 /end MEASUREMENT
/begin MEASUREMENT MCore_bAnfKlemmenfreigabeELV_0 "Boolean" UBYTE Methods_boolean 1 100 0.0 1.0 MAX_REFRESH 4 1 ECU_ADDRESS 0x5280D371 /end MEASUREMENT
/begin MEASUREMENT MCore_bEspWecken_0 "Boolean" UBYTE Methods_boolean 1 100 0.0 1.0 MAX_REFRESH 4 1 ECU_ADDRESS 0x5280D372 /end MEASUREMENT
/begin MEASUREMENT MCore_bKlemmenfreigabeWFSintern_0 "Boolean" UBYTE Methods_boolean 1 100 0.0 1.0 MAX_REFRESH 4 1 ECU_ADDRESS 0x5280D373 /end MEASUREMENT
/begin MEASUREMENT MCore_bMotorLaeuft_1 "Boolean" UBYTE Methods_boolean 1 100 0.0 1.0 MAX_REFRESH 4 1 ECU_ADDRESS 0x5280D374 /end MEASUREMENT
/begin MEASUREMENT MCore_bZATbetaetigt_0 "Boolean" UBYTE Methods_boolean 1 100 0.0 1.0 MAX_REFRESH 4 1 ECU_ADDRESS 0x5280D375 /end MEASUREMENT
/begin MEASUREMENT MCore_Unconnected_MajorVersion_0 "" UBYTE VW_BCM_CompuMethods_SC_F1_O0_UNoUnit 1 100 0.0 255.0 ARRAY_SIZE 4 ECU_ADDRESS 0x400D8C94 /end MEASUREMENT
/begin MEASUREMENT MCore_Unconnected_MinorVersion_0 "" UBYTE VW_BCM_CompuMethods_SC_F1_O0_UNoUnit 1 100 0.0 255.0 ARRAY_SIZE 4 ECU_ADDRESS 0x400D8C98 /end MEASUREMENT
/begin MEASUREMENT MCore_Unconnected_PatchVersion_0 "" UBYTE VW_BCM_CompuMethods_SC_F1_O0_UNoUnit 1 100 0.0 255.0 ARRAY_SIZE 4 ECU_ADDRESS 0x400D8C9C /end MEASUREMENT
/begin MEASUREMENT MCore_Unconnected_SwcoNumber_0 "" UBYTE VW_BCM_CompuMethods_SC_F1_O0_UNoUnit 1 100 0.0 255.0 ARRAY_SIZE 8 ECU_ADDRESS 0x400E2C20 /end MEASUREMENT
/begin MEASUREMENT MCore_Unconnected_SwcoSysName_0 "" UBYTE VW_BCM_CompuMethods_SC_F1_O0_UNoUnit 1 100 0.0 255.0 ARRAY_SIZE 13 ECU_ADDRESS 0x400D914B /end MEASUREMENT
/begin MEASUREMENT MCore_Unconnected_VendorID_0 "" UBYTE VW_BCM_CompuMethods_SC_F1_O0_UNoUnit 1 100 0.0 255.0 ARRAY_SIZE 2 ECU_ADDRESS 0x400E2F36 /end MEASUREMENT
/begin MEASUREMENT MCore_Unconnected_VwSparePartNumber_0 "" UBYTE VW_BCM_CompuMethods_SC_F1_O0_UNoUnit 1 100 0.0 255.0 ARRAY_SIZE 11 ECU_ADDRESS 0x400D9158 /end MEASUREMENT
/begin MEASUREMENT MCore_PIM_NIR_TcKlemmenstatus.numKlemmeSZasEingang "" UBYTE App_Tc_CompuMethods_CM_TXTenKlemmenstatusNir 1 100 0.0 255.0 ECU_ADDRESS 0x400E2E90 /end MEASUREMENT
/begin MEASUREMENT MCore_PIM_NIR_TcKlemmenstatus.numKlemmeSZasEingangInv "" UBYTE App_Tc_CompuMethods_CM_TXTenKlemmenstatusNir 1 100 0.0 255.0 ECU_ADDRESS 0x400E2E91 /end MEASUREMENT
/begin MEASUREMENT MCore_PIM_NIR_TcKlemmenstatus.numKlemmeSZas "" UBYTE App_Tc_CompuMethods_CM_TXTenKlemmenstatusNir 1 100 0.0 255.0 ECU_ADDRESS 0x400E2E92 /end MEASUREMENT
/begin MEASUREMENT MCore_PIM_NIR_TcKlemmenstatus.numKlemmeSZasInv "" UBYTE App_Tc_CompuMethods_CM_TXTenKlemmenstatusNir 1 100 0.0 255.0 ECU_ADDRESS 0x400E2E93 /end MEASUREMENT
/begin MEASUREMENT MCore_PIM_NIR_TcKlemmenstatus.numKlemme15Zas "" UBYTE App_Tc_CompuMethods_CM_TXTenKlemmenstatusNir 1 100 0.0 255.0 ECU_ADDRESS 0x400E2E94 /end MEASUREMENT
/begin MEASUREMENT MCore_PIM_NIR_TcKlemmenstatus.numKlemme15ZasInv "" UBYTE App_Tc_CompuMethods_CM_TXTenKlemmenstatusNir 1 100 0.0 255.0 ECU_ADDRESS 0x400E2E95 /end MEASUREMENT
/begin MEASUREMENT MCore_PIM_NIR_TcKlemmenstatus.numKlemmeStartwunschZas "" UBYTE App_Tc_CompuMethods_CM_TXTenKlemmenstatusNir 1 100 0.0 255.0 ECU_ADDRESS 0x400E2E96 /end MEASUREMENT
/begin MEASUREMENT MCore_PIM_NIR_TcKlemmenstatus.numKlemmeStartwunschZasInv "" UBYTE App_Tc_CompuMethods_CM_TXTenKlemmenstatusNir 1 100 0.0 255.0 ECU_ADDRESS 0x400E2E97 /end MEASUREMENT
/begin MEASUREMENT MCore_PIM_NIR_TcKlemmenstatus.numKlemmenfreigabeWfs "" UBYTE App_Tc_CompuMethods_CM_TXTenKlemmenstatusNir 1 100 0.0 255.0 ECU_ADDRESS 0x400E2E98 /end MEASUREMENT
/begin MEASUREMENT MCore_PIM_NIR_TcKlemmenstatus.numKlemmenfreigabeWfsInv "" UBYTE App_Tc_CompuMethods_CM_TXTenKlemmenstatusNir 1 100 0.0 255.0 ECU_ADDRESS 0x400E2E99 /end MEASUREMENT
/begin MEASUREMENT MCore_bKlemme15Zas_INIT "Boolean" UBYTE Methods_boolean 1 100 0.0 1.0 MAX_REFRESH 4 1 ECU_ADDRESS 0x528080CA /end MEASUREMENT
/begin MEASUREMENT MCore_bKlemmeSZasEingang_INIT "Boolean" UBYTE Methods_boolean 1 100 0.0 1.0 MAX_REFRESH 4 1 ECU_ADDRESS 0x528080CB /end MEASUREMENT
/begin MEASUREMENT MCore_CPT_Tc_bKlemmeSZas_INIT "Boolean" UBYTE Methods_boolean 1 100 0.0 1.0 MAX_REFRESH 4 1 ECU_ADDRESS 0x528080CC /end MEASUREMENT
/begin MEASUREMENT MCore_CPT_Tc_bKlemmeStartwunschZas_INIT "Boolean" UBYTE Methods_boolean 1 100 0.0 1.0 MAX_REFRESH 4 1 ECU_ADDRESS 0x528080CD /end MEASUREMENT
/begin MEASUREMENT MCore_bKlemmenfreigabeWfs_INIT "Boolean" UBYTE Methods_boolean 1 100 0.0 1.0 MAX_REFRESH 4 1 ECU_ADDRESS 0x528080CE /end MEASUREMENT
/begin MEASUREMENT MCore_bKl15 "Boolean" UBYTE Methods_boolean 1 100 0.0 1.0 MAX_REFRESH 4 1 ECU_ADDRESS 0x528081A6 /end MEASUREMENT
/begin MEASUREMENT MCore_bKl15Ffb "Boolean" UBYTE Methods_boolean 1 100 0.0 1.0 MAX_REFRESH 4 1 ECU_ADDRESS 0x52800051 /end MEASUREMENT
/begin MEASUREMENT MCore_bKlStartwunschSig "Boolean" UBYTE Methods_boolean 1 100 0.0 1.0 MAX_REFRESH 4 1 ECU_ADDRESS 0x528081A7 /end MEASUREMENT
/begin MEASUREMENT MCore_Unconnected_bKlemme15_0 "Boolean" UBYTE Methods_boolean 1 100 0.0 1.0 MAX_REFRESH 4 1 ECU_ADDRESS 0x400E3153 /end MEASUREMENT
/begin MEASUREMENT MCore_Unconnected_bKlemmeX "Boolean" UBYTE Methods_boolean 1 100 0.0 1.0 MAX_REFRESH 4 1 ECU_ADDRESS 0x400E3156 /end MEASUREMENT
/begin MEASUREMENT MCore_Unconnected_bKstAnfKlemme50 "Boolean" UBYTE Methods_boolean 1 100 0.0 1.0 MAX_REFRESH 4 1 ECU_ADDRESS 0x400E3154 /end MEASUREMENT
/begin MEASUREMENT MCore_Unconnected_bZasKlemme15 "Boolean" UBYTE Methods_boolean 1 100 0.0 1.0 MAX_REFRESH 4 1 ECU_ADDRESS 0x400E3152 /end MEASUREMENT
/begin MEASUREMENT MCore_Unconnected_bZasKlemmeS "Boolean" UBYTE Methods_boolean 1 100 0.0 1.0 MAX_REFRESH 4 1 ECU_ADDRESS 0x400E3151 /end MEASUREMENT
/begin MEASUREMENT MCore_Unconnected_bZasKlemmeX "Boolean" UBYTE Methods_boolean 1 100 0.0 1.0 MAX_REFRESH 4 1 ECU_ADDRESS 0x400E3155 /end MEASUREMENT
/begin MEASUREMENT MCore_Unconnected_MajorVersion_1 "" UBYTE VW_BCM_CompuMethods_SC_F1_O0_UNoUnit 1 100 0.0 255.0 ARRAY_SIZE 4 ECU_ADDRESS 0x400D8CA0 /end MEASUREMENT
/begin MEASUREMENT MCore_Unconnected_MinorVersion_1 "" UBYTE VW_BCM_CompuMethods_SC_F1_O0_UNoUnit 1 100 0.0 255.0 ARRAY_SIZE 4 ECU_ADDRESS 0x400D8CA4 /end MEASUREMENT
/begin MEASUREMENT MCore_Unconnected_PatchVersion_1 "" UBYTE VW_BCM_CompuMethods_SC_F1_O0_UNoUnit 1 100 0.0 255.0 ARRAY_SIZE 4 ECU_ADDRESS 0x400D8CA8 /end MEASUREMENT
/begin MEASUREMENT MCore_Unconnected_SwcoNumber_1 "" UBYTE VW_BCM_CompuMethods_SC_F1_O0_UNoUnit 1 100 0.0 255.0 ARRAY_SIZE 8 ECU_ADDRESS 0x400E2C28 /end MEASUREMENT
/begin MEASUREMENT MCore_Unconnected_SwcoSysName_1 "" UBYTE VW_BCM_CompuMethods_SC_F1_O0_UNoUnit 1 100 0.0 255.0 ARRAY_SIZE 13 ECU_ADDRESS 0x400D9163 /end MEASUREMENT
/begin MEASUREMENT MCore_Unconnected_VendorID_1 "" UBYTE VW_BCM_CompuMethods_SC_F1_O0_UNoUnit 1 100 0.0 255.0 ARRAY_SIZE 2 ECU_ADDRESS 0x400E2F38 /end MEASUREMENT
/begin MEASUREMENT MCore_Unconnected_VwSparePartNumber_1 "" UBYTE VW_BCM_CompuMethods_SC_F1_O0_UNoUnit 1 100 0.0 255.0 ARRAY_SIZE 11 ECU_ADDRESS 0x400D9170 /end MEASUREMENT
/begin MEASUREMENT MCore_enMWKlemme15_CAN "unsigned integer 8bit" UBYTE App_Tc_CompuMethods_CM_TXTenNotactiveActive 1 100 0.0 255.0 MAX_REFRESH 4 1 ECU_ADDRESS 0x528080B7 /end MEASUREMENT
/begin MEASUREMENT MCore_enMWKlemme15_HW "unsigned integer 8bit" UBYTE App_Tc_CompuMethods_CM_TXTenNotactiveActive 1 100 0.0 255.0 MAX_REFRESH 4 1 ECU_ADDRESS 0x528080B8 /end MEASUREMENT
/begin MEASUREMENT MCore_enMWKlemmeS_CAN "unsigned integer 8bit" UBYTE App_Tc_CompuMethods_CM_TXTenNotactiveActive 1 100 0.0 255.0 MAX_REFRESH 4 1 ECU_ADDRESS 0x528080B9 /end MEASUREMENT
/begin MEASUREMENT MCore_enMWKlemmeStartwunsch_CAN "unsigned integer 8bit" UBYTE App_Tc_CompuMethods_CM_TXTenNotactiveActive 1 100 0.0 255.0 MAX_REFRESH 4 1 ECU_ADDRESS 0x528080BA /end MEASUREMENT
/begin MEASUREMENT MCore_enMWKlemmeStartwunsch_HW "unsigned integer 8bit" UBYTE App_Tc_CompuMethods_CM_TXTenNotactiveActive 1 100 0.0 255.0 MAX_REFRESH 4 1 ECU_ADDRESS 0x528080BB /end MEASUREMENT
/begin MEASUREMENT MCore_bKlemme151Err "Boolean" UBYTE Methods_boolean 1 100 0.0 1.0 MAX_REFRESH 4 1 ECU_ADDRESS 0x52800052 /end MEASUREMENT
/begin MEASUREMENT MCore_bKlemme152Err "Boolean" UBYTE Methods_boolean 1 100 0.0 1.0 MAX_REFRESH 4 1 ECU_ADDRESS 0x52800053 /end MEASUREMENT
/begin MEASUREMENT MCore_bKlemme15zas "Boolean" UBYTE Methods_boolean 1 100 0.0 1.0 MAX_REFRESH 4 1 ECU_ADDRESS 0x528081A8 /end MEASUREMENT
/begin MEASUREMENT MCore_bKlemmeSErr_0 "Boolean" UBYTE Methods_boolean 1 100 0.0 1.0 MAX_REFRESH 4 1 ECU_ADDRESS 0x52800054 /end MEASUREMENT
/begin MEASUREMENT MCore_bKlemmeStartwunsch_0 "Boolean" UBYTE Methods_boolean 1 100 0.0 1.0 MAX_REFRESH 4 1 ECU_ADDRESS 0x52800055 /end MEASUREMENT
/begin MEASUREMENT MCore_bKlemmeSzas "Boolean" UBYTE Methods_boolean 1 100 0.0 1.0 MAX_REFRESH 4 1 ECU_ADDRESS 0x52800056 /end MEASUREMENT
/begin MEASUREMENT MCore_ZV_bKessyAktiv_COV_1 "Boolean" UBYTE Methods_boolean 1 100 0.0 1.0 MAX_REFRESH 4 1 ECU_ADDRESS 0x5280D376 /end MEASUREMENT
/begin MEASUREMENT MCore_Spn_tZatEntprellung_AV_0 "unsigned integer 8bit" UBYTE App_SpnSen_CompuMethods_SC_F5_O0_Ums 1 100 0.0 100.0 MAX_REFRESH 4 1 ECU_ADDRESS 0x5280D377 /end MEASUREMENT
/begin MEASUREMENT MCore_Tc_tDiagnoseverbotNachStart_AV "unsigned integer 8bit" UBYTE VW_BCM_CompuMethods_SC_F1_O0_USec 1 100 0.0 255.0 MAX_REFRESH 4 1 ECU_ADDRESS 0x5280D378 /end MEASUREMENT
/begin MEASUREMENT MCore_Tc_tKlemme15Entprellung_AV "unsigned integer 8bit" UBYTE App_Tc_CompuMethods_SC_F10_O0_Ums 1 100 0.0 2550.0 MAX_REFRESH 4 1 ECU_ADDRESS 0x5280D379 /end MEASUREMENT
/begin MEASUREMENT MCore_Tc_tKlemmeSEntprellung_AV "unsigned integer 8bit" UBYTE App_Tc_CompuMethods_SC_F10_O0_Ums 1 100 0.0 2550.0 MAX_REFRESH 4 1 ECU_ADDRESS 0x5280D37A /end MEASUREMENT
/begin MEASUREMENT MCore_bFFBAnfZVVerr "Boolean" UBYTE Methods_boolean 1 100 0.0 1.0 MAX_REFRESH 4 1 ECU_ADDRESS 0x5280D37B /end MEASUREMENT
/begin MEASUREMENT MCore_bStFTOffen_1 "Boolean" UBYTE Methods_boolean 1 100 0.0 1.0 MAX_REFRESH 4 1 ECU_ADDRESS 0x5280D37C /end MEASUREMENT
/begin MEASUREMENT MCore_numWFSSchluesselFahrberecht "unsigned integer 8bit" UBYTE VW_BCM_CompuMethods_SC_F1_O0_UNoUnit 1 100 0.0 15.0 MAX_REFRESH 4 1 ECU_ADDRESS 0x5280D37D /end MEASUREMENT
/begin MEASUREMENT MCore_Unconnected_MajorVersion_2 "" UBYTE VW_BCM_CompuMethods_SC_F1_O0_UNoUnit 1 100 0.0 255.0 ARRAY_SIZE 4 ECU_ADDRESS 0x400D8CAC /end MEASUREMENT
/begin MEASUREMENT MCore_Unconnected_MinorVersion_2 "" UBYTE VW_BCM_CompuMethods_SC_F1_O0_UNoUnit 1 100 0.0 255.0 ARRAY_SIZE 4 ECU_ADDRESS 0x400D8CB0 /end MEASUREMENT
/begin MEASUREMENT MCore_Unconnected_PatchVersion_2 "" UBYTE VW_BCM_CompuMethods_SC_F1_O0_UNoUnit 1 100 0.0 255.0 ARRAY_SIZE 4 ECU_ADDRESS 0x400D8CB4 /end MEASUREMENT
/begin MEASUREMENT MCore_Unconnected_SwcoNumber_2 "" UBYTE VW_BCM_CompuMethods_SC_F1_O0_UNoUnit 1 100 0.0 255.0 ARRAY_SIZE 8 ECU_ADDRESS 0x400E2C30 /end MEASUREMENT
/begin MEASUREMENT MCore_Unconnected_SwcoSysName_2 "" UBYTE VW_BCM_CompuMethods_SC_F1_O0_UNoUnit 1 100 0.0 255.0 ARRAY_SIZE 13 ECU_ADDRESS 0x400D917B /end MEASUREMENT
/begin MEASUREMENT MCore_Unconnected_VendorID_2 "" UBYTE VW_BCM_CompuMethods_SC_F1_O0_UNoUnit 1 100 0.0 255.0 ARRAY_SIZE 2 ECU_ADDRESS 0x400E2F3A /end MEASUREMENT
/begin MEASUREMENT MCore_Unconnected_VwSparePartNumber_2 "" UBYTE VW_BCM_CompuMethods_SC_F1_O0_UNoUnit 1 100 0.0 255.0 ARRAY_SIZE 11 ECU_ADDRESS 0x400D9188 /end MEASUREMENT
/begin MEASUREMENT MCore_PIM_NIR_TcSenKlemmenstatus.numKlemmeSZas "" UBYTE App_Tc_CompuMethods_CM_TXTenKlemmenstatusNir 1 100 0.0 255.0 ECU_ADDRESS 0x400D8A60 /end MEASUREMENT
/begin MEASUREMENT MCore_PIM_NIR_TcSenKlemmenstatus.numKlemmeSZasInv "" UBYTE App_Tc_CompuMethods_CM_TXTenKlemmenstatusNir 1 100 0.0 255.0 ECU_ADDRESS 0x400D8A61 /end MEASUREMENT
/begin MEASUREMENT MCore_PIM_NIR_TcSenKlemmenstatus.numKlemme151Zas "" UBYTE App_Tc_CompuMethods_CM_TXTenKlemmenstatusNir 1 100 0.0 255.0 ECU_ADDRESS 0x400D8A62 /end MEASUREMENT
/begin MEASUREMENT MCore_PIM_NIR_TcSenKlemmenstatus.numKlemme151ZasInv "" UBYTE App_Tc_CompuMethods_CM_TXTenKlemmenstatusNir 1 100 0.0 255.0 ECU_ADDRESS 0x400D8A63 /end MEASUREMENT
/begin MEASUREMENT MCore_PIM_NIR_TcSenKlemmenstatus.numKlemme152Zas "" UBYTE App_Tc_CompuMethods_CM_TXTenKlemmenstatusNir 1 100 0.0 255.0 ECU_ADDRESS 0x400D8A64 /end MEASUREMENT
/begin MEASUREMENT MCore_PIM_NIR_TcSenKlemmenstatus.numKlemme152ZasInv "" UBYTE App_Tc_CompuMethods_CM_TXTenKlemmenstatusNir 1 100 0.0 255.0 ECU_ADDRESS 0x400D8A65 /end MEASUREMENT
/begin MEASUREMENT MCore_PIM_NIR_TcSenKlemmenstatus.numKlemmeStartwunschZas "" UBYTE App_Tc_CompuMethods_CM_TXTenKlemmenstatusNir 1 100 0.0 255.0 ECU_ADDRESS 0x400D8A66 /end MEASUREMENT
/begin MEASUREMENT MCore_PIM_NIR_TcSenKlemmenstatus.numKlemmeStartwunschZasInv "" UBYTE App_Tc_CompuMethods_CM_TXTenKlemmenstatusNir 1 100 0.0 255.0 ECU_ADDRESS 0x400D8A67 /end MEASUREMENT
/begin MEASUREMENT MCore_bKlemme151Zas_INIT "Boolean" UBYTE Methods_boolean 1 100 0.0 1.0 MAX_REFRESH 4 1 ECU_ADDRESS 0x528080BC /end MEASUREMENT
/begin MEASUREMENT MCore_bKlemme152Zas_INIT "Boolean" UBYTE Methods_boolean 1 100 0.0 1.0 MAX_REFRESH 4 1 ECU_ADDRESS 0x528080BD /end MEASUREMENT
/begin MEASUREMENT MCore_CPT_TcSen_bKlemmeSZas_INIT "Boolean" UBYTE Methods_boolean 1 100 0.0 1.0 MAX_REFRESH 4 1 ECU_ADDRESS 0x528080BE /end MEASUREMENT
/begin MEASUREMENT MCore_CPT_TcSen_bKlemmeStartwunschZas_INIT "Boolean" UBYTE Methods_boolean 1 100 0.0 1.0 MAX_REFRESH 4 1 ECU_ADDRESS 0x528080BF /end MEASUREMENT
/begin MEASUREMENT MCore_CPT_TcSen_bNoIniRamValid_INIT "Boolean" UBYTE Methods_boolean 1 100 0.0 1.0 MAX_REFRESH 4 1 ECU_ADDRESS 0x528080C0 /end MEASUREMENT
/begin MEASUREMENT MCore_enMWFehlerzustandZAS "unsigned integer 8bit" UBYTE App_Tc_CompuMethods_CM_TXTenFehlerzustandZAS 1 100 0.0 255.0 MAX_REFRESH 4 1 ECU_ADDRESS 0x528080C1 /end MEASUREMENT
/begin MEASUREMENT MCore_enMWKlemme15_1_ZAS "unsigned integer 8bit" UBYTE App_Tc_CompuMethods_CM_TXTenNotactiveActiveNotinstalled 1 100 0.0 255.0 MAX_REFRESH 4 1 ECU_ADDRESS 0x528080C2 /end MEASUREMENT
/begin MEASUREMENT MCore_enMWKlemme15_2_ZAS "unsigned integer 8bit" UBYTE App_Tc_CompuMethods_CM_TXTenNotactiveActiveNotinstalled 1 100 0.0 255.0 MAX_REFRESH 4 1 ECU_ADDRESS 0x528080C3 /end MEASUREMENT
/begin MEASUREMENT MCore_enMWKlemme50 "unsigned integer 8bit" UBYTE App_Tc_CompuMethods_CM_TXTenNotactiveActive 1 100 0.0 255.0 MAX_REFRESH 4 1 ECU_ADDRESS 0x528080C4 /end MEASUREMENT
/begin MEASUREMENT MCore_enMWKlemme75 "unsigned integer 8bit" UBYTE App_Tc_CompuMethods_CM_TXTenNotactiveActive 1 100 0.0 255.0 MAX_REFRESH 4 1 ECU_ADDRESS 0x528080C5 /end MEASUREMENT
/begin MEASUREMENT MCore_enMWKlemmeS_ZAS "unsigned integer 8bit" UBYTE App_Tc_CompuMethods_CM_TXTenNotactiveActiveNotinstalled 1 100 0.0 255.0 MAX_REFRESH 4 1 ECU_ADDRESS 0x528080C6 /end MEASUREMENT
/begin MEASUREMENT MCore_enMWKlemmeStartwunsch_ZAS "unsigned integer 8bit" UBYTE App_Tc_CompuMethods_CM_TXTenNotactiveActiveNotinstalled 1 100 0.0 255.0 MAX_REFRESH 4 1 ECU_ADDRESS 0x528080C7 /end MEASUREMENT
/begin MEASUREMENT MCore_enMWTaster_ZAT1 "unsigned integer 8bit" UBYTE App_Tc_CompuMethods_CM_TXTenNotactiveActiveNotinstalled 1 100 0.0 255.0 MAX_REFRESH 4 1 ECU_ADDRESS 0x528080C8 /end MEASUREMENT
/begin MEASUREMENT MCore_enMWTaster_ZAT2 "unsigned integer 8bit" UBYTE App_Tc_CompuMethods_CM_TXTenNotactiveActiveNotinstalled 1 100 0.0 255.0 MAX_REFRESH 4 1 ECU_ADDRESS 0x528080C9 /end MEASUREMENT
/begin MEASUREMENT MCore_ASCLifterSts "unsigned integer 8bit" UBYTE VW_BCM_CompuMethods_SC_F1_O0_UNoUnit 1 100 0.0 255.0 MAX_REFRESH 4 1 ECU_ADDRESS 0x400E3536 /end MEASUREMENT
/begin MEASUREMENT MCore_VehicleLifterFailSts "unsigned integer 8bit" UBYTE VW_BCM_CompuMethods_SC_F1_O0_UNoUnit 1 100 0.0 255.0 MAX_REFRESH 4 1 ECU_ADDRESS 0x400E3537 /end MEASUREMENT
/begin MEASUREMENT MCore_VehicleLifterSts "unsigned integer 8bit" UBYTE VW_BCM_CompuMethods_SC_F1_O0_UNoUnit 1 100 0.0 255.0 MAX_REFRESH 4 1 ECU_ADDRESS 0x400E3538 /end MEASUREMENT
/begin MEASUREMENT MCore_StMon_0 "" UBYTE DefaultIdenticalCompu 1 100 0.0 255.0 MAX_REFRESH 4 1 ECU_ADDRESS 0x400E3539
 /begin ANNOTATION ANNOTATION_LABEL "Description (coming from AUTOSAR DESC field)"
  /begin ANNOTATION_TEXT "Application data type for error type data elements. Error types are bit coded\r\n" /end ANNOTATION_TEXT
 /end ANNOTATION
/end MEASUREMENT
/begin MEASUREMENT MCore_StMon_5 "" UBYTE DefaultIdenticalCompu 1 100 0.0 255.0 MAX_REFRESH 4 1 ECU_ADDRESS 0x400E353A
 /begin ANNOTATION ANNOTATION_LABEL "Description (coming from AUTOSAR DESC field)"
  /begin ANNOTATION_TEXT "Application data type for error type data elements. Error types are bit coded\r\n" /end ANNOTATION_TEXT
 /end ANNOTATION
/end MEASUREMENT
/begin MEASUREMENT MCore_StMon_9 "" UBYTE DefaultIdenticalCompu 1 100 0.0 255.0 MAX_REFRESH 4 1 ECU_ADDRESS 0x400E353B
 /begin ANNOTATION ANNOTATION_LABEL "Description (coming from AUTOSAR DESC field)"
  /begin ANNOTATION_TEXT "Application data type for error type data elements. Error types are bit coded\r\n" /end ANNOTATION_TEXT
 /end ANNOTATION
/end MEASUREMENT
/begin MEASUREMENT MCore_StMon_18 "" UBYTE DefaultIdenticalCompu 1 100 0.0 255.0 MAX_REFRESH 4 1 ECU_ADDRESS 0x400E353C
 /begin ANNOTATION ANNOTATION_LABEL "Description (coming from AUTOSAR DESC field)"
  /begin ANNOTATION_TEXT "Application data type for error type data elements. Error types are bit coded\r\n" /end ANNOTATION_TEXT
 /end ANNOTATION
/end MEASUREMENT
/begin MEASUREMENT MCore_StMon_21 "" UBYTE DefaultIdenticalCompu 1 100 0.0 255.0 MAX_REFRESH 4 1 ECU_ADDRESS 0x400E353D
 /begin ANNOTATION ANNOTATION_LABEL "Description (coming from AUTOSAR DESC field)"
  /begin ANNOTATION_TEXT "Application data type for error type data elements. Error types are bit coded\r\n" /end ANNOTATION_TEXT
 /end ANNOTATION
/end MEASUREMENT
/begin MEASUREMENT MCore_StMon_28 "" UBYTE DefaultIdenticalCompu 1 100 0.0 255.0 MAX_REFRESH 4 1 ECU_ADDRESS 0x400E353E
 /begin ANNOTATION ANNOTATION_LABEL "Description (coming from AUTOSAR DESC field)"
  /begin ANNOTATION_TEXT "Application data type for error type data elements. Error types are bit coded\r\n" /end ANNOTATION_TEXT
 /end ANNOTATION
/end MEASUREMENT
/begin MEASUREMENT MCore_StMon_29 "" UBYTE DefaultIdenticalCompu 1 100 0.0 255.0 MAX_REFRESH 4 1 ECU_ADDRESS 0x400E353F
 /begin ANNOTATION ANNOTATION_LABEL "Description (coming from AUTOSAR DESC field)"
  /begin ANNOTATION_TEXT "Application data type for error type data elements. Error types are bit coded\r\n" /end ANNOTATION_TEXT
 /end ANNOTATION
/end MEASUREMENT
/begin MEASUREMENT MCore_Chdlock_error "unsigned integer 8bit" UBYTE VW_BCM_CompuMethods_SC_F1_O0_UNoUnit 1 100 0.0 255.0 ECU_ADDRESS 0x400E3540 /end MEASUREMENT
/begin MEASUREMENT MCore_StartupTest_performed "Boolean" UBYTE Methods_boolean 1 100 0.0 1.0 ECU_ADDRESS 0x400E3541 /end MEASUREMENT
/begin MEASUREMENT MCore_Unconnected_bStWarnBlkNotlaufGueltig "Boolean" UBYTE Methods_boolean 1 100 0.0 1.0 MAX_REFRESH 4 1 ECU_ADDRESS 0x400E3157 /end MEASUREMENT
/begin MEASUREMENT MCore_bStBlinkmasterFehler "Boolean" UBYTE Methods_boolean 1 100 0.0 1.0 MAX_REFRESH 4 1 ECU_ADDRESS 0x400E35EA /end MEASUREMENT
/begin MEASUREMENT MCore_bStWarnBlkNotlauf "Boolean" UBYTE Methods_boolean 1 100 0.0 1.0 MAX_REFRESH 4 1 ECU_ADDRESS 0x400E35EB /end MEASUREMENT
/begin MEASUREMENT MCore_bKlemme15_1_ZAS_EM "Boolean" UBYTE Methods_boolean 1 100 0.0 1.0 MAX_REFRESH 4 1 ECU_ADDRESS 0x5280817F /end MEASUREMENT
/begin MEASUREMENT MCore_bKlemme15_2_ZAS_EM "Boolean" UBYTE Methods_boolean 1 100 0.0 1.0 MAX_REFRESH 4 1 ECU_ADDRESS 0x52808180 /end MEASUREMENT
/begin MEASUREMENT MCore_bKlemmeS_ZAS_EM "Boolean" UBYTE Methods_boolean 1 100 0.0 1.0 MAX_REFRESH 4 1 ECU_ADDRESS 0x52808181 /end MEASUREMENT
/begin MEASUREMENT MCore_enBlinkfunktionAktiv "unsigned integer 8bit" UBYTE VW_BCM_CompuMethods_SC_F1_O0_UNoUnit 1 100 0.0 255.0 MAX_REFRESH 4 1 ECU_ADDRESS 0x5280D29E /end MEASUREMENT
/begin MEASUREMENT MCore_Unconnected_Lpms_ResetReason_u8 "unsigned integer 8bit" UBYTE VW_BCM_CompuMethods_SC_F1_O0_UNoUnit 1 100 0.0 255.0 MAX_REFRESH 4 1 ECU_ADDRESS 0x400E3158 /end MEASUREMENT
/begin MEASUREMENT MCore_Lpms_Wakeup_Reason_u8 "unsigned integer 8bit" UBYTE VW_BCM_CompuMethods_SC_F1_O0_UNoUnit 1 100 0.0 255.0 MAX_REFRESH 4 1 ECU_ADDRESS 0x400E3614 /end MEASUREMENT
/begin MEASUREMENT MCore_StMon_330 "" UBYTE DefaultIdenticalCompu 1 100 0.0 255.0 MAX_REFRESH 4 1 ECU_ADDRESS 0x5280D301
 /begin ANNOTATION ANNOTATION_LABEL "Description (coming from AUTOSAR DESC field)"
  /begin ANNOTATION_TEXT "Application data type for error type data elements. Error types are bit coded\r\n" /end ANNOTATION_TEXT
 /end ANNOTATION
/end MEASUREMENT
/begin MEASUREMENT MCore_StMon_332 "" UBYTE DefaultIdenticalCompu 1 100 0.0 255.0 MAX_REFRESH 4 1 ECU_ADDRESS 0x5280D302
 /begin ANNOTATION ANNOTATION_LABEL "Description (coming from AUTOSAR DESC field)"
  /begin ANNOTATION_TEXT "Application data type for error type data elements. Error types are bit coded\r\n" /end ANNOTATION_TEXT
 /end ANNOTATION
/end MEASUREMENT
/begin MEASUREMENT MCore_StMon_333 "" UBYTE DefaultIdenticalCompu 1 100 0.0 255.0 MAX_REFRESH 4 1 ECU_ADDRESS 0x5280D303
 /begin ANNOTATION ANNOTATION_LABEL "Description (coming from AUTOSAR DESC field)"
  /begin ANNOTATION_TEXT "Application data type for error type data elements. Error types are bit coded\r\n" /end ANNOTATION_TEXT
 /end ANNOTATION
/end MEASUREMENT
/begin MEASUREMENT MCore_StMon_334 "" UBYTE DefaultIdenticalCompu 1 100 0.0 255.0 MAX_REFRESH 4 1 ECU_ADDRESS 0x5280D304
 /begin ANNOTATION ANNOTATION_LABEL "Description (coming from AUTOSAR DESC field)"
  /begin ANNOTATION_TEXT "Application data type for error type data elements. Error types are bit coded\r\n" /end ANNOTATION_TEXT
 /end ANNOTATION
/end MEASUREMENT
/begin MEASUREMENT MCore_StMon_335 "" UBYTE DefaultIdenticalCompu 1 100 0.0 255.0 MAX_REFRESH 4 1 ECU_ADDRESS 0x5280D305
 /begin ANNOTATION ANNOTATION_LABEL "Description (coming from AUTOSAR DESC field)"
  /begin ANNOTATION_TEXT "Application data type for error type data elements. Error types are bit coded\r\n" /end ANNOTATION_TEXT
 /end ANNOTATION
/end MEASUREMENT
/begin MEASUREMENT MCore_StMon_336 "" UBYTE DefaultIdenticalCompu 1 100 0.0 255.0 MAX_REFRESH 4 1 ECU_ADDRESS 0x5280D306
 /begin ANNOTATION ANNOTATION_LABEL "Description (coming from AUTOSAR DESC field)"
  /begin ANNOTATION_TEXT "Application data type for error type data elements. Error types are bit coded\r\n" /end ANNOTATION_TEXT
 /end ANNOTATION
/end MEASUREMENT
/begin MEASUREMENT MCore_StMon_337 "" UBYTE DefaultIdenticalCompu 1 100 0.0 255.0 MAX_REFRESH 4 1 ECU_ADDRESS 0x5280D307
 /begin ANNOTATION ANNOTATION_LABEL "Description (coming from AUTOSAR DESC field)"
  /begin ANNOTATION_TEXT "Application data type for error type data elements. Error types are bit coded\r\n" /end ANNOTATION_TEXT
 /end ANNOTATION
/end MEASUREMENT
/begin MEASUREMENT MCore_StMon_338 "" UBYTE DefaultIdenticalCompu 1 100 0.0 255.0 MAX_REFRESH 4 1 ECU_ADDRESS 0x5280D308
 /begin ANNOTATION ANNOTATION_LABEL "Description (coming from AUTOSAR DESC field)"
  /begin ANNOTATION_TEXT "Application data type for error type data elements. Error types are bit coded\r\n" /end ANNOTATION_TEXT
 /end ANNOTATION
/end MEASUREMENT
/begin MEASUREMENT MCore_Unconnected_StMon_339 "" UBYTE DefaultIdenticalCompu 1 100 0.0 255.0 MAX_REFRESH 4 1 ECU_ADDRESS 0x400D9193
 /begin ANNOTATION ANNOTATION_LABEL "Description (coming from AUTOSAR DESC field)"
  /begin ANNOTATION_TEXT "Application data type for error type data elements. Error types are bit coded\r\n" /end ANNOTATION_TEXT
 /end ANNOTATION
/end MEASUREMENT
/begin MEASUREMENT MCore_StMon_340 "" UBYTE DefaultIdenticalCompu 1 100 0.0 255.0 MAX_REFRESH 4 1 ECU_ADDRESS 0x5280D309
 /begin ANNOTATION ANNOTATION_LABEL "Description (coming from AUTOSAR DESC field)"
  /begin ANNOTATION_TEXT "Application data type for error type data elements. Error types are bit coded\r\n" /end ANNOTATION_TEXT
 /end ANNOTATION
/end MEASUREMENT
/begin MEASUREMENT MCore_StMon_341 "" UBYTE DefaultIdenticalCompu 1 100 0.0 255.0 MAX_REFRESH 4 1 ECU_ADDRESS 0x5280D30A
 /begin ANNOTATION ANNOTATION_LABEL "Description (coming from AUTOSAR DESC field)"
  /begin ANNOTATION_TEXT "Application data type for error type data elements. Error types are bit coded\r\n" /end ANNOTATION_TEXT
 /end ANNOTATION
/end MEASUREMENT
/begin MEASUREMENT MCore_StMon_342 "" UBYTE DefaultIdenticalCompu 1 100 0.0 255.0 MAX_REFRESH 4 1 ECU_ADDRESS 0x5280D30B
 /begin ANNOTATION ANNOTATION_LABEL "Description (coming from AUTOSAR DESC field)"
  /begin ANNOTATION_TEXT "Application data type for error type data elements. Error types are bit coded\r\n" /end ANNOTATION_TEXT
 /end ANNOTATION
/end MEASUREMENT
/begin MEASUREMENT MCore_StMon_343 "" UBYTE DefaultIdenticalCompu 1 100 0.0 255.0 MAX_REFRESH 4 1 ECU_ADDRESS 0x5280D30C
 /begin ANNOTATION ANNOTATION_LABEL "Description (coming from AUTOSAR DESC field)"
  /begin ANNOTATION_TEXT "Application data type for error type data elements. Error types are bit coded\r\n" /end ANNOTATION_TEXT
 /end ANNOTATION
/end MEASUREMENT
/begin MEASUREMENT MCore_StMon_344 "" UBYTE DefaultIdenticalCompu 1 100 0.0 255.0 MAX_REFRESH 4 1 ECU_ADDRESS 0x5280D30D
 /begin ANNOTATION ANNOTATION_LABEL "Description (coming from AUTOSAR DESC field)"
  /begin ANNOTATION_TEXT "Application data type for error type data elements. Error types are bit coded\r\n" /end ANNOTATION_TEXT
 /end ANNOTATION
/end MEASUREMENT
/begin MEASUREMENT MCore_StMon_345 "" UBYTE DefaultIdenticalCompu 1 100 0.0 255.0 MAX_REFRESH 4 1 ECU_ADDRESS 0x5280D30E
 /begin ANNOTATION ANNOTATION_LABEL "Description (coming from AUTOSAR DESC field)"
  /begin ANNOTATION_TEXT "Application data type for error type data elements. Error types are bit coded\r\n" /end ANNOTATION_TEXT
 /end ANNOTATION
/end MEASUREMENT
/begin MEASUREMENT MCore_StMon_346 "" UBYTE DefaultIdenticalCompu 1 100 0.0 255.0 MAX_REFRESH 4 1 ECU_ADDRESS 0x5280D30F
 /begin ANNOTATION ANNOTATION_LABEL "Description (coming from AUTOSAR DESC field)"
  /begin ANNOTATION_TEXT "Application data type for error type data elements. Error types are bit coded\r\n" /end ANNOTATION_TEXT
 /end ANNOTATION
/end MEASUREMENT
/begin MEASUREMENT MCore_StMon_347 "" UBYTE DefaultIdenticalCompu 1 100 0.0 255.0 MAX_REFRESH 4 1 ECU_ADDRESS 0x5280D310
 /begin ANNOTATION ANNOTATION_LABEL "Description (coming from AUTOSAR DESC field)"
  /begin ANNOTATION_TEXT "Application data type for error type data elements. Error types are bit coded\r\n" /end ANNOTATION_TEXT
 /end ANNOTATION
/end MEASUREMENT
/begin MEASUREMENT MCore_StMon_348 "" UBYTE DefaultIdenticalCompu 1 100 0.0 255.0 MAX_REFRESH 4 1 ECU_ADDRESS 0x5280D311
 /begin ANNOTATION ANNOTATION_LABEL "Description (coming from AUTOSAR DESC field)"
  /begin ANNOTATION_TEXT "Application data type for error type data elements. Error types are bit coded\r\n" /end ANNOTATION_TEXT
 /end ANNOTATION
/end MEASUREMENT
/begin MEASUREMENT MCore_StMon_349 "" UBYTE DefaultIdenticalCompu 1 100 0.0 255.0 MAX_REFRESH 4 1 ECU_ADDRESS 0x5280D312
 /begin ANNOTATION ANNOTATION_LABEL "Description (coming from AUTOSAR DESC field)"
  /begin ANNOTATION_TEXT "Application data type for error type data elements. Error types are bit coded\r\n" /end ANNOTATION_TEXT
 /end ANNOTATION
/end MEASUREMENT
/begin MEASUREMENT MCore_StMon_350 "" UBYTE DefaultIdenticalCompu 1 100 0.0 255.0 MAX_REFRESH 4 1 ECU_ADDRESS 0x5280D313
 /begin ANNOTATION ANNOTATION_LABEL "Description (coming from AUTOSAR DESC field)"
  /begin ANNOTATION_TEXT "Application data type for error type data elements. Error types are bit coded\r\n" /end ANNOTATION_TEXT
 /end ANNOTATION
/end MEASUREMENT
/begin MEASUREMENT MCore_StMon_351 "" UBYTE DefaultIdenticalCompu 1 100 0.0 255.0 MAX_REFRESH 4 1 ECU_ADDRESS 0x5280D314
 /begin ANNOTATION ANNOTATION_LABEL "Description (coming from AUTOSAR DESC field)"
  /begin ANNOTATION_TEXT "Application data type for error type data elements. Error types are bit coded\r\n" /end ANNOTATION_TEXT
 /end ANNOTATION
/end MEASUREMENT
/begin MEASUREMENT MCore_StMon_352 "" UBYTE DefaultIdenticalCompu 1 100 0.0 255.0 MAX_REFRESH 4 1 ECU_ADDRESS 0x5280D315
 /begin ANNOTATION ANNOTATION_LABEL "Description (coming from AUTOSAR DESC field)"
  /begin ANNOTATION_TEXT "Application data type for error type data elements. Error types are bit coded\r\n" /end ANNOTATION_TEXT
 /end ANNOTATION
/end MEASUREMENT
/begin MEASUREMENT MCore_StMon_353 "" UBYTE DefaultIdenticalCompu 1 100 0.0 255.0 MAX_REFRESH 4 1 ECU_ADDRESS 0x5280D316
 /begin ANNOTATION ANNOTATION_LABEL "Description (coming from AUTOSAR DESC field)"
  /begin ANNOTATION_TEXT "Application data type for error type data elements. Error types are bit coded\r\n" /end ANNOTATION_TEXT
 /end ANNOTATION
/end MEASUREMENT
/begin MEASUREMENT MCore_bMOKl50 "Boolean" UBYTE Methods_boolean 1 100 0.0 1.0 MAX_REFRESH 4 1 ECU_ADDRESS 0x400E3650 /end MEASUREMENT
/begin MEASUREMENT MCore_bMoHybFahrbereitschaft "Boolean" UBYTE Methods_boolean 1 100 0.0 1.0 MAX_REFRESH 4 1 ECU_ADDRESS 0x400E3651
 /begin ANNOTATION ANNOTATION_LABEL "Description (coming from AUTOSAR DESC field)" /begin ANNOTATION_TEXT "Motor hybrid driving\r\n" /end ANNOTATION_TEXT /end ANNOTATION
/end MEASUREMENT
/begin MEASUREMENT MCore_bMotorStoppWiederstartSSF "Boolean" UBYTE Methods_boolean 1 100 0.0 1.0 MAX_REFRESH 4 1 ECU_ADDRESS 0x400E3652 /end MEASUREMENT
/begin MEASUREMENT MCore_FullBridgeMotHl.ErrorDetected "" UBYTE VW_BCM_CompuMethods_SC_F1_O0_UNoUnit 1 100 0.0 1.0 ECU_ADDRESS 0x400E2D00 /end MEASUREMENT
/begin MEASUREMENT MCore_FullBridgeMotHl.ShutOffDirA_HS "" UBYTE VW_BCM_CompuMethods_SC_F1_O0_UNoUnit 1 100 0.0 1.0 ECU_ADDRESS 0x400E2D01 /end MEASUREMENT
/begin MEASUREMENT MCore_FullBridgeMotHl.ShutOffDirB "" UBYTE VW_BCM_CompuMethods_SC_F1_O0_UNoUnit 1 100 0.0 1.0 ECU_ADDRESS 0x400E2D02 /end MEASUREMENT
/begin MEASUREMENT MCore_FullBridgeMotHl.MonPerformed "" UBYTE VW_BCM_CompuMethods_SC_F1_O0_UNoUnit 1 100 0.0 1.0 ECU_ADDRESS 0x400E2D03 /end MEASUREMENT
/begin MEASUREMENT MCore_FullBridgeMotHr.ErrorDetected "" UBYTE VW_BCM_CompuMethods_SC_F1_O0_UNoUnit 1 100 0.0 1.0 ECU_ADDRESS 0x400E2D04 /end MEASUREMENT
/begin MEASUREMENT MCore_FullBridgeMotHr.ShutOffDirA_HS "" UBYTE VW_BCM_CompuMethods_SC_F1_O0_UNoUnit 1 100 0.0 1.0 ECU_ADDRESS 0x400E2D05 /end MEASUREMENT
/begin MEASUREMENT MCore_FullBridgeMotHr.ShutOffDirB "" UBYTE VW_BCM_CompuMethods_SC_F1_O0_UNoUnit 1 100 0.0 1.0 ECU_ADDRESS 0x400E2D06 /end MEASUREMENT
/begin MEASUREMENT MCore_FullBridgeMotHr.MonPerformed "" UBYTE VW_BCM_CompuMethods_SC_F1_O0_UNoUnit 1 100 0.0 1.0 ECU_ADDRESS 0x400E2D07 /end MEASUREMENT
/begin MEASUREMENT MCore_FullBridgeMotTkl.ErrorDetected "" UBYTE VW_BCM_CompuMethods_SC_F1_O0_UNoUnit 1 100 0.0 1.0 ECU_ADDRESS 0x400E2D08 /end MEASUREMENT
/begin MEASUREMENT MCore_FullBridgeMotTkl.ShutOffDirA_HS "" UBYTE VW_BCM_CompuMethods_SC_F1_O0_UNoUnit 1 100 0.0 1.0 ECU_ADDRESS 0x400E2D09 /end MEASUREMENT
/begin MEASUREMENT MCore_FullBridgeMotTkl.ShutOffDirB "" UBYTE VW_BCM_CompuMethods_SC_F1_O0_UNoUnit 1 100 0.0 1.0 ECU_ADDRESS 0x400E2D0A /end MEASUREMENT
/begin MEASUREMENT MCore_FullBridgeMotTkl.MonPerformed "" UBYTE VW_BCM_CompuMethods_SC_F1_O0_UNoUnit 1 100 0.0 1.0 ECU_ADDRESS 0x400E2D0B /end MEASUREMENT
/begin MEASUREMENT MCore_HalfBridgeHlHrSPos.ErrorDetected "" UBYTE VW_BCM_CompuMethods_SC_F1_O0_UNoUnit 1 100 0.0 1.0 ECU_ADDRESS 0x400E2D0C /end MEASUREMENT
/begin MEASUREMENT MCore_HalfBridgeHlHrSPos.ShutOffDirA_HS "" UBYTE VW_BCM_CompuMethods_SC_F1_O0_UNoUnit 1 100 0.0 1.0 ECU_ADDRESS 0x400E2D0D /end MEASUREMENT
/begin MEASUREMENT MCore_HalfBridgeHlHrSPos.ShutOffDirB "" UBYTE VW_BCM_CompuMethods_SC_F1_O0_UNoUnit 1 100 0.0 1.0 ECU_ADDRESS 0x400E2D0E /end MEASUREMENT
/begin MEASUREMENT MCore_HalfBridgeHlHrSPos.MonPerformed "" UBYTE VW_BCM_CompuMethods_SC_F1_O0_UNoUnit 1 100 0.0 1.0 ECU_ADDRESS 0x400E2D0F /end MEASUREMENT
/begin MEASUREMENT MCore_bDiagnoseverbotNachStart "Boolean" UBYTE VW_BCM_CompuMethods_SC_F1_O0_UNoUnit 1 100 0.0 1.0 MAX_REFRESH 4 1 ECU_ADDRESS 0x5280819C /end MEASUREMENT
/begin MEASUREMENT MCore_enEngineMonitorState "unsigned integer 8bit" UBYTE VW_BCM_CompuMethods_SC_F1_O0_UNoUnit 1 100 0.0 255.0 MAX_REFRESH 4 1 ECU_ADDRESS 0x400E3159 /end MEASUREMENT
/begin MEASUREMENT MCore_enKurzschlussZat1Zat2 "unsigned integer 8bit" UBYTE VW_BCM_CompuMethods_CM_TXTenErrStatus 1 100 0.0 255.0 MAX_REFRESH 4 1 ECU_ADDRESS 0x5280D317 /end MEASUREMENT
/begin MEASUREMENT MCore_bMOKl50_0 "Boolean" UBYTE Methods_boolean 1 100 0.0 1.0 MAX_REFRESH 4 1 ECU_ADDRESS 0x5280819D /end MEASUREMENT
/begin MEASUREMENT MCore_tDiagnoseverbotNachStart "unsigned integer 8bit" UBYTE VW_BCM_CompuMethods_SC_F1_O0_USec 1 100 0.0 255.0 MAX_REFRESH 4 1 ECU_ADDRESS 0x5280D31B /end MEASUREMENT
/begin MEASUREMENT MCore_tSpannungsfehler "unsigned integer 8bit" UBYTE VW_BCM_CompuMethods_SC_F1_O0_UNoUnit 1 100 0.0 255.0 MAX_REFRESH 4 1 ECU_ADDRESS 0x5280D31C /end MEASUREMENT
/begin MEASUREMENT MCore_OpenLoadErrOfAllHwOutp "" UBYTE DefaultIdenticalCompu 1 100 0.0 255.0 ARRAY_SIZE 75 ECU_ADDRESS 0x400E3653 /end MEASUREMENT
/begin MEASUREMENT MCore_PLDErrOffAllHwOutp "" UBYTE DefaultIdenticalCompu 1 100 0.0 255.0 ARRAY_SIZE 75 ECU_ADDRESS 0x400E369E /end MEASUREMENT
/begin MEASUREMENT MCore_SC2GNDErrOfAllHwOutp "" UBYTE DefaultIdenticalCompu 1 100 0.0 255.0 ARRAY_SIZE 75 ECU_ADDRESS 0x400E36E9 /end MEASUREMENT
/begin MEASUREMENT MCore_StMon_34 "" UBYTE DefaultIdenticalCompu 1 100 0.0 255.0 MAX_REFRESH 4 1 ECU_ADDRESS 0x400E3615
 /begin ANNOTATION ANNOTATION_LABEL "Description (coming from AUTOSAR DESC field)"
  /begin ANNOTATION_TEXT "Application data type for error type data elements. Error types are bit coded\r\n" /end ANNOTATION_TEXT
 /end ANNOTATION
/end MEASUREMENT
/begin MEASUREMENT MCore_StMon_39 "" UBYTE DefaultIdenticalCompu 1 100 0.0 255.0 MAX_REFRESH 4 1 ECU_ADDRESS 0x400E3616
 /begin ANNOTATION ANNOTATION_LABEL "Description (coming from AUTOSAR DESC field)"
  /begin ANNOTATION_TEXT "Application data type for error type data elements. Error types are bit coded\r\n" /end ANNOTATION_TEXT
 /end ANNOTATION
/end MEASUREMENT
/begin MEASUREMENT MCore_StMon_41 "" UBYTE DefaultIdenticalCompu 1 100 0.0 255.0 MAX_REFRESH 4 1 ECU_ADDRESS 0x400E3617
 /begin ANNOTATION ANNOTATION_LABEL "Description (coming from AUTOSAR DESC field)"
  /begin ANNOTATION_TEXT "Application data type for error type data elements. Error types are bit coded\r\n" /end ANNOTATION_TEXT
 /end ANNOTATION
/end MEASUREMENT
/begin MEASUREMENT MCore_StMon_43 "" UBYTE DefaultIdenticalCompu 1 100 0.0 255.0 MAX_REFRESH 4 1 ECU_ADDRESS 0x400E3618
 /begin ANNOTATION ANNOTATION_LABEL "Description (coming from AUTOSAR DESC field)"
  /begin ANNOTATION_TEXT "Application data type for error type data elements. Error types are bit coded\r\n" /end ANNOTATION_TEXT
 /end ANNOTATION
/end MEASUREMENT
/begin MEASUREMENT MCore_StMon_44 "" UBYTE DefaultIdenticalCompu 1 100 0.0 255.0 MAX_REFRESH 4 1 ECU_ADDRESS 0x5280D2A4
 /begin ANNOTATION ANNOTATION_LABEL "Description (coming from AUTOSAR DESC field)"
  /begin ANNOTATION_TEXT "Application data type for error type data elements. Error types are bit coded\r\n" /end ANNOTATION_TEXT
 /end ANNOTATION
/end MEASUREMENT
/begin MEASUREMENT MCore_StMon_45 "" UBYTE DefaultIdenticalCompu 1 100 0.0 255.0 MAX_REFRESH 4 1 ECU_ADDRESS 0x400E3619
 /begin ANNOTATION ANNOTATION_LABEL "Description (coming from AUTOSAR DESC field)"
  /begin ANNOTATION_TEXT "Application data type for error type data elements. Error types are bit coded\r\n" /end ANNOTATION_TEXT
 /end ANNOTATION
/end MEASUREMENT
/begin MEASUREMENT MCore_StMon_49 "" UBYTE DefaultIdenticalCompu 1 100 0.0 255.0 MAX_REFRESH 4 1 ECU_ADDRESS 0x400E361A
 /begin ANNOTATION ANNOTATION_LABEL "Description (coming from AUTOSAR DESC field)"
  /begin ANNOTATION_TEXT "Application data type for error type data elements. Error types are bit coded\r\n" /end ANNOTATION_TEXT
 /end ANNOTATION
/end MEASUREMENT
/begin MEASUREMENT MCore_StMon_51 "" UBYTE DefaultIdenticalCompu 1 100 0.0 255.0 MAX_REFRESH 4 1 ECU_ADDRESS 0x400E361B
 /begin ANNOTATION ANNOTATION_LABEL "Description (coming from AUTOSAR DESC field)"
  /begin ANNOTATION_TEXT "Application data type for error type data elements. Error types are bit coded\r\n" /end ANNOTATION_TEXT
 /end ANNOTATION
/end MEASUREMENT
/begin MEASUREMENT MCore_StMon_53 "" UBYTE DefaultIdenticalCompu 1 100 0.0 255.0 MAX_REFRESH 4 1 ECU_ADDRESS 0x400E361C
 /begin ANNOTATION ANNOTATION_LABEL "Description (coming from AUTOSAR DESC field)"
  /begin ANNOTATION_TEXT "Application data type for error type data elements. Error types are bit coded\r\n" /end ANNOTATION_TEXT
 /end ANNOTATION
/end MEASUREMENT
/begin MEASUREMENT MCore_StMon_55 "" UBYTE DefaultIdenticalCompu 1 100 0.0 255.0 MAX_REFRESH 4 1 ECU_ADDRESS 0x400E361D
 /begin ANNOTATION ANNOTATION_LABEL "Description (coming from AUTOSAR DESC field)"
  /begin ANNOTATION_TEXT "Application data type for error type data elements. Error types are bit coded\r\n" /end ANNOTATION_TEXT
 /end ANNOTATION
/end MEASUREMENT
/begin MEASUREMENT MCore_StMon_56 "" UBYTE DefaultIdenticalCompu 1 100 0.0 255.0 MAX_REFRESH 4 1 ECU_ADDRESS 0x400E361E
 /begin ANNOTATION ANNOTATION_LABEL "Description (coming from AUTOSAR DESC field)"
  /begin ANNOTATION_TEXT "Application data type for error type data elements. Error types are bit coded\r\n" /end ANNOTATION_TEXT
 /end ANNOTATION
/end MEASUREMENT
/begin MEASUREMENT MCore_Unconnected_StMon_57 "" UBYTE DefaultIdenticalCompu 1 100 0.0 255.0 MAX_REFRESH 4 1 ECU_ADDRESS 0x400D9194
 /begin ANNOTATION ANNOTATION_LABEL "Description (coming from AUTOSAR DESC field)"
  /begin ANNOTATION_TEXT "Application data type for error type data elements. Error types are bit coded\r\n" /end ANNOTATION_TEXT
 /end ANNOTATION
/end MEASUREMENT
/begin MEASUREMENT MCore_Unconnected_StMon_58 "" UBYTE DefaultIdenticalCompu 1 100 0.0 255.0 MAX_REFRESH 4 1 ECU_ADDRESS 0x400D9195
 /begin ANNOTATION ANNOTATION_LABEL "Description (coming from AUTOSAR DESC field)"
  /begin ANNOTATION_TEXT "Application data type for error type data elements. Error types are bit coded\r\n" /end ANNOTATION_TEXT
 /end ANNOTATION
/end MEASUREMENT
/begin MEASUREMENT MCore_Unconnected_StMon_59 "" UBYTE DefaultIdenticalCompu 1 100 0.0 255.0 MAX_REFRESH 4 1 ECU_ADDRESS 0x400D9196
 /begin ANNOTATION ANNOTATION_LABEL "Description (coming from AUTOSAR DESC field)"
  /begin ANNOTATION_TEXT "Application data type for error type data elements. Error types are bit coded\r\n" /end ANNOTATION_TEXT
 /end ANNOTATION
/end MEASUREMENT
/begin MEASUREMENT MCore_Unconnected_StMon_60 "" UBYTE DefaultIdenticalCompu 1 100 0.0 255.0 MAX_REFRESH 4 1 ECU_ADDRESS 0x400D9197
 /begin ANNOTATION ANNOTATION_LABEL "Description (coming from AUTOSAR DESC field)"
  /begin ANNOTATION_TEXT "Application data type for error type data elements. Error types are bit coded\r\n" /end ANNOTATION_TEXT
 /end ANNOTATION
/end MEASUREMENT
/begin MEASUREMENT MCore_Unconnected_StMon_61 "" UBYTE DefaultIdenticalCompu 1 100 0.0 255.0 MAX_REFRESH 4 1 ECU_ADDRESS 0x400D9198
 /begin ANNOTATION ANNOTATION_LABEL "Description (coming from AUTOSAR DESC field)"
  /begin ANNOTATION_TEXT "Application data type for error type data elements. Error types are bit coded\r\n" /end ANNOTATION_TEXT
 /end ANNOTATION
/end MEASUREMENT
/begin MEASUREMENT MCore_Unconnected_StMon_62 "" UBYTE DefaultIdenticalCompu 1 100 0.0 255.0 MAX_REFRESH 4 1 ECU_ADDRESS 0x400D9199
 /begin ANNOTATION ANNOTATION_LABEL "Description (coming from AUTOSAR DESC field)"
  /begin ANNOTATION_TEXT "Application data type for error type data elements. Error types are bit coded\r\n" /end ANNOTATION_TEXT
 /end ANNOTATION
/end MEASUREMENT
/begin MEASUREMENT MCore_Unconnected_StMon_63 "" UBYTE DefaultIdenticalCompu 1 100 0.0 255.0 MAX_REFRESH 4 1 ECU_ADDRESS 0x400D919A
 /begin ANNOTATION ANNOTATION_LABEL "Description (coming from AUTOSAR DESC field)"
  /begin ANNOTATION_TEXT "Application data type for error type data elements. Error types are bit coded\r\n" /end ANNOTATION_TEXT
 /end ANNOTATION
/end MEASUREMENT
/begin MEASUREMENT MCore_StMon_64 "" UBYTE DefaultIdenticalCompu 1 100 0.0 255.0 MAX_REFRESH 4 1 ECU_ADDRESS 0x5280D2A5
 /begin ANNOTATION ANNOTATION_LABEL "Description (coming from AUTOSAR DESC field)"
  /begin ANNOTATION_TEXT "Application data type for error type data elements. Error types are bit coded\r\n" /end ANNOTATION_TEXT
 /end ANNOTATION
/end MEASUREMENT
/begin MEASUREMENT MCore_Unconnected_StMon_65 "" UBYTE DefaultIdenticalCompu 1 100 0.0 255.0 MAX_REFRESH 4 1 ECU_ADDRESS 0x400D919B
 /begin ANNOTATION ANNOTATION_LABEL "Description (coming from AUTOSAR DESC field)"
  /begin ANNOTATION_TEXT "Application data type for error type data elements. Error types are bit coded\r\n" /end ANNOTATION_TEXT
 /end ANNOTATION
/end MEASUREMENT
/begin MEASUREMENT MCore_Unconnected_StMon_66 "" UBYTE DefaultIdenticalCompu 1 100 0.0 255.0 MAX_REFRESH 4 1 ECU_ADDRESS 0x400D919C
 /begin ANNOTATION ANNOTATION_LABEL "Description (coming from AUTOSAR DESC field)"
  /begin ANNOTATION_TEXT "Application data type for error type data elements. Error types are bit coded\r\n" /end ANNOTATION_TEXT
 /end ANNOTATION
/end MEASUREMENT
/begin MEASUREMENT MCore_StMon_69 "" UBYTE DefaultIdenticalCompu 1 100 0.0 255.0 MAX_REFRESH 4 1 ECU_ADDRESS 0x5280D2A6
 /begin ANNOTATION ANNOTATION_LABEL "Description (coming from AUTOSAR DESC field)"
  /begin ANNOTATION_TEXT "Application data type for error type data elements. Error types are bit coded\r\n" /end ANNOTATION_TEXT
 /end ANNOTATION
/end MEASUREMENT
/begin MEASUREMENT MCore_Unconnected_StMon_70 "" UBYTE DefaultIdenticalCompu 1 100 0.0 255.0 MAX_REFRESH 4 1 ECU_ADDRESS 0x400D919D
 /begin ANNOTATION ANNOTATION_LABEL "Description (coming from AUTOSAR DESC field)"
  /begin ANNOTATION_TEXT "Application data type for error type data elements. Error types are bit coded\r\n" /end ANNOTATION_TEXT
 /end ANNOTATION
/end MEASUREMENT
/begin MEASUREMENT MCore_Unconnected_StMon_71 "" UBYTE DefaultIdenticalCompu 1 100 0.0 255.0 MAX_REFRESH 4 1 ECU_ADDRESS 0x400D919E
 /begin ANNOTATION ANNOTATION_LABEL "Description (coming from AUTOSAR DESC field)"
  /begin ANNOTATION_TEXT "Application data type for error type data elements. Error types are bit coded\r\n" /end ANNOTATION_TEXT
 /end ANNOTATION
/end MEASUREMENT
/begin MEASUREMENT MCore_Unconnected_StMon_72 "" UBYTE DefaultIdenticalCompu 1 100 0.0 255.0 MAX_REFRESH 4 1 ECU_ADDRESS 0x400D919F
 /begin ANNOTATION ANNOTATION_LABEL "Description (coming from AUTOSAR DESC field)"
  /begin ANNOTATION_TEXT "Application data type for error type data elements. Error types are bit coded\r\n" /end ANNOTATION_TEXT
 /end ANNOTATION
/end MEASUREMENT
/begin MEASUREMENT MCore_Unconnected_StMon_73 "" UBYTE DefaultIdenticalCompu 1 100 0.0 255.0 MAX_REFRESH 4 1 ECU_ADDRESS 0x400D91A0
 /begin ANNOTATION ANNOTATION_LABEL "Description (coming from AUTOSAR DESC field)"
  /begin ANNOTATION_TEXT "Application data type for error type data elements. Error types are bit coded\r\n" /end ANNOTATION_TEXT
 /end ANNOTATION
/end MEASUREMENT
/begin MEASUREMENT MCore_Unconnected_StMon_77 "" UBYTE DefaultIdenticalCompu 1 100 0.0 255.0 MAX_REFRESH 4 1 ECU_ADDRESS 0x400D91A1
 /begin ANNOTATION ANNOTATION_LABEL "Description (coming from AUTOSAR DESC field)"
  /begin ANNOTATION_TEXT "Application data type for error type data elements. Error types are bit coded\r\n" /end ANNOTATION_TEXT
 /end ANNOTATION
/end MEASUREMENT
/begin MEASUREMENT MCore_Unconnected_StMon_78 "" UBYTE DefaultIdenticalCompu 1 100 0.0 255.0 MAX_REFRESH 4 1 ECU_ADDRESS 0x400D91A2
 /begin ANNOTATION ANNOTATION_LABEL "Description (coming from AUTOSAR DESC field)"
  /begin ANNOTATION_TEXT "Application data type for error type data elements. Error types are bit coded\r\n" /end ANNOTATION_TEXT
 /end ANNOTATION
/end MEASUREMENT
/begin MEASUREMENT MCore_StMon_81 "" UBYTE DefaultIdenticalCompu 1 100 0.0 255.0 MAX_REFRESH 4 1 ECU_ADDRESS 0x5280D2A7
 /begin ANNOTATION ANNOTATION_LABEL "Description (coming from AUTOSAR DESC field)"
  /begin ANNOTATION_TEXT "Application data type for error type data elements. Error types are bit coded\r\n" /end ANNOTATION_TEXT
 /end ANNOTATION
/end MEASUREMENT
/begin MEASUREMENT MCore_Unconnected_StMon_83 "" UBYTE DefaultIdenticalCompu 1 100 0.0 255.0 MAX_REFRESH 4 1 ECU_ADDRESS 0x400D91A3
 /begin ANNOTATION ANNOTATION_LABEL "Description (coming from AUTOSAR DESC field)"
  /begin ANNOTATION_TEXT "Application data type for error type data elements. Error types are bit coded\r\n" /end ANNOTATION_TEXT
 /end ANNOTATION
/end MEASUREMENT
/begin MEASUREMENT MCore_Unconnected_StMon_84 "" UBYTE DefaultIdenticalCompu 1 100 0.0 255.0 MAX_REFRESH 4 1 ECU_ADDRESS 0x400D91A4
 /begin ANNOTATION ANNOTATION_LABEL "Description (coming from AUTOSAR DESC field)"
  /begin ANNOTATION_TEXT "Application data type for error type data elements. Error types are bit coded\r\n" /end ANNOTATION_TEXT
 /end ANNOTATION
/end MEASUREMENT
/begin MEASUREMENT MCore_Unconnected_StMon_89 "" UBYTE DefaultIdenticalCompu 1 100 0.0 255.0 MAX_REFRESH 4 1 ECU_ADDRESS 0x400D91A5
 /begin ANNOTATION ANNOTATION_LABEL "Description (coming from AUTOSAR DESC field)"
  /begin ANNOTATION_TEXT "Application data type for error type data elements. Error types are bit coded\r\n" /end ANNOTATION_TEXT
 /end ANNOTATION
/end MEASUREMENT
/begin MEASUREMENT MCore_Unconnected_StMon_94 "" UBYTE DefaultIdenticalCompu 1 100 0.0 255.0 MAX_REFRESH 4 1 ECU_ADDRESS 0x400D91A6
 /begin ANNOTATION ANNOTATION_LABEL "Description (coming from AUTOSAR DESC field)"
  /begin ANNOTATION_TEXT "Application data type for error type data elements. Error types are bit coded\r\n" /end ANNOTATION_TEXT
 /end ANNOTATION
/end MEASUREMENT
/begin MEASUREMENT MCore_Unconnected_StMon_95 "" UBYTE DefaultIdenticalCompu 1 100 0.0 255.0 MAX_REFRESH 4 1 ECU_ADDRESS 0x400D91A7
 /begin ANNOTATION ANNOTATION_LABEL "Description (coming from AUTOSAR DESC field)"
  /begin ANNOTATION_TEXT "Application data type for error type data elements. Error types are bit coded\r\n" /end ANNOTATION_TEXT
 /end ANNOTATION
/end MEASUREMENT
/begin MEASUREMENT MCore_Unconnected_StMon_96 "" UBYTE DefaultIdenticalCompu 1 100 0.0 255.0 MAX_REFRESH 4 1 ECU_ADDRESS 0x400D91A8
 /begin ANNOTATION ANNOTATION_LABEL "Description (coming from AUTOSAR DESC field)"
  /begin ANNOTATION_TEXT "Application data type for error type data elements. Error types are bit coded\r\n" /end ANNOTATION_TEXT
 /end ANNOTATION
/end MEASUREMENT
/begin MEASUREMENT MCore_Unconnected_StMon_97 "" UBYTE DefaultIdenticalCompu 1 100 0.0 255.0 MAX_REFRESH 4 1 ECU_ADDRESS 0x400D91A9
 /begin ANNOTATION ANNOTATION_LABEL "Description (coming from AUTOSAR DESC field)"
  /begin ANNOTATION_TEXT "Application data type for error type data elements. Error types are bit coded\r\n" /end ANNOTATION_TEXT
 /end ANNOTATION
/end MEASUREMENT
/begin MEASUREMENT MCore_StMon_98 "" UBYTE DefaultIdenticalCompu 1 100 0.0 255.0 MAX_REFRESH 4 1 ECU_ADDRESS 0x5280D2A8
 /begin ANNOTATION ANNOTATION_LABEL "Description (coming from AUTOSAR DESC field)"
  /begin ANNOTATION_TEXT "Application data type for error type data elements. Error types are bit coded\r\n" /end ANNOTATION_TEXT
 /end ANNOTATION
/end MEASUREMENT
/begin MEASUREMENT MCore_StMon_100 "" UBYTE DefaultIdenticalCompu 1 100 0.0 255.0 MAX_REFRESH 4 1 ECU_ADDRESS 0x5280D2A9
 /begin ANNOTATION ANNOTATION_LABEL "Description (coming from AUTOSAR DESC field)"
  /begin ANNOTATION_TEXT "Application data type for error type data elements. Error types are bit coded\r\n" /end ANNOTATION_TEXT
 /end ANNOTATION
/end MEASUREMENT
/begin MEASUREMENT MCore_Unconnected_StMon_101 "" UBYTE DefaultIdenticalCompu 1 100 0.0 255.0 MAX_REFRESH 4 1 ECU_ADDRESS 0x400D91AA
 /begin ANNOTATION ANNOTATION_LABEL "Description (coming from AUTOSAR DESC field)"
  /begin ANNOTATION_TEXT "Application data type for error type data elements. Error types are bit coded\r\n" /end ANNOTATION_TEXT
 /end ANNOTATION
/end MEASUREMENT
/begin MEASUREMENT MCore_StMon_102 "" UBYTE DefaultIdenticalCompu 1 100 0.0 255.0 MAX_REFRESH 4 1 ECU_ADDRESS 0x5280D2AA
 /begin ANNOTATION ANNOTATION_LABEL "Description (coming from AUTOSAR DESC field)"
  /begin ANNOTATION_TEXT "Application data type for error type data elements. Error types are bit coded\r\n" /end ANNOTATION_TEXT
 /end ANNOTATION
/end MEASUREMENT
/begin MEASUREMENT MCore_StMon_104 "" UBYTE DefaultIdenticalCompu 1 100 0.0 255.0 MAX_REFRESH 4 1 ECU_ADDRESS 0x5280D2AB
 /begin ANNOTATION ANNOTATION_LABEL "Description (coming from AUTOSAR DESC field)"
  /begin ANNOTATION_TEXT "Application data type for error type data elements. Error types are bit coded\r\n" /end ANNOTATION_TEXT
 /end ANNOTATION
/end MEASUREMENT
/begin MEASUREMENT MCore_Unconnected_StMon_106 "" UBYTE DefaultIdenticalCompu 1 100 0.0 255.0 MAX_REFRESH 4 1 ECU_ADDRESS 0x400D91AB
 /begin ANNOTATION ANNOTATION_LABEL "Description (coming from AUTOSAR DESC field)"
  /begin ANNOTATION_TEXT "Application data type for error type data elements. Error types are bit coded\r\n" /end ANNOTATION_TEXT
 /end ANNOTATION
/end MEASUREMENT
/begin MEASUREMENT MCore_Unconnected_StMon_107 "" UBYTE DefaultIdenticalCompu 1 100 0.0 255.0 MAX_REFRESH 4 1 ECU_ADDRESS 0x400D91AC
 /begin ANNOTATION ANNOTATION_LABEL "Description (coming from AUTOSAR DESC field)"
  /begin ANNOTATION_TEXT "Application data type for error type data elements. Error types are bit coded\r\n" /end ANNOTATION_TEXT
 /end ANNOTATION
/end MEASUREMENT
/begin MEASUREMENT MCore_StMon_108 "" UBYTE DefaultIdenticalCompu 1 100 0.0 255.0 MAX_REFRESH 4 1 ECU_ADDRESS 0x5280D2AC
 /begin ANNOTATION ANNOTATION_LABEL "Description (coming from AUTOSAR DESC field)"
  /begin ANNOTATION_TEXT "Application data type for error type data elements. Error types are bit coded\r\n" /end ANNOTATION_TEXT
 /end ANNOTATION
/end MEASUREMENT
/begin MEASUREMENT MCore_Unconnected_StMon_109 "" UBYTE DefaultIdenticalCompu 1 100 0.0 255.0 MAX_REFRESH 4 1 ECU_ADDRESS 0x400D91AD
 /begin ANNOTATION ANNOTATION_LABEL "Description (coming from AUTOSAR DESC field)"
  /begin ANNOTATION_TEXT "Application data type for error type data elements. Error types are bit coded\r\n" /end ANNOTATION_TEXT
 /end ANNOTATION
/end MEASUREMENT
/begin MEASUREMENT MCore_Unconnected_StMon_111 "" UBYTE DefaultIdenticalCompu 1 100 0.0 255.0 MAX_REFRESH 4 1 ECU_ADDRESS 0x400D91AE
 /begin ANNOTATION ANNOTATION_LABEL "Description (coming from AUTOSAR DESC field)"
  /begin ANNOTATION_TEXT "Application data type for error type data elements. Error types are bit coded\r\n" /end ANNOTATION_TEXT
 /end ANNOTATION
/end MEASUREMENT
/begin MEASUREMENT MCore_Unconnected_StMon_112 "" UBYTE DefaultIdenticalCompu 1 100 0.0 255.0 MAX_REFRESH 4 1 ECU_ADDRESS 0x400D91AF
 /begin ANNOTATION ANNOTATION_LABEL "Description (coming from AUTOSAR DESC field)"
  /begin ANNOTATION_TEXT "Application data type for error type data elements. Error types are bit coded\r\n" /end ANNOTATION_TEXT
 /end ANNOTATION
/end MEASUREMENT
/begin MEASUREMENT MCore_Unconnected_StMon_118 "" UBYTE DefaultIdenticalCompu 1 100 0.0 255.0 MAX_REFRESH 4 1 ECU_ADDRESS 0x400D91B0
 /begin ANNOTATION ANNOTATION_LABEL "Description (coming from AUTOSAR DESC field)"
  /begin ANNOTATION_TEXT "Application data type for error type data elements. Error types are bit coded\r\n" /end ANNOTATION_TEXT
 /end ANNOTATION
/end MEASUREMENT
/begin MEASUREMENT MCore_Unconnected_StMon_119 "" UBYTE DefaultIdenticalCompu 1 100 0.0 255.0 MAX_REFRESH 4 1 ECU_ADDRESS 0x400D91B1
 /begin ANNOTATION ANNOTATION_LABEL "Description (coming from AUTOSAR DESC field)"
  /begin ANNOTATION_TEXT "Application data type for error type data elements. Error types are bit coded\r\n" /end ANNOTATION_TEXT
 /end ANNOTATION
/end MEASUREMENT
/begin MEASUREMENT MCore_Unconnected_StMon_122 "" UBYTE DefaultIdenticalCompu 1 100 0.0 255.0 MAX_REFRESH 4 1 ECU_ADDRESS 0x400D91B2
 /begin ANNOTATION ANNOTATION_LABEL "Description (coming from AUTOSAR DESC field)"
  /begin ANNOTATION_TEXT "Application data type for error type data elements. Error types are bit coded\r\n" /end ANNOTATION_TEXT
 /end ANNOTATION
/end MEASUREMENT
/begin MEASUREMENT MCore_Unconnected_StMon_123 "" UBYTE DefaultIdenticalCompu 1 100 0.0 255.0 MAX_REFRESH 4 1 ECU_ADDRESS 0x400D91B3
 /begin ANNOTATION ANNOTATION_LABEL "Description (coming from AUTOSAR DESC field)"
  /begin ANNOTATION_TEXT "Application data type for error type data elements. Error types are bit coded\r\n" /end ANNOTATION_TEXT
 /end ANNOTATION
/end MEASUREMENT
/begin MEASUREMENT MCore_Unconnected_StMon_124 "" UBYTE DefaultIdenticalCompu 1 100 0.0 255.0 MAX_REFRESH 4 1 ECU_ADDRESS 0x400D91B4
 /begin ANNOTATION ANNOTATION_LABEL "Description (coming from AUTOSAR DESC field)"
  /begin ANNOTATION_TEXT "Application data type for error type data elements. Error types are bit coded\r\n" /end ANNOTATION_TEXT
 /end ANNOTATION
/end MEASUREMENT
/begin MEASUREMENT MCore_Unconnected_StMon_125 "" UBYTE DefaultIdenticalCompu 1 100 0.0 255.0 MAX_REFRESH 4 1 ECU_ADDRESS 0x400D91B5
 /begin ANNOTATION ANNOTATION_LABEL "Description (coming from AUTOSAR DESC field)"
  /begin ANNOTATION_TEXT "Application data type for error type data elements. Error types are bit coded\r\n" /end ANNOTATION_TEXT
 /end ANNOTATION
/end MEASUREMENT
/begin MEASUREMENT MCore_Unconnected_StMon_126 "" UBYTE DefaultIdenticalCompu 1 100 0.0 255.0 MAX_REFRESH 4 1 ECU_ADDRESS 0x400D91B6
 /begin ANNOTATION ANNOTATION_LABEL "Description (coming from AUTOSAR DESC field)"
  /begin ANNOTATION_TEXT "Application data type for error type data elements. Error types are bit coded\r\n" /end ANNOTATION_TEXT
 /end ANNOTATION
/end MEASUREMENT
/begin MEASUREMENT MCore_Unconnected_StMon_127 "" UBYTE DefaultIdenticalCompu 1 100 0.0 255.0 MAX_REFRESH 4 1 ECU_ADDRESS 0x400D91B7
 /begin ANNOTATION ANNOTATION_LABEL "Description (coming from AUTOSAR DESC field)"
  /begin ANNOTATION_TEXT "Application data type for error type data elements. Error types are bit coded\r\n" /end ANNOTATION_TEXT
 /end ANNOTATION
/end MEASUREMENT
/begin MEASUREMENT MCore_StMon_128 "" UBYTE DefaultIdenticalCompu 1 100 0.0 255.0 MAX_REFRESH 4 1 ECU_ADDRESS 0x5280D2AD
 /begin ANNOTATION ANNOTATION_LABEL "Description (coming from AUTOSAR DESC field)"
  /begin ANNOTATION_TEXT "Application data type for error type data elements. Error types are bit coded\r\n" /end ANNOTATION_TEXT
 /end ANNOTATION
/end MEASUREMENT
/begin MEASUREMENT MCore_Unconnected_StMon_129 "" UBYTE DefaultIdenticalCompu 1 100 0.0 255.0 MAX_REFRESH 4 1 ECU_ADDRESS 0x400D91B8
 /begin ANNOTATION ANNOTATION_LABEL "Description (coming from AUTOSAR DESC field)"
  /begin ANNOTATION_TEXT "Application data type for error type data elements. Error types are bit coded\r\n" /end ANNOTATION_TEXT
 /end ANNOTATION
/end MEASUREMENT
/begin MEASUREMENT MCore_StMon_130 "" UBYTE DefaultIdenticalCompu 1 100 0.0 255.0 MAX_REFRESH 4 1 ECU_ADDRESS 0x5280D2AE
 /begin ANNOTATION ANNOTATION_LABEL "Description (coming from AUTOSAR DESC field)"
  /begin ANNOTATION_TEXT "Application data type for error type data elements. Error types are bit coded\r\n" /end ANNOTATION_TEXT
 /end ANNOTATION
/end MEASUREMENT
/begin MEASUREMENT MCore_StMon_132 "" UBYTE DefaultIdenticalCompu 1 100 0.0 255.0 MAX_REFRESH 4 1 ECU_ADDRESS 0x5280D2AF
 /begin ANNOTATION ANNOTATION_LABEL "Description (coming from AUTOSAR DESC field)"
  /begin ANNOTATION_TEXT "Application data type for error type data elements. Error types are bit coded\r\n" /end ANNOTATION_TEXT
 /end ANNOTATION
/end MEASUREMENT
/begin MEASUREMENT MCore_StMon_133 "" UBYTE DefaultIdenticalCompu 1 100 0.0 255.0 MAX_REFRESH 4 1 ECU_ADDRESS 0x5280D2B0
 /begin ANNOTATION ANNOTATION_LABEL "Description (coming from AUTOSAR DESC field)"
  /begin ANNOTATION_TEXT "Application data type for error type data elements. Error types are bit coded\r\n" /end ANNOTATION_TEXT
 /end ANNOTATION
/end MEASUREMENT
/begin MEASUREMENT MCore_StMon_134 "" UBYTE DefaultIdenticalCompu 1 100 0.0 255.0 MAX_REFRESH 4 1 ECU_ADDRESS 0x5280D2B1
 /begin ANNOTATION ANNOTATION_LABEL "Description (coming from AUTOSAR DESC field)"
  /begin ANNOTATION_TEXT "Application data type for error type data elements. Error types are bit coded\r\n" /end ANNOTATION_TEXT
 /end ANNOTATION
/end MEASUREMENT
/begin MEASUREMENT MCore_Unconnected_StMon_135 "" UBYTE DefaultIdenticalCompu 1 100 0.0 255.0 MAX_REFRESH 4 1 ECU_ADDRESS 0x400D91B9
 /begin ANNOTATION ANNOTATION_LABEL "Description (coming from AUTOSAR DESC field)"
  /begin ANNOTATION_TEXT "Application data type for error type data elements. Error types are bit coded\r\n" /end ANNOTATION_TEXT
 /end ANNOTATION
/end MEASUREMENT
/begin MEASUREMENT MCore_Unconnected_StMon_136 "" UBYTE DefaultIdenticalCompu 1 100 0.0 255.0 MAX_REFRESH 4 1 ECU_ADDRESS 0x400D91BA
 /begin ANNOTATION ANNOTATION_LABEL "Description (coming from AUTOSAR DESC field)"
  /begin ANNOTATION_TEXT "Application data type for error type data elements. Error types are bit coded\r\n" /end ANNOTATION_TEXT
 /end ANNOTATION
/end MEASUREMENT
/begin MEASUREMENT MCore_Unconnected_StMon_137 "" UBYTE DefaultIdenticalCompu 1 100 0.0 255.0 MAX_REFRESH 4 1 ECU_ADDRESS 0x400D91BB
 /begin ANNOTATION ANNOTATION_LABEL "Description (coming from AUTOSAR DESC field)"
  /begin ANNOTATION_TEXT "Application data type for error type data elements. Error types are bit coded\r\n" /end ANNOTATION_TEXT
 /end ANNOTATION
/end MEASUREMENT
/begin MEASUREMENT MCore_Unconnected_StMon_138 "" UBYTE DefaultIdenticalCompu 1 100 0.0 255.0 MAX_REFRESH 4 1 ECU_ADDRESS 0x400D91BC
 /begin ANNOTATION ANNOTATION_LABEL "Description (coming from AUTOSAR DESC field)"
  /begin ANNOTATION_TEXT "Application data type for error type data elements. Error types are bit coded\r\n" /end ANNOTATION_TEXT
 /end ANNOTATION
/end MEASUREMENT
/begin MEASUREMENT MCore_Unconnected_StMon_139 "" UBYTE DefaultIdenticalCompu 1 100 0.0 255.0 MAX_REFRESH 4 1 ECU_ADDRESS 0x400D91BD
 /begin ANNOTATION ANNOTATION_LABEL "Description (coming from AUTOSAR DESC field)"
  /begin ANNOTATION_TEXT "Application data type for error type data elements. Error types are bit coded\r\n" /end ANNOTATION_TEXT
 /end ANNOTATION
/end MEASUREMENT
/begin MEASUREMENT MCore_Unconnected_StMon_140 "" UBYTE DefaultIdenticalCompu 1 100 0.0 255.0 MAX_REFRESH 4 1 ECU_ADDRESS 0x400D91BE
 /begin ANNOTATION ANNOTATION_LABEL "Description (coming from AUTOSAR DESC field)"
  /begin ANNOTATION_TEXT "Application data type for error type data elements. Error types are bit coded\r\n" /end ANNOTATION_TEXT
 /end ANNOTATION
/end MEASUREMENT
/begin MEASUREMENT MCore_Unconnected_StMon_142 "" UBYTE DefaultIdenticalCompu 1 100 0.0 255.0 MAX_REFRESH 4 1 ECU_ADDRESS 0x400D91BF
 /begin ANNOTATION ANNOTATION_LABEL "Description (coming from AUTOSAR DESC field)"
  /begin ANNOTATION_TEXT "Application data type for error type data elements. Error types are bit coded\r\n" /end ANNOTATION_TEXT
 /end ANNOTATION
/end MEASUREMENT
/begin MEASUREMENT MCore_StMon_143 "" UBYTE DefaultIdenticalCompu 1 100 0.0 255.0 MAX_REFRESH 4 1 ECU_ADDRESS 0x5280D2B2
 /begin ANNOTATION ANNOTATION_LABEL "Description (coming from AUTOSAR DESC field)"
  /begin ANNOTATION_TEXT "Application data type for error type data elements. Error types are bit coded\r\n" /end ANNOTATION_TEXT
 /end ANNOTATION
/end MEASUREMENT
/begin MEASUREMENT MCore_StMon_144 "" UBYTE DefaultIdenticalCompu 1 100 0.0 255.0 MAX_REFRESH 4 1 ECU_ADDRESS 0x5280D2B3
 /begin ANNOTATION ANNOTATION_LABEL "Description (coming from AUTOSAR DESC field)"
  /begin ANNOTATION_TEXT "Application data type for error type data elements. Error types are bit coded\r\n" /end ANNOTATION_TEXT
 /end ANNOTATION
/end MEASUREMENT
/begin MEASUREMENT MCore_StMon_145 "" UBYTE DefaultIdenticalCompu 1 100 0.0 255.0 MAX_REFRESH 4 1 ECU_ADDRESS 0x5280D2B4
 /begin ANNOTATION ANNOTATION_LABEL "Description (coming from AUTOSAR DESC field)"
  /begin ANNOTATION_TEXT "Application data type for error type data elements. Error types are bit coded\r\n" /end ANNOTATION_TEXT
 /end ANNOTATION
/end MEASUREMENT
/begin MEASUREMENT MCore_StMon_146 "" UBYTE DefaultIdenticalCompu 1 100 0.0 255.0 MAX_REFRESH 4 1 ECU_ADDRESS 0x5280D2B5
 /begin ANNOTATION ANNOTATION_LABEL "Description (coming from AUTOSAR DESC field)"
  /begin ANNOTATION_TEXT "Application data type for error type data elements. Error types are bit coded\r\n" /end ANNOTATION_TEXT
 /end ANNOTATION
/end MEASUREMENT
/begin MEASUREMENT MCore_StMon_147 "" UBYTE DefaultIdenticalCompu 1 100 0.0 255.0 MAX_REFRESH 4 1 ECU_ADDRESS 0x5280D2B6
 /begin ANNOTATION ANNOTATION_LABEL "Description (coming from AUTOSAR DESC field)"
  /begin ANNOTATION_TEXT "Application data type for error type data elements. Error types are bit coded\r\n" /end ANNOTATION_TEXT
 /end ANNOTATION
/end MEASUREMENT
/begin MEASUREMENT MCore_Unconnected_StMon_148 "" UBYTE DefaultIdenticalCompu 1 100 0.0 255.0 MAX_REFRESH 4 1 ECU_ADDRESS 0x400D91C0
 /begin ANNOTATION ANNOTATION_LABEL "Description (coming from AUTOSAR DESC field)"
  /begin ANNOTATION_TEXT "Application data type for error type data elements. Error types are bit coded\r\n" /end ANNOTATION_TEXT
 /end ANNOTATION
/end MEASUREMENT
/begin MEASUREMENT MCore_StMon_149 "" UBYTE DefaultIdenticalCompu 1 100 0.0 255.0 MAX_REFRESH 4 1 ECU_ADDRESS 0x5280D2B7
 /begin ANNOTATION ANNOTATION_LABEL "Description (coming from AUTOSAR DESC field)"
  /begin ANNOTATION_TEXT "Application data type for error type data elements. Error types are bit coded\r\n" /end ANNOTATION_TEXT
 /end ANNOTATION
/end MEASUREMENT
/begin MEASUREMENT MCore_StMon_150 "" UBYTE DefaultIdenticalCompu 1 100 0.0 255.0 MAX_REFRESH 4 1 ECU_ADDRESS 0x5280D2B8
 /begin ANNOTATION ANNOTATION_LABEL "Description (coming from AUTOSAR DESC field)"
  /begin ANNOTATION_TEXT "Application data type for error type data elements. Error types are bit coded\r\n" /end ANNOTATION_TEXT
 /end ANNOTATION
/end MEASUREMENT
/begin MEASUREMENT MCore_StMon_153 "" UBYTE DefaultIdenticalCompu 1 100 0.0 255.0 MAX_REFRESH 4 1 ECU_ADDRESS 0x5280D2B9
 /begin ANNOTATION ANNOTATION_LABEL "Description (coming from AUTOSAR DESC field)"
  /begin ANNOTATION_TEXT "Application data type for error type data elements. Error types are bit coded\r\n" /end ANNOTATION_TEXT
 /end ANNOTATION
/end MEASUREMENT
/begin MEASUREMENT MCore_StMon_154 "" UBYTE DefaultIdenticalCompu 1 100 0.0 255.0 MAX_REFRESH 4 1 ECU_ADDRESS 0x5280D2BA
 /begin ANNOTATION ANNOTATION_LABEL "Description (coming from AUTOSAR DESC field)"
  /begin ANNOTATION_TEXT "Application data type for error type data elements. Error types are bit coded\r\n" /end ANNOTATION_TEXT
 /end ANNOTATION
/end MEASUREMENT
/begin MEASUREMENT MCore_StMon_155 "" UBYTE DefaultIdenticalCompu 1 100 0.0 255.0 MAX_REFRESH 4 1 ECU_ADDRESS 0x5280D2BB
 /begin ANNOTATION ANNOTATION_LABEL "Description (coming from AUTOSAR DESC field)"
  /begin ANNOTATION_TEXT "Application data type for error type data elements. Error types are bit coded\r\n" /end ANNOTATION_TEXT
 /end ANNOTATION
/end MEASUREMENT
/begin MEASUREMENT MCore_StMon_156 "" UBYTE DefaultIdenticalCompu 1 100 0.0 255.0 MAX_REFRESH 4 1 ECU_ADDRESS 0x5280D2BC
 /begin ANNOTATION ANNOTATION_LABEL "Description (coming from AUTOSAR DESC field)"
  /begin ANNOTATION_TEXT "Application data type for error type data elements. Error types are bit coded\r\n" /end ANNOTATION_TEXT
 /end ANNOTATION
/end MEASUREMENT
/begin MEASUREMENT MCore_StMon_157 "" UBYTE DefaultIdenticalCompu 1 100 0.0 255.0 MAX_REFRESH 4 1 ECU_ADDRESS 0x5280D2BD
 /begin ANNOTATION ANNOTATION_LABEL "Description (coming from AUTOSAR DESC field)"
  /begin ANNOTATION_TEXT "Application data type for error type data elements. Error types are bit coded\r\n" /end ANNOTATION_TEXT
 /end ANNOTATION
/end MEASUREMENT
/begin MEASUREMENT MCore_Unconnected_StMon_159 "" UBYTE DefaultIdenticalCompu 1 100 0.0 255.0 MAX_REFRESH 4 1 ECU_ADDRESS 0x400D91C1
 /begin ANNOTATION ANNOTATION_LABEL "Description (coming from AUTOSAR DESC field)"
  /begin ANNOTATION_TEXT "Application data type for error type data elements. Error types are bit coded\r\n" /end ANNOTATION_TEXT
 /end ANNOTATION
/end MEASUREMENT
/begin MEASUREMENT MCore_StMon_160 "" UBYTE DefaultIdenticalCompu 1 100 0.0 255.0 MAX_REFRESH 4 1 ECU_ADDRESS 0x5280D2BE
 /begin ANNOTATION ANNOTATION_LABEL "Description (coming from AUTOSAR DESC field)"
  /begin ANNOTATION_TEXT "Application data type for error type data elements. Error types are bit coded\r\n" /end ANNOTATION_TEXT
 /end ANNOTATION
/end MEASUREMENT
/begin MEASUREMENT MCore_Unconnected_StMon_161 "" UBYTE DefaultIdenticalCompu 1 100 0.0 255.0 MAX_REFRESH 4 1 ECU_ADDRESS 0x400D91C2
 /begin ANNOTATION ANNOTATION_LABEL "Description (coming from AUTOSAR DESC field)"
  /begin ANNOTATION_TEXT "Application data type for error type data elements. Error types are bit coded\r\n" /end ANNOTATION_TEXT
 /end ANNOTATION
/end MEASUREMENT
/begin MEASUREMENT MCore_Unconnected_StMon_162 "" UBYTE DefaultIdenticalCompu 1 100 0.0 255.0 MAX_REFRESH 4 1 ECU_ADDRESS 0x400D91C3
 /begin ANNOTATION ANNOTATION_LABEL "Description (coming from AUTOSAR DESC field)"
  /begin ANNOTATION_TEXT "Application data type for error type data elements. Error types are bit coded\r\n" /end ANNOTATION_TEXT
 /end ANNOTATION
/end MEASUREMENT
/begin MEASUREMENT MCore_StMon_163 "" UBYTE DefaultIdenticalCompu 1 100 0.0 255.0 MAX_REFRESH 4 1 ECU_ADDRESS 0x5280D2BF
 /begin ANNOTATION ANNOTATION_LABEL "Description (coming from AUTOSAR DESC field)"
  /begin ANNOTATION_TEXT "Application data type for error type data elements. Error types are bit coded\r\n" /end ANNOTATION_TEXT
 /end ANNOTATION
/end MEASUREMENT
/begin MEASUREMENT MCore_Unconnected_StMon_164 "" UBYTE DefaultIdenticalCompu 1 100 0.0 255.0 MAX_REFRESH 4 1 ECU_ADDRESS 0x400D91C4
 /begin ANNOTATION ANNOTATION_LABEL "Description (coming from AUTOSAR DESC field)"
  /begin ANNOTATION_TEXT "Application data type for error type data elements. Error types are bit coded\r\n" /end ANNOTATION_TEXT
 /end ANNOTATION
/end MEASUREMENT
/begin MEASUREMENT MCore_StMon_165 "" UBYTE DefaultIdenticalCompu 1 100 0.0 255.0 MAX_REFRESH 4 1 ECU_ADDRESS 0x5280D2C0
 /begin ANNOTATION ANNOTATION_LABEL "Description (coming from AUTOSAR DESC field)"
  /begin ANNOTATION_TEXT "Application data type for error type data elements. Error types are bit coded\r\n" /end ANNOTATION_TEXT
 /end ANNOTATION
/end MEASUREMENT
/begin MEASUREMENT MCore_StMon_166 "" UBYTE DefaultIdenticalCompu 1 100 0.0 255.0 MAX_REFRESH 4 1 ECU_ADDRESS 0x5280D2C1
 /begin ANNOTATION ANNOTATION_LABEL "Description (coming from AUTOSAR DESC field)"
  /begin ANNOTATION_TEXT "Application data type for error type data elements. Error types are bit coded\r\n" /end ANNOTATION_TEXT
 /end ANNOTATION
/end MEASUREMENT
/begin MEASUREMENT MCore_Unconnected_StMon_167 "" UBYTE DefaultIdenticalCompu 1 100 0.0 255.0 MAX_REFRESH 4 1 ECU_ADDRESS 0x400D91C5
 /begin ANNOTATION ANNOTATION_LABEL "Description (coming from AUTOSAR DESC field)"
  /begin ANNOTATION_TEXT "Application data type for error type data elements. Error types are bit coded\r\n" /end ANNOTATION_TEXT
 /end ANNOTATION
/end MEASUREMENT
/begin MEASUREMENT MCore_StMon_168 "" UBYTE DefaultIdenticalCompu 1 100 0.0 255.0 MAX_REFRESH 4 1 ECU_ADDRESS 0x5280D2C2
 /begin ANNOTATION ANNOTATION_LABEL "Description (coming from AUTOSAR DESC field)"
  /begin ANNOTATION_TEXT "Application data type for error type data elements. Error types are bit coded\r\n" /end ANNOTATION_TEXT
 /end ANNOTATION
/end MEASUREMENT
/begin MEASUREMENT MCore_StMon_169 "" UBYTE DefaultIdenticalCompu 1 100 0.0 255.0 MAX_REFRESH 4 1 ECU_ADDRESS 0x5280D2C3
 /begin ANNOTATION ANNOTATION_LABEL "Description (coming from AUTOSAR DESC field)"
  /begin ANNOTATION_TEXT "Application data type for error type data elements. Error types are bit coded\r\n" /end ANNOTATION_TEXT
 /end ANNOTATION
/end MEASUREMENT
/begin MEASUREMENT MCore_StMon_170 "" UBYTE DefaultIdenticalCompu 1 100 0.0 255.0 MAX_REFRESH 4 1 ECU_ADDRESS 0x5280D2C4
 /begin ANNOTATION ANNOTATION_LABEL "Description (coming from AUTOSAR DESC field)"
  /begin ANNOTATION_TEXT "Application data type for error type data elements. Error types are bit coded\r\n" /end ANNOTATION_TEXT
 /end ANNOTATION
/end MEASUREMENT
/begin MEASUREMENT MCore_StMon_171 "" UBYTE DefaultIdenticalCompu 1 100 0.0 255.0 MAX_REFRESH 4 1 ECU_ADDRESS 0x5280D2C5
 /begin ANNOTATION ANNOTATION_LABEL "Description (coming from AUTOSAR DESC field)"
  /begin ANNOTATION_TEXT "Application data type for error type data elements. Error types are bit coded\r\n" /end ANNOTATION_TEXT
 /end ANNOTATION
/end MEASUREMENT
/begin MEASUREMENT MCore_StMon_172 "" UBYTE DefaultIdenticalCompu 1 100 0.0 255.0 MAX_REFRESH 4 1 ECU_ADDRESS 0x5280D2C6
 /begin ANNOTATION ANNOTATION_LABEL "Description (coming from AUTOSAR DESC field)"
  /begin ANNOTATION_TEXT "Application data type for error type data elements. Error types are bit coded\r\n" /end ANNOTATION_TEXT
 /end ANNOTATION
/end MEASUREMENT
/begin MEASUREMENT MCore_StMon_173 "" UBYTE DefaultIdenticalCompu 1 100 0.0 255.0 MAX_REFRESH 4 1 ECU_ADDRESS 0x5280D2C7
 /begin ANNOTATION ANNOTATION_LABEL "Description (coming from AUTOSAR DESC field)"
  /begin ANNOTATION_TEXT "Application data type for error type data elements. Error types are bit coded\r\n" /end ANNOTATION_TEXT
 /end ANNOTATION
/end MEASUREMENT
/begin MEASUREMENT MCore_Unconnected_StMon_174 "" UBYTE DefaultIdenticalCompu 1 100 0.0 255.0 MAX_REFRESH 4 1 ECU_ADDRESS 0x400D91C6
 /begin ANNOTATION ANNOTATION_LABEL "Description (coming from AUTOSAR DESC field)"
  /begin ANNOTATION_TEXT "Application data type for error type data elements. Error types are bit coded\r\n" /end ANNOTATION_TEXT
 /end ANNOTATION
/end MEASUREMENT
/begin MEASUREMENT MCore_StMon_175 "" UBYTE DefaultIdenticalCompu 1 100 0.0 255.0 MAX_REFRESH 4 1 ECU_ADDRESS 0x5280D2C8
 /begin ANNOTATION ANNOTATION_LABEL "Description (coming from AUTOSAR DESC field)"
  /begin ANNOTATION_TEXT "Application data type for error type data elements. Error types are bit coded\r\n" /end ANNOTATION_TEXT
 /end ANNOTATION
/end MEASUREMENT
/begin MEASUREMENT MCore_Unconnected_StMon_176 "" UBYTE DefaultIdenticalCompu 1 100 0.0 255.0 MAX_REFRESH 4 1 ECU_ADDRESS 0x400D91C7
 /begin ANNOTATION ANNOTATION_LABEL "Description (coming from AUTOSAR DESC field)"
  /begin ANNOTATION_TEXT "Application data type for error type data elements. Error types are bit coded\r\n" /end ANNOTATION_TEXT
 /end ANNOTATION
/end MEASUREMENT
/begin MEASUREMENT MCore_StMon_177 "" UBYTE DefaultIdenticalCompu 1 100 0.0 255.0 MAX_REFRESH 4 1 ECU_ADDRESS 0x5280D2C9
 /begin ANNOTATION ANNOTATION_LABEL "Description (coming from AUTOSAR DESC field)"
  /begin ANNOTATION_TEXT "Application data type for error type data elements. Error types are bit coded\r\n" /end ANNOTATION_TEXT
 /end ANNOTATION
/end MEASUREMENT
/begin MEASUREMENT MCore_Unconnected_StMon_178 "" UBYTE DefaultIdenticalCompu 1 100 0.0 255.0 MAX_REFRESH 4 1 ECU_ADDRESS 0x400D91C8
 /begin ANNOTATION ANNOTATION_LABEL "Description (coming from AUTOSAR DESC field)"
  /begin ANNOTATION_TEXT "Application data type for error type data elements. Error types are bit coded\r\n" /end ANNOTATION_TEXT
 /end ANNOTATION
/end MEASUREMENT
/begin MEASUREMENT MCore_Unconnected_StMon_182 "" UBYTE DefaultIdenticalCompu 1 100 0.0 255.0 MAX_REFRESH 4 1 ECU_ADDRESS 0x400D91C9
 /begin ANNOTATION ANNOTATION_LABEL "Description (coming from AUTOSAR DESC field)"
  /begin ANNOTATION_TEXT "Application data type for error type data elements. Error types are bit coded\r\n" /end ANNOTATION_TEXT
 /end ANNOTATION
/end MEASUREMENT
/begin MEASUREMENT MCore_Unconnected_StMon_188 "" UBYTE DefaultIdenticalCompu 1 100 0.0 255.0 MAX_REFRESH 4 1 ECU_ADDRESS 0x400D91CA
 /begin ANNOTATION ANNOTATION_LABEL "Description (coming from AUTOSAR DESC field)"
  /begin ANNOTATION_TEXT "Application data type for error type data elements. Error types are bit coded\r\n" /end ANNOTATION_TEXT
 /end ANNOTATION
/end MEASUREMENT
/begin MEASUREMENT MCore_Unconnected_StMon_189 "" UBYTE DefaultIdenticalCompu 1 100 0.0 255.0 MAX_REFRESH 4 1 ECU_ADDRESS 0x400D91CB
 /begin ANNOTATION ANNOTATION_LABEL "Description (coming from AUTOSAR DESC field)"
  /begin ANNOTATION_TEXT "Application data type for error type data elements. Error types are bit coded\r\n" /end ANNOTATION_TEXT
 /end ANNOTATION
/end MEASUREMENT
/begin MEASUREMENT MCore_StMon_191 "" UBYTE DefaultIdenticalCompu 1 100 0.0 255.0 MAX_REFRESH 4 1 ECU_ADDRESS 0x5280D2CA
 /begin ANNOTATION ANNOTATION_LABEL "Description (coming from AUTOSAR DESC field)"
  /begin ANNOTATION_TEXT "Application data type for error type data elements. Error types are bit coded\r\n" /end ANNOTATION_TEXT
 /end ANNOTATION
/end MEASUREMENT
/begin MEASUREMENT MCore_StMon_193 "" UBYTE DefaultIdenticalCompu 1 100 0.0 255.0 MAX_REFRESH 4 1 ECU_ADDRESS 0x5280D2CB
 /begin ANNOTATION ANNOTATION_LABEL "Description (coming from AUTOSAR DESC field)"
  /begin ANNOTATION_TEXT "Application data type for error type data elements. Error types are bit coded\r\n" /end ANNOTATION_TEXT
 /end ANNOTATION
/end MEASUREMENT
/begin MEASUREMENT MCore_Unconnected_StMon_194 "" UBYTE DefaultIdenticalCompu 1 100 0.0 255.0 MAX_REFRESH 4 1 ECU_ADDRESS 0x400D91CC
 /begin ANNOTATION ANNOTATION_LABEL "Description (coming from AUTOSAR DESC field)"
  /begin ANNOTATION_TEXT "Application data type for error type data elements. Error types are bit coded\r\n" /end ANNOTATION_TEXT
 /end ANNOTATION
/end MEASUREMENT
/begin MEASUREMENT MCore_StMon_196 "" UBYTE DefaultIdenticalCompu 1 100 0.0 255.0 MAX_REFRESH 4 1 ECU_ADDRESS 0x5280D2CC
 /begin ANNOTATION ANNOTATION_LABEL "Description (coming from AUTOSAR DESC field)"
  /begin ANNOTATION_TEXT "Application data type for error type data elements. Error types are bit coded\r\n" /end ANNOTATION_TEXT
 /end ANNOTATION
/end MEASUREMENT
/begin MEASUREMENT MCore_StMon_198 "" UBYTE DefaultIdenticalCompu 1 100 0.0 255.0 MAX_REFRESH 4 1 ECU_ADDRESS 0x5280D2CD
 /begin ANNOTATION ANNOTATION_LABEL "Description (coming from AUTOSAR DESC field)"
  /begin ANNOTATION_TEXT "Application data type for error type data elements. Error types are bit coded\r\n" /end ANNOTATION_TEXT
 /end ANNOTATION
/end MEASUREMENT
/begin MEASUREMENT MCore_StMon_199 "" UBYTE DefaultIdenticalCompu 1 100 0.0 255.0 MAX_REFRESH 4 1 ECU_ADDRESS 0x5280D2CE
 /begin ANNOTATION ANNOTATION_LABEL "Description (coming from AUTOSAR DESC field)"
  /begin ANNOTATION_TEXT "Application data type for error type data elements. Error types are bit coded\r\n" /end ANNOTATION_TEXT
 /end ANNOTATION
/end MEASUREMENT
/begin MEASUREMENT MCore_Unconnected_StMon_200 "" UBYTE DefaultIdenticalCompu 1 100 0.0 255.0 MAX_REFRESH 4 1 ECU_ADDRESS 0x400D91CD
 /begin ANNOTATION ANNOTATION_LABEL "Description (coming from AUTOSAR DESC field)"
  /begin ANNOTATION_TEXT "Application data type for error type data elements. Error types are bit coded\r\n" /end ANNOTATION_TEXT
 /end ANNOTATION
/end MEASUREMENT
/begin MEASUREMENT MCore_StMon_201 "" UBYTE DefaultIdenticalCompu 1 100 0.0 255.0 MAX_REFRESH 4 1 ECU_ADDRESS 0x5280D2CF
 /begin ANNOTATION ANNOTATION_LABEL "Description (coming from AUTOSAR DESC field)"
  /begin ANNOTATION_TEXT "Application data type for error type data elements. Error types are bit coded\r\n" /end ANNOTATION_TEXT
 /end ANNOTATION
/end MEASUREMENT
/begin MEASUREMENT MCore_StMon_203 "" UBYTE DefaultIdenticalCompu 1 100 0.0 255.0 MAX_REFRESH 4 1 ECU_ADDRESS 0x5280D2D0
 /begin ANNOTATION ANNOTATION_LABEL "Description (coming from AUTOSAR DESC field)"
  /begin ANNOTATION_TEXT "Application data type for error type data elements. Error types are bit coded\r\n" /end ANNOTATION_TEXT
 /end ANNOTATION
/end MEASUREMENT
/begin MEASUREMENT MCore_StMon_204 "" UBYTE DefaultIdenticalCompu 1 100 0.0 255.0 MAX_REFRESH 4 1 ECU_ADDRESS 0x5280D2D1
 /begin ANNOTATION ANNOTATION_LABEL "Description (coming from AUTOSAR DESC field)"
  /begin ANNOTATION_TEXT "Application data type for error type data elements. Error types are bit coded\r\n" /end ANNOTATION_TEXT
 /end ANNOTATION
/end MEASUREMENT
/begin MEASUREMENT MCore_Unconnected_StMon_205 "" UBYTE DefaultIdenticalCompu 1 100 0.0 255.0 MAX_REFRESH 4 1 ECU_ADDRESS 0x400D91CE
 /begin ANNOTATION ANNOTATION_LABEL "Description (coming from AUTOSAR DESC field)"
  /begin ANNOTATION_TEXT "Application data type for error type data elements. Error types are bit coded\r\n" /end ANNOTATION_TEXT
 /end ANNOTATION
/end MEASUREMENT
/begin MEASUREMENT MCore_StMon_206 "" UBYTE DefaultIdenticalCompu 1 100 0.0 255.0 MAX_REFRESH 4 1 ECU_ADDRESS 0x5280D2D2
 /begin ANNOTATION ANNOTATION_LABEL "Description (coming from AUTOSAR DESC field)"
  /begin ANNOTATION_TEXT "Application data type for error type data elements. Error types are bit coded\r\n" /end ANNOTATION_TEXT
 /end ANNOTATION
/end MEASUREMENT
/begin MEASUREMENT MCore_Unconnected_StMon_207 "" UBYTE DefaultIdenticalCompu 1 100 0.0 255.0 MAX_REFRESH 4 1 ECU_ADDRESS 0x400D91CF
 /begin ANNOTATION ANNOTATION_LABEL "Description (coming from AUTOSAR DESC field)"
  /begin ANNOTATION_TEXT "Application data type for error type data elements. Error types are bit coded\r\n" /end ANNOTATION_TEXT
 /end ANNOTATION
/end MEASUREMENT
/begin MEASUREMENT MCore_Unconnected_StMon_210 "" UBYTE DefaultIdenticalCompu 1 100 0.0 255.0 MAX_REFRESH 4 1 ECU_ADDRESS 0x400D91D0
 /begin ANNOTATION ANNOTATION_LABEL "Description (coming from AUTOSAR DESC field)"
  /begin ANNOTATION_TEXT "Application data type for error type data elements. Error types are bit coded\r\n" /end ANNOTATION_TEXT
 /end ANNOTATION
/end MEASUREMENT
/begin MEASUREMENT MCore_StMon_211 "" UBYTE DefaultIdenticalCompu 1 100 0.0 255.0 MAX_REFRESH 4 1 ECU_ADDRESS 0x5280D2D3
 /begin ANNOTATION ANNOTATION_LABEL "Description (coming from AUTOSAR DESC field)"
  /begin ANNOTATION_TEXT "Application data type for error type data elements. Error types are bit coded\r\n" /end ANNOTATION_TEXT
 /end ANNOTATION
/end MEASUREMENT
/begin MEASUREMENT MCore_Unconnected_StMon_212 "" UBYTE DefaultIdenticalCompu 1 100 0.0 255.0 MAX_REFRESH 4 1 ECU_ADDRESS 0x400D91D1
 /begin ANNOTATION ANNOTATION_LABEL "Description (coming from AUTOSAR DESC field)"
  /begin ANNOTATION_TEXT "Application data type for error type data elements. Error types are bit coded\r\n" /end ANNOTATION_TEXT
 /end ANNOTATION
/end MEASUREMENT
/begin MEASUREMENT MCore_StMon_213 "" UBYTE DefaultIdenticalCompu 1 100 0.0 255.0 MAX_REFRESH 4 1 ECU_ADDRESS 0x400D91D2
 /begin ANNOTATION ANNOTATION_LABEL "Description (coming from AUTOSAR DESC field)"
  /begin ANNOTATION_TEXT "Application data type for error type data elements. Error types are bit coded\r\n" /end ANNOTATION_TEXT
 /end ANNOTATION
/end MEASUREMENT
/begin MEASUREMENT MCore_Unconnected_StMon_214 "" UBYTE DefaultIdenticalCompu 1 100 0.0 255.0 MAX_REFRESH 4 1 ECU_ADDRESS 0x400D91D3
 /begin ANNOTATION ANNOTATION_LABEL "Description (coming from AUTOSAR DESC field)"
  /begin ANNOTATION_TEXT "Application data type for error type data elements. Error types are bit coded\r\n" /end ANNOTATION_TEXT
 /end ANNOTATION
/end MEASUREMENT
/begin MEASUREMENT MCore_Unconnected_StMon_215 "" UBYTE DefaultIdenticalCompu 1 100 0.0 255.0 MAX_REFRESH 4 1 ECU_ADDRESS 0x400D91D4
 /begin ANNOTATION ANNOTATION_LABEL "Description (coming from AUTOSAR DESC field)"
  /begin ANNOTATION_TEXT "Application data type for error type data elements. Error types are bit coded\r\n" /end ANNOTATION_TEXT
 /end ANNOTATION
/end MEASUREMENT
/begin MEASUREMENT MCore_StMon_218 "" UBYTE DefaultIdenticalCompu 1 100 0.0 255.0 MAX_REFRESH 4 1 ECU_ADDRESS 0x5280D2D4
 /begin ANNOTATION ANNOTATION_LABEL "Description (coming from AUTOSAR DESC field)"
  /begin ANNOTATION_TEXT "Application data type for error type data elements. Error types are bit coded\r\n" /end ANNOTATION_TEXT
 /end ANNOTATION
/end MEASUREMENT
/begin MEASUREMENT MCore_StMon_219 "" UBYTE DefaultIdenticalCompu 1 100 0.0 255.0 MAX_REFRESH 4 1 ECU_ADDRESS 0x5280D2D5
 /begin ANNOTATION ANNOTATION_LABEL "Description (coming from AUTOSAR DESC field)"
  /begin ANNOTATION_TEXT "Application data type for error type data elements. Error types are bit coded\r\n" /end ANNOTATION_TEXT
 /end ANNOTATION
/end MEASUREMENT
/begin MEASUREMENT MCore_StMon_220 "" UBYTE DefaultIdenticalCompu 1 100 0.0 255.0 MAX_REFRESH 4 1 ECU_ADDRESS 0x5280D2D6
 /begin ANNOTATION ANNOTATION_LABEL "Description (coming from AUTOSAR DESC field)"
  /begin ANNOTATION_TEXT "Application data type for error type data elements. Error types are bit coded\r\n" /end ANNOTATION_TEXT
 /end ANNOTATION
/end MEASUREMENT
/begin MEASUREMENT MCore_Unconnected_StMon_221 "" UBYTE DefaultIdenticalCompu 1 100 0.0 255.0 MAX_REFRESH 4 1 ECU_ADDRESS 0x400D91D5
 /begin ANNOTATION ANNOTATION_LABEL "Description (coming from AUTOSAR DESC field)"
  /begin ANNOTATION_TEXT "Application data type for error type data elements. Error types are bit coded\r\n" /end ANNOTATION_TEXT
 /end ANNOTATION
/end MEASUREMENT
/begin MEASUREMENT MCore_StMon_222 "" UBYTE DefaultIdenticalCompu 1 100 0.0 255.0 MAX_REFRESH 4 1 ECU_ADDRESS 0x5280D2D7
 /begin ANNOTATION ANNOTATION_LABEL "Description (coming from AUTOSAR DESC field)"
  /begin ANNOTATION_TEXT "Application data type for error type data elements. Error types are bit coded\r\n" /end ANNOTATION_TEXT
 /end ANNOTATION
/end MEASUREMENT
/begin MEASUREMENT MCore_Unconnected_StMon_223 "" UBYTE DefaultIdenticalCompu 1 100 0.0 255.0 MAX_REFRESH 4 1 ECU_ADDRESS 0x400D91D6
 /begin ANNOTATION ANNOTATION_LABEL "Description (coming from AUTOSAR DESC field)"
  /begin ANNOTATION_TEXT "Application data type for error type data elements. Error types are bit coded\r\n" /end ANNOTATION_TEXT
 /end ANNOTATION
/end MEASUREMENT
/begin MEASUREMENT MCore_StMon_224 "" UBYTE DefaultIdenticalCompu 1 100 0.0 255.0 MAX_REFRESH 4 1 ECU_ADDRESS 0x5280D2D8
 /begin ANNOTATION ANNOTATION_LABEL "Description (coming from AUTOSAR DESC field)"
  /begin ANNOTATION_TEXT "Application data type for error type data elements. Error types are bit coded\r\n" /end ANNOTATION_TEXT
 /end ANNOTATION
/end MEASUREMENT
/begin MEASUREMENT MCore_Unconnected_StMon_225 "" UBYTE DefaultIdenticalCompu 1 100 0.0 255.0 MAX_REFRESH 4 1 ECU_ADDRESS 0x400D91D7
 /begin ANNOTATION ANNOTATION_LABEL "Description (coming from AUTOSAR DESC field)"
  /begin ANNOTATION_TEXT "Application data type for error type data elements. Error types are bit coded\r\n" /end ANNOTATION_TEXT
 /end ANNOTATION
/end MEASUREMENT
/begin MEASUREMENT MCore_StMon_226 "" UBYTE DefaultIdenticalCompu 1 100 0.0 255.0 MAX_REFRESH 4 1 ECU_ADDRESS 0x5280D2D9
 /begin ANNOTATION ANNOTATION_LABEL "Description (coming from AUTOSAR DESC field)"
  /begin ANNOTATION_TEXT "Application data type for error type data elements. Error types are bit coded\r\n" /end ANNOTATION_TEXT
 /end ANNOTATION
/end MEASUREMENT
/begin MEASUREMENT MCore_Unconnected_StMon_227 "" UBYTE DefaultIdenticalCompu 1 100 0.0 255.0 MAX_REFRESH 4 1 ECU_ADDRESS 0x400D91D8
 /begin ANNOTATION ANNOTATION_LABEL "Description (coming from AUTOSAR DESC field)"
  /begin ANNOTATION_TEXT "Application data type for error type data elements. Error types are bit coded\r\n" /end ANNOTATION_TEXT
 /end ANNOTATION
/end MEASUREMENT
/begin MEASUREMENT MCore_StMon_228 "" UBYTE DefaultIdenticalCompu 1 100 0.0 255.0 MAX_REFRESH 4 1 ECU_ADDRESS 0x5280D2DA
 /begin ANNOTATION ANNOTATION_LABEL "Description (coming from AUTOSAR DESC field)"
  /begin ANNOTATION_TEXT "Application data type for error type data elements. Error types are bit coded\r\n" /end ANNOTATION_TEXT
 /end ANNOTATION
/end MEASUREMENT
/begin MEASUREMENT MCore_Unconnected_StMon_229 "" UBYTE DefaultIdenticalCompu 1 100 0.0 255.0 MAX_REFRESH 4 1 ECU_ADDRESS 0x400D91D9
 /begin ANNOTATION ANNOTATION_LABEL "Description (coming from AUTOSAR DESC field)"
  /begin ANNOTATION_TEXT "Application data type for error type data elements. Error types are bit coded\r\n" /end ANNOTATION_TEXT
 /end ANNOTATION
/end MEASUREMENT
/begin MEASUREMENT MCore_StMon_230 "" UBYTE DefaultIdenticalCompu 1 100 0.0 255.0 MAX_REFRESH 4 1 ECU_ADDRESS 0x5280D2DB
 /begin ANNOTATION ANNOTATION_LABEL "Description (coming from AUTOSAR DESC field)"
  /begin ANNOTATION_TEXT "Application data type for error type data elements. Error types are bit coded\r\n" /end ANNOTATION_TEXT
 /end ANNOTATION
/end MEASUREMENT
/begin MEASUREMENT MCore_StMon_232 "" UBYTE DefaultIdenticalCompu 1 100 0.0 255.0 MAX_REFRESH 4 1 ECU_ADDRESS 0x5280D2DC
 /begin ANNOTATION ANNOTATION_LABEL "Description (coming from AUTOSAR DESC field)"
  /begin ANNOTATION_TEXT "Application data type for error type data elements. Error types are bit coded\r\n" /end ANNOTATION_TEXT
 /end ANNOTATION
/end MEASUREMENT
/begin MEASUREMENT MCore_StMon_234 "" UBYTE DefaultIdenticalCompu 1 100 0.0 255.0 MAX_REFRESH 4 1 ECU_ADDRESS 0x5280D2DD
 /begin ANNOTATION ANNOTATION_LABEL "Description (coming from AUTOSAR DESC field)"
  /begin ANNOTATION_TEXT "Application data type for error type data elements. Error types are bit coded\r\n" /end ANNOTATION_TEXT
 /end ANNOTATION
/end MEASUREMENT
/begin MEASUREMENT MCore_StMon_235 "" UBYTE DefaultIdenticalCompu 1 100 0.0 255.0 MAX_REFRESH 4 1 ECU_ADDRESS 0x5280D2DE
 /begin ANNOTATION ANNOTATION_LABEL "Description (coming from AUTOSAR DESC field)"
  /begin ANNOTATION_TEXT "Application data type for error type data elements. Error types are bit coded\r\n" /end ANNOTATION_TEXT
 /end ANNOTATION
/end MEASUREMENT
/begin MEASUREMENT MCore_StMon_236 "" UBYTE DefaultIdenticalCompu 1 100 0.0 255.0 MAX_REFRESH 4 1 ECU_ADDRESS 0x5280D2DF
 /begin ANNOTATION ANNOTATION_LABEL "Description (coming from AUTOSAR DESC field)"
  /begin ANNOTATION_TEXT "Application data type for error type data elements. Error types are bit coded\r\n" /end ANNOTATION_TEXT
 /end ANNOTATION
/end MEASUREMENT
/begin MEASUREMENT MCore_StMon_238 "" UBYTE DefaultIdenticalCompu 1 100 0.0 255.0 MAX_REFRESH 4 1 ECU_ADDRESS 0x5280D2E0
 /begin ANNOTATION ANNOTATION_LABEL "Description (coming from AUTOSAR DESC field)"
  /begin ANNOTATION_TEXT "Application data type for error type data elements. Error types are bit coded\r\n" /end ANNOTATION_TEXT
 /end ANNOTATION
/end MEASUREMENT
/begin MEASUREMENT MCore_StMon_241 "" UBYTE DefaultIdenticalCompu 1 100 0.0 255.0 MAX_REFRESH 4 1 ECU_ADDRESS 0x5280D2E1
 /begin ANNOTATION ANNOTATION_LABEL "Description (coming from AUTOSAR DESC field)"
  /begin ANNOTATION_TEXT "Application data type for error type data elements. Error types are bit coded\r\n" /end ANNOTATION_TEXT
 /end ANNOTATION
/end MEASUREMENT
/begin MEASUREMENT MCore_StMon_243 "" UBYTE DefaultIdenticalCompu 1 100 0.0 255.0 MAX_REFRESH 4 1 ECU_ADDRESS 0x5280D2E2
 /begin ANNOTATION ANNOTATION_LABEL "Description (coming from AUTOSAR DESC field)"
  /begin ANNOTATION_TEXT "Application data type for error type data elements. Error types are bit coded\r\n" /end ANNOTATION_TEXT
 /end ANNOTATION
/end MEASUREMENT
/begin MEASUREMENT MCore_StMon_245 "" UBYTE DefaultIdenticalCompu 1 100 0.0 255.0 MAX_REFRESH 4 1 ECU_ADDRESS 0x5280D2E3
 /begin ANNOTATION ANNOTATION_LABEL "Description (coming from AUTOSAR DESC field)"
  /begin ANNOTATION_TEXT "Application data type for error type data elements. Error types are bit coded\r\n" /end ANNOTATION_TEXT
 /end ANNOTATION
/end MEASUREMENT
/begin MEASUREMENT MCore_StMon_247 "" UBYTE DefaultIdenticalCompu 1 100 0.0 255.0 MAX_REFRESH 4 1 ECU_ADDRESS 0x5280D2E4
 /begin ANNOTATION ANNOTATION_LABEL "Description (coming from AUTOSAR DESC field)"
  /begin ANNOTATION_TEXT "Application data type for error type data elements. Error types are bit coded\r\n" /end ANNOTATION_TEXT
 /end ANNOTATION
/end MEASUREMENT
/begin MEASUREMENT MCore_StMon_248 "" UBYTE DefaultIdenticalCompu 1 100 0.0 255.0 MAX_REFRESH 4 1 ECU_ADDRESS 0x5280D2E5
 /begin ANNOTATION ANNOTATION_LABEL "Description (coming from AUTOSAR DESC field)"
  /begin ANNOTATION_TEXT "Application data type for error type data elements. Error types are bit coded\r\n" /end ANNOTATION_TEXT
 /end ANNOTATION
/end MEASUREMENT
/begin MEASUREMENT MCore_StMon_250 "" UBYTE DefaultIdenticalCompu 1 100 0.0 255.0 MAX_REFRESH 4 1 ECU_ADDRESS 0x5280D2E6
 /begin ANNOTATION ANNOTATION_LABEL "Description (coming from AUTOSAR DESC field)"
  /begin ANNOTATION_TEXT "Application data type for error type data elements. Error types are bit coded\r\n" /end ANNOTATION_TEXT
 /end ANNOTATION
/end MEASUREMENT
/begin MEASUREMENT MCore_StMon_252 "" UBYTE DefaultIdenticalCompu 1 100 0.0 255.0 MAX_REFRESH 4 1 ECU_ADDRESS 0x5280D2E7
 /begin ANNOTATION ANNOTATION_LABEL "Description (coming from AUTOSAR DESC field)"
  /begin ANNOTATION_TEXT "Application data type for error type data elements. Error types are bit coded\r\n" /end ANNOTATION_TEXT
 /end ANNOTATION
/end MEASUREMENT
/begin MEASUREMENT MCore_StMon_253 "" UBYTE DefaultIdenticalCompu 1 100 0.0 255.0 MAX_REFRESH 4 1 ECU_ADDRESS 0x5280D2E8
 /begin ANNOTATION ANNOTATION_LABEL "Description (coming from AUTOSAR DESC field)"
  /begin ANNOTATION_TEXT "Application data type for error type data elements. Error types are bit coded\r\n" /end ANNOTATION_TEXT
 /end ANNOTATION
/end MEASUREMENT
/begin MEASUREMENT MCore_Unconnected_StMon_254 "" UBYTE DefaultIdenticalCompu 1 100 0.0 255.0 MAX_REFRESH 4 1 ECU_ADDRESS 0x400D91DA
 /begin ANNOTATION ANNOTATION_LABEL "Description (coming from AUTOSAR DESC field)"
  /begin ANNOTATION_TEXT "Application data type for error type data elements. Error types are bit coded\r\n" /end ANNOTATION_TEXT
 /end ANNOTATION
/end MEASUREMENT
/begin MEASUREMENT MCore_Unconnected_StMon_255 "" UBYTE DefaultIdenticalCompu 1 100 0.0 255.0 MAX_REFRESH 4 1 ECU_ADDRESS 0x400D91DB
 /begin ANNOTATION ANNOTATION_LABEL "Description (coming from AUTOSAR DESC field)"
  /begin ANNOTATION_TEXT "Application data type for error type data elements. Error types are bit coded\r\n" /end ANNOTATION_TEXT
 /end ANNOTATION
/end MEASUREMENT
/begin MEASUREMENT MCore_Unconnected_StMon_256 "" UBYTE DefaultIdenticalCompu 1 100 0.0 255.0 MAX_REFRESH 4 1 ECU_ADDRESS 0x400D91DC
 /begin ANNOTATION ANNOTATION_LABEL "Description (coming from AUTOSAR DESC field)"
  /begin ANNOTATION_TEXT "Application data type for error type data elements. Error types are bit coded\r\n" /end ANNOTATION_TEXT
 /end ANNOTATION
/end MEASUREMENT
/begin MEASUREMENT MCore_StMon_257 "" UBYTE DefaultIdenticalCompu 1 100 0.0 255.0 MAX_REFRESH 4 1 ECU_ADDRESS 0x5280D2E9
 /begin ANNOTATION ANNOTATION_LABEL "Description (coming from AUTOSAR DESC field)"
  /begin ANNOTATION_TEXT "Application data type for error type data elements. Error types are bit coded\r\n" /end ANNOTATION_TEXT
 /end ANNOTATION
/end MEASUREMENT
/begin MEASUREMENT MCore_Unconnected_StMon_258 "" UBYTE DefaultIdenticalCompu 1 100 0.0 255.0 MAX_REFRESH 4 1 ECU_ADDRESS 0x400D91DD
 /begin ANNOTATION ANNOTATION_LABEL "Description (coming from AUTOSAR DESC field)"
  /begin ANNOTATION_TEXT "Application data type for error type data elements. Error types are bit coded\r\n" /end ANNOTATION_TEXT
 /end ANNOTATION
/end MEASUREMENT
/begin MEASUREMENT MCore_StMon_259 "" UBYTE DefaultIdenticalCompu 1 100 0.0 255.0 MAX_REFRESH 4 1 ECU_ADDRESS 0x5280D2EA
 /begin ANNOTATION ANNOTATION_LABEL "Description (coming from AUTOSAR DESC field)"
  /begin ANNOTATION_TEXT "Application data type for error type data elements. Error types are bit coded\r\n" /end ANNOTATION_TEXT
 /end ANNOTATION
/end MEASUREMENT
/begin MEASUREMENT MCore_StMon_261 "" UBYTE DefaultIdenticalCompu 1 100 0.0 255.0 MAX_REFRESH 4 1 ECU_ADDRESS 0x5280D2EB
 /begin ANNOTATION ANNOTATION_LABEL "Description (coming from AUTOSAR DESC field)"
  /begin ANNOTATION_TEXT "Application data type for error type data elements. Error types are bit coded\r\n" /end ANNOTATION_TEXT
 /end ANNOTATION
/end MEASUREMENT
/begin MEASUREMENT MCore_StMon_263 "" UBYTE DefaultIdenticalCompu 1 100 0.0 255.0 MAX_REFRESH 4 1 ECU_ADDRESS 0x5280D2EC
 /begin ANNOTATION ANNOTATION_LABEL "Description (coming from AUTOSAR DESC field)"
  /begin ANNOTATION_TEXT "Application data type for error type data elements. Error types are bit coded\r\n" /end ANNOTATION_TEXT
 /end ANNOTATION
/end MEASUREMENT
/begin MEASUREMENT MCore_Unconnected_StMon_264 "" UBYTE DefaultIdenticalCompu 1 100 0.0 255.0 MAX_REFRESH 4 1 ECU_ADDRESS 0x400D91DE
 /begin ANNOTATION ANNOTATION_LABEL "Description (coming from AUTOSAR DESC field)"
  /begin ANNOTATION_TEXT "Application data type for error type data elements. Error types are bit coded\r\n" /end ANNOTATION_TEXT
 /end ANNOTATION
/end MEASUREMENT
/begin MEASUREMENT MCore_Unconnected_StMon_266 "" UBYTE DefaultIdenticalCompu 1 100 0.0 255.0 MAX_REFRESH 4 1 ECU_ADDRESS 0x400D91DF
 /begin ANNOTATION ANNOTATION_LABEL "Description (coming from AUTOSAR DESC field)"
  /begin ANNOTATION_TEXT "Application data type for error type data elements. Error types are bit coded\r\n" /end ANNOTATION_TEXT
 /end ANNOTATION
/end MEASUREMENT
/begin MEASUREMENT MCore_StMon_267 "" UBYTE DefaultIdenticalCompu 1 100 0.0 255.0 MAX_REFRESH 4 1 ECU_ADDRESS 0x5280D2ED
 /begin ANNOTATION ANNOTATION_LABEL "Description (coming from AUTOSAR DESC field)"
  /begin ANNOTATION_TEXT "Application data type for error type data elements. Error types are bit coded\r\n" /end ANNOTATION_TEXT
 /end ANNOTATION
/end MEASUREMENT
/begin MEASUREMENT MCore_Unconnected_StMon_268 "" UBYTE DefaultIdenticalCompu 1 100 0.0 255.0 MAX_REFRESH 4 1 ECU_ADDRESS 0x400D91E0
 /begin ANNOTATION ANNOTATION_LABEL "Description (coming from AUTOSAR DESC field)"
  /begin ANNOTATION_TEXT "Application data type for error type data elements. Error types are bit coded\r\n" /end ANNOTATION_TEXT
 /end ANNOTATION
/end MEASUREMENT
/begin MEASUREMENT MCore_Unconnected_StMon_269 "" UBYTE DefaultIdenticalCompu 1 100 0.0 255.0 MAX_REFRESH 4 1 ECU_ADDRESS 0x400D91E1
 /begin ANNOTATION ANNOTATION_LABEL "Description (coming from AUTOSAR DESC field)"
  /begin ANNOTATION_TEXT "Application data type for error type data elements. Error types are bit coded\r\n" /end ANNOTATION_TEXT
 /end ANNOTATION
/end MEASUREMENT
/begin MEASUREMENT MCore_StMon_270 "" UBYTE DefaultIdenticalCompu 1 100 0.0 255.0 MAX_REFRESH 4 1 ECU_ADDRESS 0x5280D2EE
 /begin ANNOTATION ANNOTATION_LABEL "Description (coming from AUTOSAR DESC field)"
  /begin ANNOTATION_TEXT "Application data type for error type data elements. Error types are bit coded\r\n" /end ANNOTATION_TEXT
 /end ANNOTATION
/end MEASUREMENT
/begin MEASUREMENT MCore_StMon_273 "" UBYTE DefaultIdenticalCompu 1 100 0.0 255.0 MAX_REFRESH 4 1 ECU_ADDRESS 0x5280D2EF
 /begin ANNOTATION ANNOTATION_LABEL "Description (coming from AUTOSAR DESC field)"
  /begin ANNOTATION_TEXT "Application data type for error type data elements. Error types are bit coded\r\n" /end ANNOTATION_TEXT
 /end ANNOTATION
/end MEASUREMENT
/begin MEASUREMENT MCore_Unconnected_StMon_274 "" UBYTE DefaultIdenticalCompu 1 100 0.0 255.0 MAX_REFRESH 4 1 ECU_ADDRESS 0x400D91E2
 /begin ANNOTATION ANNOTATION_LABEL "Description (coming from AUTOSAR DESC field)"
  /begin ANNOTATION_TEXT "Application data type for error type data elements. Error types are bit coded\r\n" /end ANNOTATION_TEXT
 /end ANNOTATION
/end MEASUREMENT
/begin MEASUREMENT MCore_StMon_276 "" UBYTE DefaultIdenticalCompu 1 100 0.0 255.0 MAX_REFRESH 4 1 ECU_ADDRESS 0x5280D2F0
 /begin ANNOTATION ANNOTATION_LABEL "Description (coming from AUTOSAR DESC field)"
  /begin ANNOTATION_TEXT "Application data type for error type data elements. Error types are bit coded\r\n" /end ANNOTATION_TEXT
 /end ANNOTATION
/end MEASUREMENT
/begin MEASUREMENT MCore_Unconnected_StMon_279 "" UBYTE DefaultIdenticalCompu 1 100 0.0 255.0 MAX_REFRESH 4 1 ECU_ADDRESS 0x400D91E3
 /begin ANNOTATION ANNOTATION_LABEL "Description (coming from AUTOSAR DESC field)"
  /begin ANNOTATION_TEXT "Application data type for error type data elements. Error types are bit coded\r\n" /end ANNOTATION_TEXT
 /end ANNOTATION
/end MEASUREMENT
/begin MEASUREMENT MCore_StMon_280 "" UBYTE DefaultIdenticalCompu 1 100 0.0 255.0 MAX_REFRESH 4 1 ECU_ADDRESS 0x5280D2F1
 /begin ANNOTATION ANNOTATION_LABEL "Description (coming from AUTOSAR DESC field)"
  /begin ANNOTATION_TEXT "Application data type for error type data elements. Error types are bit coded\r\n" /end ANNOTATION_TEXT
 /end ANNOTATION
/end MEASUREMENT
/begin MEASUREMENT MCore_StMon_281 "" UBYTE DefaultIdenticalCompu 1 100 0.0 255.0 MAX_REFRESH 4 1 ECU_ADDRESS 0x5280D2F2
 /begin ANNOTATION ANNOTATION_LABEL "Description (coming from AUTOSAR DESC field)"
  /begin ANNOTATION_TEXT "Application data type for error type data elements. Error types are bit coded\r\n" /end ANNOTATION_TEXT
 /end ANNOTATION
/end MEASUREMENT
/begin MEASUREMENT MCore_StMon_282 "" UBYTE DefaultIdenticalCompu 1 100 0.0 255.0 MAX_REFRESH 4 1 ECU_ADDRESS 0x5280D2F3
 /begin ANNOTATION ANNOTATION_LABEL "Description (coming from AUTOSAR DESC field)"
  /begin ANNOTATION_TEXT "Application data type for error type data elements. Error types are bit coded\r\n" /end ANNOTATION_TEXT
 /end ANNOTATION
/end MEASUREMENT
/begin MEASUREMENT MCore_Unconnected_StMon_286 "" UBYTE DefaultIdenticalCompu 1 100 0.0 255.0 MAX_REFRESH 4 1 ECU_ADDRESS 0x400D91E4
 /begin ANNOTATION ANNOTATION_LABEL "Description (coming from AUTOSAR DESC field)"
  /begin ANNOTATION_TEXT "Application data type for error type data elements. Error types are bit coded\r\n" /end ANNOTATION_TEXT
 /end ANNOTATION
/end MEASUREMENT
/begin MEASUREMENT MCore_Unconnected_StMon_287 "" UBYTE DefaultIdenticalCompu 1 100 0.0 255.0 MAX_REFRESH 4 1 ECU_ADDRESS 0x400D91E5
 /begin ANNOTATION ANNOTATION_LABEL "Description (coming from AUTOSAR DESC field)"
  /begin ANNOTATION_TEXT "Application data type for error type data elements. Error types are bit coded\r\n" /end ANNOTATION_TEXT
 /end ANNOTATION
/end MEASUREMENT
/begin MEASUREMENT MCore_Unconnected_StMon_288 "" UBYTE DefaultIdenticalCompu 1 100 0.0 255.0 MAX_REFRESH 4 1 ECU_ADDRESS 0x400D91E6
 /begin ANNOTATION ANNOTATION_LABEL "Description (coming from AUTOSAR DESC field)"
  /begin ANNOTATION_TEXT "Application data type for error type data elements. Error types are bit coded\r\n" /end ANNOTATION_TEXT
 /end ANNOTATION
/end MEASUREMENT
/begin MEASUREMENT MCore_Unconnected_StMon_289 "" UBYTE DefaultIdenticalCompu 1 100 0.0 255.0 MAX_REFRESH 4 1 ECU_ADDRESS 0x400D91E7
 /begin ANNOTATION ANNOTATION_LABEL "Description (coming from AUTOSAR DESC field)"
  /begin ANNOTATION_TEXT "Application data type for error type data elements. Error types are bit coded\r\n" /end ANNOTATION_TEXT
 /end ANNOTATION
/end MEASUREMENT
/begin MEASUREMENT MCore_Unconnected_StMon_290 "" UBYTE DefaultIdenticalCompu 1 100 0.0 255.0 MAX_REFRESH 4 1 ECU_ADDRESS 0x400D91E8
 /begin ANNOTATION ANNOTATION_LABEL "Description (coming from AUTOSAR DESC field)"
  /begin ANNOTATION_TEXT "Application data type for error type data elements. Error types are bit coded\r\n" /end ANNOTATION_TEXT
 /end ANNOTATION
/end MEASUREMENT
/begin MEASUREMENT MCore_Unconnected_StMon_292 "" UBYTE DefaultIdenticalCompu 1 100 0.0 255.0 MAX_REFRESH 4 1 ECU_ADDRESS 0x400D91E9
 /begin ANNOTATION ANNOTATION_LABEL "Description (coming from AUTOSAR DESC field)"
  /begin ANNOTATION_TEXT "Application data type for error type data elements. Error types are bit coded\r\n" /end ANNOTATION_TEXT
 /end ANNOTATION
/end MEASUREMENT
/begin MEASUREMENT MCore_Unconnected_StMon_293 "" UBYTE DefaultIdenticalCompu 1 100 0.0 255.0 MAX_REFRESH 4 1 ECU_ADDRESS 0x400D91EA
 /begin ANNOTATION ANNOTATION_LABEL "Description (coming from AUTOSAR DESC field)"
  /begin ANNOTATION_TEXT "Application data type for error type data elements. Error types are bit coded\r\n" /end ANNOTATION_TEXT
 /end ANNOTATION
/end MEASUREMENT
/begin MEASUREMENT MCore_StMon_294 "" UBYTE DefaultIdenticalCompu 1 100 0.0 255.0 MAX_REFRESH 4 1 ECU_ADDRESS 0x5280D2F4
 /begin ANNOTATION ANNOTATION_LABEL "Description (coming from AUTOSAR DESC field)"
  /begin ANNOTATION_TEXT "Application data type for error type data elements. Error types are bit coded\r\n" /end ANNOTATION_TEXT
 /end ANNOTATION
/end MEASUREMENT
/begin MEASUREMENT MCore_Unconnected_StMon_295 "" UBYTE DefaultIdenticalCompu 1 100 0.0 255.0 MAX_REFRESH 4 1 ECU_ADDRESS 0x400D91EB
 /begin ANNOTATION ANNOTATION_LABEL "Description (coming from AUTOSAR DESC field)"
  /begin ANNOTATION_TEXT "Application data type for error type data elements. Error types are bit coded\r\n" /end ANNOTATION_TEXT
 /end ANNOTATION
/end MEASUREMENT
/begin MEASUREMENT MCore_Unconnected_StMon_296 "" UBYTE DefaultIdenticalCompu 1 100 0.0 255.0 MAX_REFRESH 4 1 ECU_ADDRESS 0x400D91EC
 /begin ANNOTATION ANNOTATION_LABEL "Description (coming from AUTOSAR DESC field)"
  /begin ANNOTATION_TEXT "Application data type for error type data elements. Error types are bit coded\r\n" /end ANNOTATION_TEXT
 /end ANNOTATION
/end MEASUREMENT
/begin MEASUREMENT MCore_Unconnected_StMon_297 "" UBYTE DefaultIdenticalCompu 1 100 0.0 255.0 MAX_REFRESH 4 1 ECU_ADDRESS 0x400D91ED
 /begin ANNOTATION ANNOTATION_LABEL "Description (coming from AUTOSAR DESC field)"
  /begin ANNOTATION_TEXT "Application data type for error type data elements. Error types are bit coded\r\n" /end ANNOTATION_TEXT
 /end ANNOTATION
/end MEASUREMENT
/begin MEASUREMENT MCore_Unconnected_StMon_298 "" UBYTE DefaultIdenticalCompu 1 100 0.0 255.0 MAX_REFRESH 4 1 ECU_ADDRESS 0x400D91EE
 /begin ANNOTATION ANNOTATION_LABEL "Description (coming from AUTOSAR DESC field)"
  /begin ANNOTATION_TEXT "Application data type for error type data elements. Error types are bit coded\r\n" /end ANNOTATION_TEXT
 /end ANNOTATION
/end MEASUREMENT
/begin MEASUREMENT MCore_Unconnected_StMon_299 "" UBYTE DefaultIdenticalCompu 1 100 0.0 255.0 MAX_REFRESH 4 1 ECU_ADDRESS 0x400D91EF
 /begin ANNOTATION ANNOTATION_LABEL "Description (coming from AUTOSAR DESC field)"
  /begin ANNOTATION_TEXT "Application data type for error type data elements. Error types are bit coded\r\n" /end ANNOTATION_TEXT
 /end ANNOTATION
/end MEASUREMENT
/begin MEASUREMENT MCore_StMon_300 "" UBYTE DefaultIdenticalCompu 1 100 0.0 255.0 MAX_REFRESH 4 1 ECU_ADDRESS 0x5280D2F5
 /begin ANNOTATION ANNOTATION_LABEL "Description (coming from AUTOSAR DESC field)"
  /begin ANNOTATION_TEXT "Application data type for error type data elements. Error types are bit coded\r\n" /end ANNOTATION_TEXT
 /end ANNOTATION
/end MEASUREMENT
/begin MEASUREMENT MCore_Unconnected_StMon_301 "" UBYTE DefaultIdenticalCompu 1 100 0.0 255.0 MAX_REFRESH 4 1 ECU_ADDRESS 0x400D91F0
 /begin ANNOTATION ANNOTATION_LABEL "Description (coming from AUTOSAR DESC field)"
  /begin ANNOTATION_TEXT "Application data type for error type data elements. Error types are bit coded\r\n" /end ANNOTATION_TEXT
 /end ANNOTATION
/end MEASUREMENT
/begin MEASUREMENT MCore_Unconnected_StMon_307 "" UBYTE DefaultIdenticalCompu 1 100 0.0 255.0 MAX_REFRESH 4 1 ECU_ADDRESS 0x400D91F1
 /begin ANNOTATION ANNOTATION_LABEL "Description (coming from AUTOSAR DESC field)"
  /begin ANNOTATION_TEXT "Application data type for error type data elements. Error types are bit coded\r\n" /end ANNOTATION_TEXT
 /end ANNOTATION
/end MEASUREMENT
/begin MEASUREMENT MCore_Unconnected_StMon_308 "" UBYTE DefaultIdenticalCompu 1 100 0.0 255.0 MAX_REFRESH 4 1 ECU_ADDRESS 0x400D91F2
 /begin ANNOTATION ANNOTATION_LABEL "Description (coming from AUTOSAR DESC field)"
  /begin ANNOTATION_TEXT "Application data type for error type data elements. Error types are bit coded\r\n" /end ANNOTATION_TEXT
 /end ANNOTATION
/end MEASUREMENT
/begin MEASUREMENT MCore_Unconnected_StMon_309 "" UBYTE DefaultIdenticalCompu 1 100 0.0 255.0 MAX_REFRESH 4 1 ECU_ADDRESS 0x400D91F3
 /begin ANNOTATION ANNOTATION_LABEL "Description (coming from AUTOSAR DESC field)"
  /begin ANNOTATION_TEXT "Application data type for error type data elements. Error types are bit coded\r\n" /end ANNOTATION_TEXT
 /end ANNOTATION
/end MEASUREMENT
/begin MEASUREMENT MCore_Unconnected_StMon_310 "" UBYTE DefaultIdenticalCompu 1 100 0.0 255.0 MAX_REFRESH 4 1 ECU_ADDRESS 0x400D91F4
 /begin ANNOTATION ANNOTATION_LABEL "Description (coming from AUTOSAR DESC field)"
  /begin ANNOTATION_TEXT "Application data type for error type data elements. Error types are bit coded\r\n" /end ANNOTATION_TEXT
 /end ANNOTATION
/end MEASUREMENT
/begin MEASUREMENT MCore_Unconnected_StMon_311 "" UBYTE DefaultIdenticalCompu 1 100 0.0 255.0 MAX_REFRESH 4 1 ECU_ADDRESS 0x400D91F5
 /begin ANNOTATION ANNOTATION_LABEL "Description (coming from AUTOSAR DESC field)"
  /begin ANNOTATION_TEXT "Application data type for error type data elements. Error types are bit coded\r\n" /end ANNOTATION_TEXT
 /end ANNOTATION
/end MEASUREMENT
/begin MEASUREMENT MCore_Unconnected_StMon_312 "" UBYTE DefaultIdenticalCompu 1 100 0.0 255.0 MAX_REFRESH 4 1 ECU_ADDRESS 0x400D91F6
 /begin ANNOTATION ANNOTATION_LABEL "Description (coming from AUTOSAR DESC field)"
  /begin ANNOTATION_TEXT "Application data type for error type data elements. Error types are bit coded\r\n" /end ANNOTATION_TEXT
 /end ANNOTATION
/end MEASUREMENT
/begin MEASUREMENT MCore_Unconnected_StMon_313 "" UBYTE DefaultIdenticalCompu 1 100 0.0 255.0 MAX_REFRESH 4 1 ECU_ADDRESS 0x400D91F7
 /begin ANNOTATION ANNOTATION_LABEL "Description (coming from AUTOSAR DESC field)"
  /begin ANNOTATION_TEXT "Application data type for error type data elements. Error types are bit coded\r\n" /end ANNOTATION_TEXT
 /end ANNOTATION
/end MEASUREMENT
/begin MEASUREMENT MCore_Unconnected_StMon_314 "" UBYTE DefaultIdenticalCompu 1 100 0.0 255.0 MAX_REFRESH 4 1 ECU_ADDRESS 0x400D91F8
 /begin ANNOTATION ANNOTATION_LABEL "Description (coming from AUTOSAR DESC field)"
  /begin ANNOTATION_TEXT "Application data type for error type data elements. Error types are bit coded\r\n" /end ANNOTATION_TEXT
 /end ANNOTATION
/end MEASUREMENT
/begin MEASUREMENT MCore_Unconnected_StMon_315 "" UBYTE DefaultIdenticalCompu 1 100 0.0 255.0 MAX_REFRESH 4 1 ECU_ADDRESS 0x400D91F9
 /begin ANNOTATION ANNOTATION_LABEL "Description (coming from AUTOSAR DESC field)"
  /begin ANNOTATION_TEXT "Application data type for error type data elements. Error types are bit coded\r\n" /end ANNOTATION_TEXT
 /end ANNOTATION
/end MEASUREMENT
/begin MEASUREMENT MCore_Unconnected_StMon_316 "" UBYTE DefaultIdenticalCompu 1 100 0.0 255.0 MAX_REFRESH 4 1 ECU_ADDRESS 0x400D91FA
 /begin ANNOTATION ANNOTATION_LABEL "Description (coming from AUTOSAR DESC field)"
  /begin ANNOTATION_TEXT "Application data type for error type data elements. Error types are bit coded\r\n" /end ANNOTATION_TEXT
 /end ANNOTATION
/end MEASUREMENT
/begin MEASUREMENT MCore_Unconnected_StMon_317 "" UBYTE DefaultIdenticalCompu 1 100 0.0 255.0 MAX_REFRESH 4 1 ECU_ADDRESS 0x400D91FB
 /begin ANNOTATION ANNOTATION_LABEL "Description (coming from AUTOSAR DESC field)"
  /begin ANNOTATION_TEXT "Application data type for error type data elements. Error types are bit coded\r\n" /end ANNOTATION_TEXT
 /end ANNOTATION
/end MEASUREMENT
/begin MEASUREMENT MCore_Unconnected_StMon_318 "" UBYTE DefaultIdenticalCompu 1 100 0.0 255.0 MAX_REFRESH 4 1 ECU_ADDRESS 0x400D91FC
 /begin ANNOTATION ANNOTATION_LABEL "Description (coming from AUTOSAR DESC field)"
  /begin ANNOTATION_TEXT "Application data type for error type data elements. Error types are bit coded\r\n" /end ANNOTATION_TEXT
 /end ANNOTATION
/end MEASUREMENT
/begin MEASUREMENT MCore_Unconnected_StMon_324 "" UBYTE DefaultIdenticalCompu 1 100 0.0 255.0 MAX_REFRESH 4 1 ECU_ADDRESS 0x400D91FD
 /begin ANNOTATION ANNOTATION_LABEL "Description (coming from AUTOSAR DESC field)"
  /begin ANNOTATION_TEXT "Application data type for error type data elements. Error types are bit coded\r\n" /end ANNOTATION_TEXT
 /end ANNOTATION
/end MEASUREMENT
/begin MEASUREMENT MCore_Unconnected_StMon_325 "" UBYTE DefaultIdenticalCompu 1 100 0.0 255.0 MAX_REFRESH 4 1 ECU_ADDRESS 0x400D91FE
 /begin ANNOTATION ANNOTATION_LABEL "Description (coming from AUTOSAR DESC field)"
  /begin ANNOTATION_TEXT "Application data type for error type data elements. Error types are bit coded\r\n" /end ANNOTATION_TEXT
 /end ANNOTATION
/end MEASUREMENT
/begin MEASUREMENT MCore_Unconnected_StMon_326 "" UBYTE DefaultIdenticalCompu 1 100 0.0 255.0 MAX_REFRESH 4 1 ECU_ADDRESS 0x400D91FF
 /begin ANNOTATION ANNOTATION_LABEL "Description (coming from AUTOSAR DESC field)"
  /begin ANNOTATION_TEXT "Application data type for error type data elements. Error types are bit coded\r\n" /end ANNOTATION_TEXT
 /end ANNOTATION
/end MEASUREMENT
/begin MEASUREMENT MCore_StMon_327 "" UBYTE DefaultIdenticalCompu 1 100 0.0 255.0 MAX_REFRESH 4 1 ECU_ADDRESS 0x5280D2F6
 /begin ANNOTATION ANNOTATION_LABEL "Description (coming from AUTOSAR DESC field)"
  /begin ANNOTATION_TEXT "Application data type for error type data elements. Error types are bit coded\r\n" /end ANNOTATION_TEXT
 /end ANNOTATION
/end MEASUREMENT
/begin MEASUREMENT MCore_Unconnected_StMon_328 "" UBYTE DefaultIdenticalCompu 1 100 0.0 255.0 MAX_REFRESH 4 1 ECU_ADDRESS 0x400D9200
 /begin ANNOTATION ANNOTATION_LABEL "Description (coming from AUTOSAR DESC field)"
  /begin ANNOTATION_TEXT "Application data type for error type data elements. Error types are bit coded\r\n" /end ANNOTATION_TEXT
 /end ANNOTATION
/end MEASUREMENT
/begin MEASUREMENT MCore_Unconnected_StMon_329 "" UBYTE DefaultIdenticalCompu 1 100 0.0 255.0 MAX_REFRESH 4 1 ECU_ADDRESS 0x400D9201
 /begin ANNOTATION ANNOTATION_LABEL "Description (coming from AUTOSAR DESC field)"
  /begin ANNOTATION_TEXT "Application data type for error type data elements. Error types are bit coded\r\n" /end ANNOTATION_TEXT
 /end ANNOTATION
/end MEASUREMENT
/begin MEASUREMENT MCore_BrakePedalSts "Boolean" UBYTE Methods_boolean 1 100 0.0 1.0 MAX_REFRESH 4 1 ECU_ADDRESS 0x400E315A /end MEASUREMENT
/begin MEASUREMENT MCore_BrakePedalValidData "unsigned integer 8bit" UBYTE VW_BCM_CompuMethods_SC_F1_O0_UNoUnit 1 100 0.0 255.0 MAX_REFRESH 4 1 ECU_ADDRESS 0x400E315B /end MEASUREMENT
/begin MEASUREMENT MCore_DriverBrkPressureRqtValidData "unsigned integer 8bit" UBYTE VW_BCM_CompuMethods_SC_F1_O0_UNoUnit 1 100 0.0 255.0 MAX_REFRESH 4 1 ECU_ADDRESS 0x400E315C /end MEASUREMENT
/begin MEASUREMENT MCore_StopLightActRq "Boolean" UBYTE Methods_boolean 1 100 0.0 1.0 MAX_REFRESH 4 1 ECU_ADDRESS 0x5280818E /end MEASUREMENT
/begin MEASUREMENT MCore_Unconnected_NFR_Speed_FA_FailSts "Boolean" UBYTE Methods_boolean 1 100 0.0 1.0 MAX_REFRESH 4 1 ECU_ADDRESS 0x400D9202 /end MEASUREMENT
/begin MEASUREMENT MCore_Unconnected_VehicleSpeedVSOSigFailSts "Boolean" UBYTE Methods_boolean 1 100 0.0 1.0 MAX_REFRESH 4 1 ECU_ADDRESS 0x400D9203 /end MEASUREMENT
/begin MEASUREMENT MCore_Unconnected_flgVehSpdErr "Boolean" UBYTE Methods_boolean 1 100 0.0 1.0 MAX_REFRESH 4 1 ECU_ADDRESS 0x400D9204 /end MEASUREMENT
/begin MEASUREMENT MCore_Unconnected_stVehSpdQlfr "unsigned integer 8bit" UBYTE VW_BCM_CompuMethods_CM_TXTenErrStatus 1 100 0.0 255.0 MAX_REFRESH 4 1 ECU_ADDRESS 0x400E315D /end MEASUREMENT
/begin MEASUREMENT MCore_Unconnected_vVehSpd "unsigned integer 16bit" UWORD DefaultIdenticalCompu 1 100 0.0 65535.0 MAX_REFRESH 4 1 ECU_ADDRESS 0x400E2F3C /end MEASUREMENT
/begin MEASUREMENT MCore_LowBeam_Button "unsigned integer 8bit" UBYTE VW_BCM_CompuMethods_SC_F1_O0_UNoUnit 1 100 0.0 255.0 MAX_REFRESH 4 1 ECU_ADDRESS 0x400E361F /end MEASUREMENT
/begin MEASUREMENT MCore_Unconnected_CrashOutputSts "unsigned integer 8bit" UBYTE VW_BCM_CompuMethods_SC_F1_O0_UNoUnit 1 100 0.0 255.0 MAX_REFRESH 4 1 ECU_ADDRESS 0x400E315F /end MEASUREMENT
/begin MEASUREMENT MCore_Unconnected_CrashOutputValidData "Boolean" UBYTE Methods_boolean 1 100 0.0 1.0 MAX_REFRESH 4 1 ECU_ADDRESS 0x400E315E /end MEASUREMENT
/begin MEASUREMENT MCore_Unconnected_Ppd_psngr_info "unsigned integer 8bit" UBYTE VW_BCM_CompuMethods_SC_F1_O0_UNoUnit 1 100 0.0 255.0 MAX_REFRESH 4 1 ECU_ADDRESS 0x400E3160 /end MEASUREMENT
/begin MEASUREMENT MCore_Unconnected_SBR1RowDriverSeatFailSts "unsigned integer 8bit" UBYTE VW_BCM_CompuMethods_SC_F1_O0_UNoUnit 1 100 0.0 255.0 MAX_REFRESH 4 1 ECU_ADDRESS 0x400D9207 /end MEASUREMENT
/begin MEASUREMENT MCore_Unconnected_SBR1RowDriverSeatSts "unsigned integer 8bit" UBYTE VW_BCM_CompuMethods_SC_F1_O0_UNoUnit 1 100 0.0 255.0 MAX_REFRESH 4 1 ECU_ADDRESS 0x400D9205 /end MEASUREMENT
/begin MEASUREMENT MCore_Unconnected_SBR1RowPsngrSeatBuckleFailSts "unsigned integer 8bit" UBYTE VW_BCM_CompuMethods_SC_F1_O0_UNoUnit 1 100 0.0 255.0 MAX_REFRESH 4 1 ECU_ADDRESS 0x400D9208 /end MEASUREMENT
/begin MEASUREMENT MCore_Unconnected_SBR1RowPsngrSeatSts "unsigned integer 8bit" UBYTE VW_BCM_CompuMethods_SC_F1_O0_UNoUnit 1 100 0.0 255.0 MAX_REFRESH 4 1 ECU_ADDRESS 0x400D9206 /end MEASUREMENT
/begin MEASUREMENT MCore_Unconnected_NFR_Speed_FA_FailSts_0 "Boolean" UBYTE Methods_boolean 1 100 0.0 1.0 MAX_REFRESH 4 1 ECU_ADDRESS 0x400AB35D /end MEASUREMENT
/begin MEASUREMENT MCore_Unconnected_DeLDirectionSwitchSts "" UBYTE Methods_boolean 1 100 0.0 255.0 MAX_REFRESH 4 1 ECU_ADDRESS 0x400E3161 /end MEASUREMENT
/begin MEASUREMENT MCore_Unconnected_DeRDirectionSwitchSts "" UBYTE Methods_boolean 1 100 0.0 255.0 MAX_REFRESH 4 1 ECU_ADDRESS 0x400E3162 /end MEASUREMENT
/begin MEASUREMENT MCore_LdirectionSwitchSts_1 "Boolean" UBYTE Methods_boolean 1 100 0.0 1.0 MAX_REFRESH 4 1 ECU_ADDRESS 0x400E3163 /end MEASUREMENT
/begin MEASUREMENT MCore_RdirectionSwitchSts_1 "Boolean" UBYTE Methods_boolean 1 100 0.0 1.0 MAX_REFRESH 4 1 ECU_ADDRESS 0x400E3164 /end MEASUREMENT
/begin MEASUREMENT MCore_PowertrainSts "unsigned integer 8bit" UBYTE VW_BCM_CompuMethods_SC_F1_O0_UNoUnit 1 100 0.0 255.0 MAX_REFRESH 4 1 ECU_ADDRESS 0x5280818F /end MEASUREMENT
/begin MEASUREMENT MCore_DeLeft_TI_FailSts "" UBYTE Methods_boolean 1 100 0.0 255.0 MAX_REFRESH 4 1 ECU_ADDRESS 0x400E3165 /end MEASUREMENT
/begin MEASUREMENT MCore_DeLeft_TI_Feedback "" UBYTE Methods_boolean 1 100 0.0 255.0 MAX_REFRESH 4 1 ECU_ADDRESS 0x400E3166 /end MEASUREMENT
/begin MEASUREMENT MCore_DeRight_TI_FailSts "" UBYTE Methods_boolean 1 100 0.0 255.0 MAX_REFRESH 4 1 ECU_ADDRESS 0x400E3167 /end MEASUREMENT
/begin MEASUREMENT MCore_DeRight_TI_Feedback "" UBYTE Methods_boolean 1 100 0.0 255.0 MAX_REFRESH 4 1 ECU_ADDRESS 0x400E3168 /end MEASUREMENT
/begin MEASUREMENT MCore_Unconnected_STS_LH_DoorStatus "unsigned integer 8bit" UBYTE VW_BCM_CompuMethods_SC_F1_O0_UNoUnit 1 100 0.0 255.0 MAX_REFRESH 4 1 ECU_ADDRESS 0x400E3169 /end MEASUREMENT
/begin MEASUREMENT MCore_Unconnected_STS_LH_FailSts "Boolean" UBYTE Methods_boolean 1 100 0.0 1.0 MAX_REFRESH 4 1 ECU_ADDRESS 0x400E316B /end MEASUREMENT
/begin MEASUREMENT MCore_Unconnected_STS_LH_IsHandle_Active "Boolean" UBYTE Methods_boolean 1 100 0.0 1.0 MAX_REFRESH 4 1 ECU_ADDRESS 0x400E316C /end MEASUREMENT
/begin MEASUREMENT MCore_Unconnected_STS_LH_Latch "unsigned integer 8bit" UBYTE VW_BCM_CompuMethods_SC_F1_O0_UNoUnit 1 100 0.0 255.0 MAX_REFRESH 4 1 ECU_ADDRESS 0x400E316A /end MEASUREMENT
/begin MEASUREMENT MCore_Unconnected_STS_LH_OsHandle_Lock_Active "Boolean" UBYTE Methods_boolean 1 100 0.0 1.0 MAX_REFRESH 4 1 ECU_ADDRESS 0x400E316D /end MEASUREMENT
/begin MEASUREMENT MCore_STS_LH_DoorStatus_0 "unsigned integer 8bit" UBYTE VW_BCM_CompuMethods_SC_F1_O0_UNoUnit 1 100 0.0 255.0 MAX_REFRESH 4 1 ECU_ADDRESS 0x52808194 /end MEASUREMENT
/begin MEASUREMENT MCore_STS_LH_FailSts_0 "Boolean" UBYTE Methods_boolean 1 100 0.0 1.0 MAX_REFRESH 4 1 ECU_ADDRESS 0x400E3621 /end MEASUREMENT
/begin MEASUREMENT MCore_STS_LH_Latch_0 "unsigned integer 8bit" UBYTE VW_BCM_CompuMethods_SC_F1_O0_UNoUnit 1 100 0.0 255.0 MAX_REFRESH 4 1 ECU_ADDRESS 0x52808195 /end MEASUREMENT
/begin MEASUREMENT MCore_Unconnected_STS_RH_DoorStatus "unsigned integer 8bit" UBYTE VW_BCM_CompuMethods_SC_F1_O0_UNoUnit 1 100 0.0 255.0 MAX_REFRESH 4 1 ECU_ADDRESS 0x400E316E /end MEASUREMENT
/begin MEASUREMENT MCore_Unconnected_STS_RH_FailSts "Boolean" UBYTE Methods_boolean 1 100 0.0 1.0 MAX_REFRESH 4 1 ECU_ADDRESS 0x400E3170 /end MEASUREMENT
/begin MEASUREMENT MCore_Unconnected_STS_RH_IsHandle_Active "Boolean" UBYTE Methods_boolean 1 100 0.0 1.0 MAX_REFRESH 4 1 ECU_ADDRESS 0x400E3172 /end MEASUREMENT
/begin MEASUREMENT MCore_Unconnected_STS_RH_Latch "unsigned integer 8bit" UBYTE VW_BCM_CompuMethods_SC_F1_O0_UNoUnit 1 100 0.0 255.0 MAX_REFRESH 4 1 ECU_ADDRESS 0x400E316F /end MEASUREMENT
/begin MEASUREMENT MCore_Unconnected_STS_RH_OsHandle_Lock_Active "Boolean" UBYTE Methods_boolean 1 100 0.0 1.0 MAX_REFRESH 4 1 ECU_ADDRESS 0x400E3171 /end MEASUREMENT
/begin MEASUREMENT MCore_STS_RH_DoorStatus_0 "unsigned integer 8bit" UBYTE VW_BCM_CompuMethods_SC_F1_O0_UNoUnit 1 100 0.0 255.0 MAX_REFRESH 4 1 ECU_ADDRESS 0x52808196 /end MEASUREMENT
/begin MEASUREMENT MCore_STS_RH_FailSts_0 "Boolean" UBYTE Methods_boolean 1 100 0.0 1.0 MAX_REFRESH 4 1 ECU_ADDRESS 0x400E3622 /end MEASUREMENT
/begin MEASUREMENT MCore_STS_RH_Latch_0 "unsigned integer 8bit" UBYTE VW_BCM_CompuMethods_SC_F1_O0_UNoUnit 1 100 0.0 255.0 MAX_REFRESH 4 1 ECU_ADDRESS 0x52808197 /end MEASUREMENT
/begin MEASUREMENT MCore_STS_LV_DoorStatus_0 "unsigned integer 8bit" UBYTE VW_BCM_CompuMethods_SC_F1_O0_UNoUnit 1 100 0.0 255.0 MAX_REFRESH 4 1 ECU_ADDRESS 0x52808198 /end MEASUREMENT
/begin MEASUREMENT MCore_STS_LV_FailSts_0 "Boolean" UBYTE Methods_boolean 1 100 0.0 1.0 MAX_REFRESH 4 1 ECU_ADDRESS 0x400E3623 /end MEASUREMENT
/begin MEASUREMENT MCore_STS_LV_Latch_0 "unsigned integer 8bit" UBYTE VW_BCM_CompuMethods_SC_F1_O0_UNoUnit 1 100 0.0 255.0 MAX_REFRESH 4 1 ECU_ADDRESS 0x52808199 /end MEASUREMENT
/begin MEASUREMENT MCore_STS_RV_DoorStatus_0 "unsigned integer 8bit" UBYTE VW_BCM_CompuMethods_SC_F1_O0_UNoUnit 1 100 0.0 255.0 MAX_REFRESH 4 1 ECU_ADDRESS 0x5280819A /end MEASUREMENT
/begin MEASUREMENT MCore_STS_RV_FailSts_0 "Boolean" UBYTE Methods_boolean 1 100 0.0 1.0 MAX_REFRESH 4 1 ECU_ADDRESS 0x400E3625 /end MEASUREMENT
/begin MEASUREMENT MCore_STS_RV_Latch_0 "unsigned integer 8bit" UBYTE VW_BCM_CompuMethods_SC_F1_O0_UNoUnit 1 100 0.0 255.0 MAX_REFRESH 4 1 ECU_ADDRESS 0x5280819B /end MEASUREMENT
/begin MEASUREMENT MCore_ExternalRearLeftStopLightCmd "Boolean" UBYTE Methods_boolean 1 100 0.0 1.0 MAX_REFRESH 4 1 ECU_ADDRESS 0x400AB361 /end MEASUREMENT
/begin MEASUREMENT MCore_ExternalRearRightStopLightCmd "Boolean" UBYTE Methods_boolean 1 100 0.0 1.0 MAX_REFRESH 4 1 ECU_ADDRESS 0x400AB362 /end MEASUREMENT
/begin MEASUREMENT MCore_InternalRearLeftStopLightCmd "Boolean" UBYTE Methods_boolean 1 100 0.0 1.0 MAX_REFRESH 4 1 ECU_ADDRESS 0x400AB363 /end MEASUREMENT
/begin MEASUREMENT MCore_InternalRearRightStopLightCmd "Boolean" UBYTE Methods_boolean 1 100 0.0 1.0 MAX_REFRESH 4 1 ECU_ADDRESS 0x400AB364 /end MEASUREMENT
/begin MEASUREMENT MCore_Unconnected_bfAnfFreigSchnellerBrDurchgr_0 "unsigned integer 16bit" UWORD VW_BCM_CompuMethods_SC_F1_O0_UNoUnit 1 100 0.0 1023.0 MAX_REFRESH 4 1 ECU_ADDRESS 0x400E2F3E /end MEASUREMENT
/begin MEASUREMENT MCore_Stop_Lateral_Left_Light_Fail "unsigned integer 8bit" UBYTE VW_BCM_CompuMethods_SC_F1_O0_UNoUnit 1 100 0.0 255.0 MAX_REFRESH 4 1 ECU_ADDRESS 0x400E3884 /end MEASUREMENT
/begin MEASUREMENT MCore_Stop_Lateral_Right_Light_Fail "unsigned integer 8bit" UBYTE VW_BCM_CompuMethods_SC_F1_O0_UNoUnit 1 100 0.0 255.0 MAX_REFRESH 4 1 ECU_ADDRESS 0x400E3885 /end MEASUREMENT
/begin MEASUREMENT MCore_Stop_Light_Req "Boolean" UBYTE Methods_boolean 1 100 0.0 1.0 MAX_REFRESH 4 1 ECU_ADDRESS 0x400E3886 /end MEASUREMENT
/begin MEASUREMENT MCore_TesterValue "Boolean" UBYTE Methods_boolean 1 100 0.0 1.0 MAX_REFRESH 4 1 ECU_ADDRESS 0x400E3888 /end MEASUREMENT
/begin MEASUREMENT MCore_TesterValue_0 "Boolean" UBYTE Methods_boolean 1 100 0.0 1.0 MAX_REFRESH 4 1 ECU_ADDRESS 0x400E388A /end MEASUREMENT
/begin MEASUREMENT MCore_DE_WSMCmd "Boolean" UBYTE Methods_boolean 1 100 0.0 1.0 MAX_REFRESH 4 1 ECU_ADDRESS 0x400E388B /end MEASUREMENT
/begin MEASUREMENT MCore_RainSensorActive "Boolean" UBYTE Methods_boolean 1 100 0.0 1.0 MAX_REFRESH 4 1 ECU_ADDRESS 0x400E388C /end MEASUREMENT
/begin MEASUREMENT MCore_StMon_366 "" UBYTE DefaultIdenticalCompu 1 100 0.0 255.0 MAX_REFRESH 4 1 ECU_ADDRESS 0x400E388D
 /begin ANNOTATION ANNOTATION_LABEL "Description (coming from AUTOSAR DESC field)"
  /begin ANNOTATION_TEXT "Application data type for error type data elements. Error types are bit coded\r\n" /end ANNOTATION_TEXT
 /end ANNOTATION
/end MEASUREMENT
/begin MEASUREMENT MCore_NFR_Speed_FA_FailSts_2 "Boolean" UBYTE Methods_boolean 1 100 0.0 1.0 MAX_REFRESH 4 1 ECU_ADDRESS 0x400E388E /end MEASUREMENT
/begin MEASUREMENT MCore_PiBackLiChdLock "" UWORD DefaultIdenticalCompu 1 100 0.0 100.0 MAX_REFRESH 4 1 ECU_ADDRESS 0x400E2FA4 /end MEASUREMENT
/begin MEASUREMENT MCore_VF228_actvLeChdLockCtrl "Boolean" UBYTE Methods_boolean 1 100 0.0 1.0 MAX_REFRESH 4 1 ECU_ADDRESS 0x400E3178 /end MEASUREMENT
/*********** End of merged MEASUREMENT blocks ***********/ /*********** Start of merged COMPU_METHOD blocks ***********/
/begin COMPU_METHOD BCGW_ModeM_CompuMethods_ModeM_RequestComModeType "" TAB_VERB "%10.5" "" COMPU_TAB_REF BCGW_ModeM_CompuMethods_ModeM_RequestComModeType /end COMPU_METHOD
/begin COMPU_METHOD VW_BCM_CompuMethods_CM_TXTenDIAGAnfStatus "" TAB_VERB "%10.5" "" COMPU_TAB_REF VW_BCM_CompuMethods_CM_TXTenDIAGAnfStatus /end COMPU_METHOD
/begin COMPU_METHOD VW_BCM_CompuMethods_CM_TXTenSPNAnfKlemme15 "" TAB_VERB "%10.5" "" COMPU_TAB_REF VW_BCM_CompuMethods_CM_TXTenSPNAnfKlemme15 /end COMPU_METHOD
/begin COMPU_METHOD VW_BCM_CompuMethods_CM_TXTenSPNAnfStatus "" TAB_VERB "%10.5" "" COMPU_TAB_REF VW_BCM_CompuMethods_CM_TXTenSPNAnfStatus /end COMPU_METHOD
/begin COMPU_METHOD VW_BCM_CompuMethods_CM_TXTenSPNAnfWFSFreigabe "" TAB_VERB "%10.5" "" COMPU_TAB_REF VW_BCM_CompuMethods_CM_TXTenSPNAnfWFSFreigabe /end COMPU_METHOD
/begin COMPU_METHOD VW_BCM_CompuMethods_CM_TXTenComUserRequestReasonSpnSen "" TAB_VERB "%10.5" "" COMPU_TAB_REF VW_BCM_CompuMethods_CM_TXTenComUserRequestReasonSpnSen /end COMPU_METHOD
/begin COMPU_METHOD Methods_boolean "" TAB_VERB "%10.5" "" COMPU_TAB_REF Methods_boolean /end COMPU_METHOD
/begin COMPU_METHOD VW_BCM_CompuMethods_CM_TXTenElvVerbaut "" TAB_VERB "%10.5" "" COMPU_TAB_REF VW_BCM_CompuMethods_CM_TXTenElvVerbaut /end COMPU_METHOD
/begin COMPU_METHOD VW_BCM_CompuMethods_SC_F1_O0_UNoUnit "" RAT_FUNC "%10.5" "" COEFFS 0.0 -1.0 0.0 0.0 0.0 -1.0 /end COMPU_METHOD
/begin COMPU_METHOD App_SpnSen_CompuMethods_SC_F10_O0_Urpm "" RAT_FUNC "%10.5" "rpm" COEFFS 0.0 -1.0 0.0 0.0 0.0 -10.0 REF_UNIT App_Tc_Units_Rpm /end COMPU_METHOD
/begin COMPU_METHOD App_SpnSen_CompuMethods_SC_F100_O0_Ums "" RAT_FUNC "%10.5" "ms" COEFFS 0.0 -1.0 0.0 0.0 0.0 -100.0 REF_UNIT App_Tc_Units_ms /end COMPU_METHOD
/begin COMPU_METHOD VW_BCM_CompuMethods_SC_F1_O0_USec "" RAT_FUNC "%10.5" "" COEFFS 0.0 -1.0 0.0 0.0 0.0 -1.0 /end COMPU_METHOD
/begin COMPU_METHOD App_Tc_CompuMethods_SC_F10_O0_Ums "" RAT_FUNC "%10.5" "ms" COEFFS 0.0 -1.0 0.0 0.0 0.0 -10.0 REF_UNIT App_Tc_Units_ms /end COMPU_METHOD
/begin COMPU_METHOD App_SpnSen_CompuMethods_SC_F200_O0_Ums "" RAT_FUNC "%10.5" "ms" COEFFS 0.0 -1.0 0.0 0.0 0.0 -200.0 REF_UNIT App_Tc_Units_ms /end COMPU_METHOD
/begin COMPU_METHOD App_SpnSen_CompuMethods_SC_F5_O0_Ums "" RAT_FUNC "%10.5" "ms" COEFFS 0.0 -1.0 0.0 0.0 0.0 -5.0 REF_UNIT App_Tc_Units_ms /end COMPU_METHOD
/begin COMPU_METHOD App_SpnSen_CompuMethods_SC_F50_O0_Ums "" RAT_FUNC "%10.5" "ms" COEFFS 0.0 -1.0 0.0 0.0 0.0 -50.0 REF_UNIT App_Tc_Units_ms /end COMPU_METHOD
/begin COMPU_METHOD App_SpnSen_CompuMethods_SC_F0pt1_O0_Ukmh "" RAT_FUNC "%10.5" "km/h" COEFFS 0.0 -1.0 0.0 0.0 0.0 -0.1 REF_UNIT App_Tc_Units_kmh /end COMPU_METHOD
/begin COMPU_METHOD App_Tc_CompuMethods_SC_F1_O0_Ukmh "" RAT_FUNC "%10.5" "km/h" COEFFS 0.0 -1.0 0.0 0.0 0.0 -1.0 REF_UNIT App_Tc_Units_kmh /end COMPU_METHOD
/begin COMPU_METHOD VW_BCM_CompuMethods_CM_TXTenErrStatus "" TAB_VERB "%10.5" "" COMPU_TAB_REF VW_BCM_CompuMethods_CM_TXTenErrStatus /end COMPU_METHOD
/begin COMPU_METHOD VW_BCM_CompuMethods_CM_TXTenESCvSigQualifizierung "" TAB_VERB "%10.5" "" COMPU_TAB_REF VW_BCM_CompuMethods_CM_TXTenESCvSigQualifizierung /end COMPU_METHOD
/begin COMPU_METHOD VW_BCM_CompuMethods_CM_TXTenMoStartVoraussErfuellt "" TAB_VERB "%10.5" "" COMPU_TAB_REF VW_BCM_CompuMethods_CM_TXTenMoStartVoraussErfuellt /end COMPU_METHOD
/begin COMPU_METHOD VW_BCM_CompuMethods_SC_F0pt25_O0_URpm "" RAT_FUNC "%10.5" "" COEFFS 0.0 -1.0 0.0 0.0 0.0 -0.25 /end COMPU_METHOD
/begin COMPU_METHOD VW_BCM_CompuMethods_SC_F0pt1_O0_UVolt "" RAT_FUNC "%10.5" "" COEFFS 0.0 -1.0 0.0 0.0 0.0 -0.1 /end COMPU_METHOD
/begin COMPU_METHOD VW_BCM_CompuMethods_CM_TXTenWeckgrund "" TAB_VERB "%10.5" "" COMPU_TAB_REF VW_BCM_CompuMethods_CM_TXTenWeckgrund /end COMPU_METHOD
/begin COMPU_METHOD App_Tc_CompuMethods_CM_TXTenKlemmenstatusNir "" TAB_VERB "%10.5" "-" COMPU_TAB_REF App_Tc_CompuMethods_CM_TXTenKlemmenstatusNir REF_UNIT App_Tc_Units_NoUnit /end COMPU_METHOD
/begin COMPU_METHOD App_Tc_CompuMethods_CM_TXTenNotactiveActive "" TAB_VERB "%10.5" "-" COMPU_TAB_REF App_Tc_CompuMethods_CM_TXTenNotactiveActive REF_UNIT App_Tc_Units_NoUnit /end COMPU_METHOD
/begin COMPU_METHOD App_Tc_CompuMethods_CM_TXTenNotactiveActiveNotinstalled "" TAB_VERB "%10.5" "-" COMPU_TAB_REF App_Tc_CompuMethods_CM_TXTenNotactiveActiveNotinstalled REF_UNIT App_Tc_Units_NoUnit /end COMPU_METHOD
/begin COMPU_METHOD App_Tc_CompuMethods_CM_TXTenNoYes "" TAB_VERB "%10.5" "-" COMPU_TAB_REF App_Tc_CompuMethods_CM_TXTenNoYes REF_UNIT App_Tc_Units_NoUnit /end COMPU_METHOD
/begin COMPU_METHOD App_SpnSen_CompuMethods_CM_TXTenFzggeschwSignalzust "" TAB_VERB "%10.5" "-" COMPU_TAB_REF App_SpnSen_CompuMethods_CM_TXTenFzggeschwSignalzust REF_UNIT App_Tc_Units_NoUnit /end COMPU_METHOD
/begin COMPU_METHOD App_Tc_CompuMethods_CM_TXTenNotactiveActiveTimeout "" TAB_VERB "%10.5" "-" COMPU_TAB_REF App_Tc_CompuMethods_CM_TXTenNotactiveActiveTimeout REF_UNIT App_Tc_Units_NoUnit /end COMPU_METHOD
/begin COMPU_METHOD App_Tc_CompuMethods_CM_TXTenOffOn "" TAB_VERB "%10.5" "-" COMPU_TAB_REF App_Tc_CompuMethods_CM_TXTenOffOn REF_UNIT App_Tc_Units_NoUnit /end COMPU_METHOD
/begin COMPU_METHOD VW_BCM_CompuMethods_CM_TXTenKSTZuendungswarnung "" TAB_VERB "%10.5" "" COMPU_TAB_REF VW_BCM_CompuMethods_CM_TXTenKSTZuendungswarnung /end COMPU_METHOD
/begin COMPU_METHOD VW_BCM_CompuMethods_CM_TXTenAnfKlemme15Sz "" TAB_VERB "%10.5" "" COMPU_TAB_REF VW_BCM_CompuMethods_CM_TXTenAnfKlemme15Sz /end COMPU_METHOD
/begin COMPU_METHOD VW_BCM_CompuMethods_CM_TXTenKSTSonderzustandAnforderung "" TAB_VERB "%10.5" "" COMPU_TAB_REF VW_BCM_CompuMethods_CM_TXTenKSTSonderzustandAnforderung /end COMPU_METHOD
/begin COMPU_METHOD VW_BCM_CompuMethods_CM_TXTenKSTSonderzustandStatus "" TAB_VERB "%10.5" "" COMPU_TAB_REF VW_BCM_CompuMethods_CM_TXTenKSTSonderzustandStatus /end COMPU_METHOD
/begin COMPU_METHOD VW_BCM_CompuMethods_CM_TXTenKSTWFSFahrfreigabeAnforderung "" TAB_VERB "%10.5" "" COMPU_TAB_REF VW_BCM_CompuMethods_CM_TXTenKSTWFSFahrfreigabeAnforderung /end COMPU_METHOD
/begin COMPU_METHOD VW_BCM_CompuMethods_CM_TXTenComUserRequestReasonTc "" TAB_VERB "%10.5" "" COMPU_TAB_REF VW_BCM_CompuMethods_CM_TXTenComUserRequestReasonTc /end COMPU_METHOD
/begin COMPU_METHOD App_Tc_CompuMethods_SC_F0pt1_O0_USec "" RAT_FUNC "%10.5" "s" COEFFS 0.0 -1.0 0.0 0.0 0.0 -0.1 REF_UNIT App_Tc_Units_Sec /end COMPU_METHOD
/begin COMPU_METHOD App_Tc_CompuMethods_CM_TXTenFehlerzustandZAS "" TAB_VERB "%10.5" "-" COMPU_TAB_REF App_Tc_CompuMethods_CM_TXTenFehlerzustandZAS REF_UNIT App_Tc_Units_NoUnit /end COMPU_METHOD
/begin COMPU_METHOD DefaultIdenticalCompu "" RAT_FUNC "%10.5" "" COEFFS 0.0 1.0 0.0 0.0 0.0 1.0 /end COMPU_METHOD
/*********** End of merged COMPU_METHOD blocks ***********/ /*********** Start of merged UNIT blocks ***********/
/begin UNIT App_Tc_Units_Rpm "Rpm" "rpm" EXTENDED_SI SI_EXPONENTS 0 0 -1 0 0 0 0 /end UNIT
/begin UNIT App_Tc_Units_ms "" "ms" EXTENDED_SI SI_EXPONENTS 0 0 1 0 0 0 0 /end UNIT
/begin UNIT App_Tc_Units_kmh "" "km/h" EXTENDED_SI SI_EXPONENTS 1 0 -1 0 0 0 0 /end UNIT
/begin UNIT App_Tc_Units_NoUnit "No Unit" "-" EXTENDED_SI SI_EXPONENTS 0 0 0 0 0 0 0 /end UNIT
/begin UNIT App_Tc_Units_Sec "Second" "s" EXTENDED_SI SI_EXPONENTS 0 0 1 0 0 0 0 /end UNIT
/*********** End of merged UNIT blocks ***********/ /*********** Start of merged COMPU_VTAB blocks ***********/
/begin COMPU_VTAB BCGW_ModeM_CompuMethods_ModeM_RequestComModeType "" TAB_VERB 2 1 "MODEM_REQUEST_COM_MODE_NO_COM" 0 "MODEM_REQUEST_COM_MODE_FULL_COM" /end COMPU_VTAB
/begin COMPU_VTAB VW_BCM_CompuMethods_CM_TXTenDIAGAnfStatus "" TAB_VERB 5 0 "Init" 1 "Anforderung" 2 "Aktiv" 3 "Beendet" 4 "Abbruch_Klemmenabschaltung" /end COMPU_VTAB
/begin COMPU_VTAB VW_BCM_CompuMethods_CM_TXTenSPNAnfKlemme15 "" TAB_VERB 4 0 "Keine" 1 "KL_15_HW" 2 "void" 3 "KL_15_HW_UND_CAN" /end COMPU_VTAB
/begin COMPU_VTAB VW_BCM_CompuMethods_CM_TXTenSPNAnfStatus "" TAB_VERB 5 0 "Init" 1 "Anforderung" 2 "Aktiv" 3 "Beendet" 4 "Abbruch_Klemmenabschaltung" /end COMPU_VTAB
/begin COMPU_VTAB VW_BCM_CompuMethods_CM_TXTenSPNAnfWFSFreigabe "" TAB_VERB 3 0 "Keine" 1 "Uneingeschraenkt" 2 "Eingeschraenkt" /end COMPU_VTAB
/begin COMPU_VTAB VW_BCM_CompuMethods_CM_TXTenComUserRequestReasonSpnSen "" TAB_VERB 2 0 "keine_Kommunikation_angefordert" 1 "Anfordern_der_Klemmenfreigabe_von_ELV" /end COMPU_VTAB
/begin COMPU_VTAB Methods_boolean "" TAB_VERB 2 0 "FALSE" 1 "TRUE" /end COMPU_VTAB
/begin COMPU_VTAB VW_BCM_CompuMethods_CM_TXTenElvVerbaut "" TAB_VERB 3 0 "nicht_verbaut" 1 "verbaut" 2 "init" /end COMPU_VTAB
/begin COMPU_VTAB VW_BCM_CompuMethods_CM_TXTenErrStatus "" TAB_VERB 4 0 "Ok" 1 "Fehler" 2 "Init" 3 "No_Monitoring" /end COMPU_VTAB
/begin COMPU_VTAB VW_BCM_CompuMethods_CM_TXTenESCvSigQualifizierung "" TAB_VERB 8 0 "Gueteschwelle_kleiner_1kmh" 1 "Gueteschwelle_kleiner_3kmh" 2 "Gueteschwelle_kleiner_5kmh" 3 "Gueteschwelle_kleiner_10kmh" 4 "Gueteschwelle_kleiner_20kmh" 5 "Gueteschwelle_groessergleich_20kmh" 6 "Init" 7 "Fehler" /end COMPU_VTAB
/begin COMPU_VTAB VW_BCM_CompuMethods_CM_TXTenMoStartVoraussErfuellt "" TAB_VERB 4 0 "Signal_nicht_bedient" 1 "StartVorauss_nicht_ueberpruefbar" 2 "StartVorauss_nicht_erfuellt" 3 "StartVorauss_erfuellt" /end COMPU_VTAB
/begin COMPU_VTAB VW_BCM_CompuMethods_CM_TXTenWeckgrund "" TAB_VERB 4 0 "Init" 1 "PowerOn" 2 "InternEcuReset" 255 "AndereGruende" /end COMPU_VTAB
/begin COMPU_VTAB App_Tc_CompuMethods_CM_TXTenKlemmenstatusNir "" TAB_VERB 3 0 "Init" 106 "nicht_aktiv" 149 "aktiv" /end COMPU_VTAB
/begin COMPU_VTAB App_Tc_CompuMethods_CM_TXTenNotactiveActive "" TAB_VERB 2 0 "not_active" 1 "active" /end COMPU_VTAB
/begin COMPU_VTAB App_Tc_CompuMethods_CM_TXTenNotactiveActiveNotinstalled "" TAB_VERB 3 0 "not_active" 1 "active" 14 "not_installed" /end COMPU_VTAB
/begin COMPU_VTAB App_Tc_CompuMethods_CM_TXTenNoYes "" TAB_VERB 2 0 "no" 1 "yes" /end COMPU_VTAB
/begin COMPU_VTAB App_SpnSen_CompuMethods_CM_TXTenFzggeschwSignalzust "" TAB_VERB 5 0 "gueltig" 1 "veraltet" 2 "ungueltig" 3 "ungueltig_und_veraltet" 4 "Timeout" /end COMPU_VTAB
/begin COMPU_VTAB App_Tc_CompuMethods_CM_TXTenNotactiveActiveTimeout "" TAB_VERB 3 0 "not_active" 1 "active" 2 "Timeout" /end COMPU_VTAB
/begin COMPU_VTAB App_Tc_CompuMethods_CM_TXTenOffOn "" TAB_VERB 2 0 "off" 1 "on" /end COMPU_VTAB
/begin COMPU_VTAB VW_BCM_CompuMethods_CM_TXTenKSTZuendungswarnung "" TAB_VERB 4 0 "keine_Ausgabe_Zuendungswarnung" 1 "Ausg_Zuendungswarnung_Stillstand" 2 "Ausg_Zuendungswarnung_Fahrt" 3 "reserved" /end COMPU_VTAB
/begin COMPU_VTAB VW_BCM_CompuMethods_CM_TXTenAnfKlemme15Sz "" TAB_VERB 4 0 "Keine" 1 "KL_15_HW" 2 "void" 3 "KL_15_HW_UND_CAN" /end COMPU_VTAB
/begin COMPU_VTAB VW_BCM_CompuMethods_CM_TXTenKSTSonderzustandAnforderung "" TAB_VERB 14 0 "Init" 1 "RemoteStart" 2 "RemoteParkAssist" 3 "IntelligentParkAssist" 4 "TrainiertesParken" 5 "OnlineRemoteUpdate" 6 "Einfrierschutz" 7 "Klemme15ViaDiagnose" 8 "RueckwandklappenSicherungPDC" 9 "ParkHausPilot" 10 "AnhaengerAnkuppelAssistent" 11 "MotorWeiterlaufSchaltung" 30 "void" 31 "Fehler" /end COMPU_VTAB
/begin COMPU_VTAB VW_BCM_CompuMethods_CM_TXTenKSTSonderzustandStatus "" TAB_VERB 4 0 "Init" 1 "Uebergang_neue_Anforderung" 2 "Aktiv" 3 "Fehler" /end COMPU_VTAB
/begin COMPU_VTAB VW_BCM_CompuMethods_CM_TXTenKSTWFSFahrfreigabeAnforderung "" TAB_VERB 3 0 "Keine" 1 "Uneingeschraenkt" 2 "Eingeschraenkt" /end COMPU_VTAB
/begin COMPU_VTAB VW_BCM_CompuMethods_CM_TXTenComUserRequestReasonTc "" TAB_VERB 3 0 "keine_Kommunikation_angefordert" 1 "Einschalten_Klemme_15" 2 "Einschalten_Klemme_S" /end COMPU_VTAB
/begin COMPU_VTAB App_Tc_CompuMethods_CM_TXTenFehlerzustandZAS "" TAB_VERB 7 0 "kein_Fehler_erkannt" 1 "Klemme_S_Kurzschluss_nach_Masse" 2 "Klemme_15_1_Kurzschluss_nach_Masse" 3 "Klemme_15_1_Kurzschluss_nach_Plus" 4 "Klemme_15_2_Kurzschluss_nach_Masse" 5 "Klemme_15_2_Kurzschluss_nach_Plus" 6 "Klemme_S_Kurzschluss_nach_Plus" /end COMPU_VTAB
/*********** End of merged COMPU_VTAB_RANGE blocks ***********/
/end MODULE
/end PROJECT
